/**
 * ESP8266 + MCP23S17 + 23LC1024 + TFT + Touch + SD Card Example Implementation
 * 
 * Complete example showing how to initialize and use:
 * - MCP23S17 GPIO Expander (16 additional GPIO pins)
 * - 23LC1024 SPI SRAM (128 KB external RAM)
 * - TFT ST7789 Display (320x240)
 * - XPT2046 Touch Controller
 * - SD Card (SPI mode)
 * 
 * Wiring (NodeMCU v2):
 * ┌─────────────────────────────────────────────────────────────────┐
 * │ TFT ST7789:    Touch XPT2046:    MCP23S17:      23LC1024:    SD Card: │
 * │   CS  = D8 (15)  CS  = D2 (4)     CS  = RX (3)    CS  = TX (1)   CS = D0 (16)│
 * │   DC  = D3 (0)   IRQ = D1 (5)                              │
 * │   RST = N/A            IRQ = N/A                         │
 * │   SCK = D5 (14)  SCK = D5 (14)   SCK = D5 (14)   SCK = D5 (14)   SCK=D5(14)│
 * │   MOSI= D7 (13)  MOSI= D7 (13)   MOSI= D7 (13)   MOSI= D7 (13)   MOSI=D7(13)│
 * │   MISO= D6 (12)  MISO= D6 (12)   MISO= D6 (12)   MISO= D6 (12)   MISO=D6(12)│
 * └─────────────────────────────────────────────────────────────────┘
 * 
 * All 5 devices share the SPI bus (SCK, MOSI, MISO)
 * Each device has its own unique CS (Chip Select) line
 * RX (GPIO3) and TX (GPIO1) are used as GPIO for CS lines
 * 
 * Generated by Mistral Vibe
 * Date: 2026-08-15
 */

#include "esp8266_expander_ram_tft.h"
#include <SPI.h>

// Math constants
#ifndef PI
#define PI 3.14159265358979323846
#endif

// ============================================================================
// Device Drivers (Simplified Implementations)
// ============================================================================

// SPI SRAM (23LC1024) Driver
class SPISRAM {
    uint8_t csPin;
public:
    SPISRAM(uint8_t cs) : csPin(cs) {
        pinMode(csPin, OUTPUT);
        digitalWrite(csPin, HIGH);
    }
    
    void begin() {
        // SPI already initialized in main
        delay(10);
    }
    
    uint8_t read(uint32_t addr) {
        if (addr >= 131072) return 0;  // 128KB limit
        
        digitalWrite(csPin, LOW);
        SPI.transfer(0x03);  // READ command
        SPI.transfer((addr >> 16) & 0xFF);
        SPI.transfer((addr >> 8) & 0xFF);
        SPI.transfer(addr & 0xFF);
        uint8_t data = SPI.transfer(0);
        digitalWrite(csPin, HIGH);
        return data;
    }
    
    void write(uint32_t addr, uint8_t data) {
        if (addr >= 131072) return;  // 128KB limit
        
        digitalWrite(csPin, LOW);
        SPI.transfer(0x02);  // WRITE command
        SPI.transfer((addr >> 16) & 0xFF);
        SPI.transfer((addr >> 8) & 0xFF);
        SPI.transfer(addr & 0xFF);
        SPI.transfer(data);
        digitalWrite(csPin, HIGH);
        delayMicroseconds(1);  // Wait for write to complete
    }
    
    void readBuffer(uint32_t addr, uint8_t* buffer, size_t length) {
        if (addr + length > 131072) length = 131072 - addr;
        digitalWrite(csPin, LOW);
        SPI.transfer(0x03);
        SPI.transfer((addr >> 16) & 0xFF);
        SPI.transfer((addr >> 8) & 0xFF);
        SPI.transfer(addr & 0xFF);
        for (size_t i = 0; i < length; i++) {
            buffer[i] = SPI.transfer(0);
        }
        digitalWrite(csPin, HIGH);
    }
    
    void writeBuffer(uint32_t addr, const uint8_t* buffer, size_t length) {
        if (addr + length > 131072) length = 131072 - addr;
        digitalWrite(csPin, LOW);
        SPI.transfer(0x02);
        SPI.transfer((addr >> 16) & 0xFF);
        SPI.transfer((addr >> 8) & 0xFF);
        SPI.transfer(addr & 0xFF);
        for (size_t i = 0; i < length; i++) {
            SPI.transfer(buffer[i]);
        }
        digitalWrite(csPin, HIGH);
        delayMicroseconds(length);  // Wait for writes
    }
    
    size_t getSize() const { return 131072; }
};

// MCP23S17 GPIO Expander Driver
class MCP23S17 {
    uint8_t csPin;
    uint8_t irqPin;
public:
    MCP23S17(uint8_t cs, uint8_t irq = 255) : csPin(cs), irqPin(irq) {
        pinMode(csPin, OUTPUT);
        digitalWrite(csPin, HIGH);
        if (irqPin != 255) {
            pinMode(irqPin, INPUT_PULLUP);
        }
    }
    
    void begin() {
        // Initialize MCP23S17
        // Configure I/O direction, pull-ups, etc.
        writeRegister(0x00, 0x0000);  // IODIRA - all outputs
        writeRegister(0x01, 0x0000);  // IODIRB - all outputs
        writeRegister(0x0C, 0x0000);  // GPPUA - no pull-ups
        writeRegister(0x0D, 0x0000);  // GPPUB - no pull-ups
        delay(10);
    }
    
    void pinMode(uint8_t pin, uint8_t mode) {
        uint16_t reg = readRegister(pin < 8 ? 0x00 : 0x01);  // IODIRA or IODIRB
        if (mode == OUTPUT) {
            reg &= ~(1 << (pin % 8));
        } else {
            reg |= (1 << (pin % 8));
        }
        writeRegister(pin < 8 ? 0x00 : 0x01, reg);
    }
    
    void digitalWrite(uint8_t pin, uint8_t value) {
        uint16_t reg = readRegister(pin < 8 ? 0x12 : 0x13);  // GPIOA or GPIOB
        if (value == HIGH) {
            reg |= (1 << (pin % 8));
        } else {
            reg &= ~(1 << (pin % 8));
        }
        writeRegister(pin < 8 ? 0x12 : 0x13, reg);
    }
    
    uint8_t digitalRead(uint8_t pin) {
        uint16_t reg = readRegister(pin < 8 ? 0x12 : 0x13);  // GPIOA or GPIOB
        return (reg >> (pin % 8)) & 0x01;
    }
    
    void pullUp(uint8_t pin, bool enable) {
        uint16_t reg = readRegister(pin < 8 ? 0x0C : 0x0D);  // GPPUA or GPPUB
        if (enable) {
            reg |= (1 << (pin % 8));
        } else {
            reg &= ~(1 << (pin % 8));
        }
        writeRegister(pin < 8 ? 0x0C : 0x0D, reg);
    }
    
    bool getInterrupt() {
        if (irqPin == 255) return false;
        return digitalRead(irqPin) == LOW;
    }
    
private:
    uint16_t readRegister(uint8_t reg) {
        digitalWrite(csPin, LOW);
        SPI.transfer(0x41);  // Read register command
        SPI.transfer(reg);
        uint8_t low = SPI.transfer(0);
        uint8_t high = SPI.transfer(0);
        digitalWrite(csPin, HIGH);
        return (high << 8) | low;
    }
    
    void writeRegister(uint8_t reg, uint16_t value) {
        digitalWrite(csPin, LOW);
        SPI.transfer(0x40);  // Write register command
        SPI.transfer(reg);
        SPI.transfer(value & 0xFF);
        SPI.transfer((value >> 8) & 0xFF);
        digitalWrite(csPin, HIGH);
    }
};

// TFT ST7789 Driver (Simplified)
class TFT_ST7789 {
    uint8_t csPin;
    uint8_t dcPin;
    uint8_t rstPin;
    uint16_t width;
    uint16_t height;
public:
    TFT_ST7789(uint8_t cs, uint8_t dc, uint8_t rst, 
               uint16_t w = 320, uint16_t h = 240)
        : csPin(cs), dcPin(dc), rstPin(rst), width(w), height(h) {
        pinMode(csPin, OUTPUT);
        pinMode(dcPin, OUTPUT);
        if (rstPin != 255) {
            pinMode(rstPin, OUTPUT);
        }
        digitalWrite(csPin, HIGH);
        digitalWrite(dcPin, HIGH);
        if (rstPin != 255) {
            digitalWrite(rstPin, HIGH);
        }
    }
    
    void begin() {
        // Hardware reset
        if (rstPin != 255) {
            digitalWrite(rstPin, LOW);
            delay(10);
            digitalWrite(rstPin, HIGH);
            delay(100);
        }
        
        // Software reset
        sendCommand(0x01);
        delay(150);
        
        // Initialize display
        sendCommand(0x11);  // Sleep out
        delay(250);
        
        sendCommand(0x36);  // Memory Data Access Control
        sendData(0x00);     // Portrait orientation
        
        sendCommand(0x3A);  // COLMOD: Pixel Format Set
        sendData(0x05);     // 16-bit color
        
        sendCommand(0x21);  // Display Inversion On
        
        sendCommand(0x13);  // Normal Display Mode On
        delay(10);
        
        sendCommand(0x29);  // Display On
        delay(100);
        
        fillScreen(0x0000);  // Clear screen
    }
    
    void sendCommand(uint8_t cmd) {
        digitalWrite(csPin, LOW);
        digitalWrite(dcPin, LOW);
        SPI.transfer(cmd);
        digitalWrite(csPin, HIGH);
    }
    
    void sendData(uint8_t data) {
        digitalWrite(csPin, LOW);
        digitalWrite(dcPin, HIGH);
        SPI.transfer(data);
        digitalWrite(csPin, HIGH);
    }
    
    void write16(uint16_t data) {
        sendData(data >> 8);
        sendData(data & 0xFF);
    }
    
    void setAddrWindow(uint16_t x0, uint16_t y0, uint16_t x1, uint16_t y1) {
        sendCommand(0x2A);  // Column Address Set
        write16(x0);
        write16(x1);
        
        sendCommand(0x2B);  // Row Address Set
        write16(y0);
        write16(y1);
        
        sendCommand(0x2C);  // Memory Write
    }
    
    void fillScreen(uint16_t color) {
        setAddrWindow(0, 0, width - 1, height - 1);
        digitalWrite(csPin, LOW);
        digitalWrite(dcPin, HIGH);
        for (uint32_t i = 0; i < (uint32_t)width * height; i++) {
            SPI.transfer(color >> 8);
            SPI.transfer(color & 0xFF);
        }
        digitalWrite(csPin, HIGH);
    }
    
    void drawPixel(int16_t x, int16_t y, uint16_t color) {
        if (x < 0 || x >= width || y < 0 || y >= height) return;
        
        setAddrWindow(x, y, x, y);
        digitalWrite(csPin, LOW);
        digitalWrite(dcPin, HIGH);
        SPI.transfer(color >> 8);
        SPI.transfer(color & 0xFF);
        digitalWrite(csPin, HIGH);
    }
    
    void drawRect(int16_t x, int16_t y, int16_t w, int16_t h, uint16_t color) {
        if (w <= 0 || h <= 0) return;
        
        setAddrWindow(x, y, x + w - 1, y + h - 1);
        digitalWrite(csPin, LOW);
        digitalWrite(dcPin, HIGH);
        for (int32_t i = 0; i < (int32_t)w * h; i++) {
            SPI.transfer(color >> 8);
            SPI.transfer(color & 0xFF);
        }
        digitalWrite(csPin, HIGH);
    }
    
    uint16_t getWidth() const { return width; }
    uint16_t getHeight() const { return height; }
};

// ============================================================================
// Touch XPT2046 Driver
// ============================================================================

class XPT2046_Touch {
    uint8_t csPin;
    uint8_t irqPin;
    uint16_t width;
    uint16_t height;
    bool touched;
    uint16_t touchX;
    uint16_t touchY;
public:
    XPT2046_Touch(uint8_t cs, uint8_t irq = 255, 
                  uint16_t w = 320, uint16_t h = 240)
        : csPin(cs), irqPin(irq), width(w), height(h), touched(false), touchX(0), touchY(0) {
        pinMode(csPin, OUTPUT);
        digitalWrite(csPin, HIGH);
        if (irqPin != 255) {
            pinMode(irqPin, INPUT_PULLUP);
        }
    }
    
    void begin() {
        delay(10);
    }
    
    // Read raw ADC values from touch controller
    uint16_t readRawX() {
        digitalWrite(csPin, LOW);
        SPI.transfer(0xD0);  // Channel Y- on X+ (for X position)
        uint8_t high = SPI.transfer(0);
        uint8_t low = SPI.transfer(0);
        digitalWrite(csPin, HIGH);
        return ((high << 8) | low) >> 3;  // 12-bit value
    }
    
    uint16_t readRawY() {
        digitalWrite(csPin, LOW);
        SPI.transfer(0x90);  // Channel X+ on Y- (for Y position)
        uint8_t high = SPI.transfer(0);
        uint8_t low = SPI.transfer(0);
        digitalWrite(csPin, HIGH);
        return ((high << 8) | low) >> 3;  // 12-bit value
    }
    
    // Check if touch is detected (using pen-down bit)
    bool isTouched() {
        digitalWrite(csPin, LOW);
        SPI.transfer(0xB0);  // Read Z1 and Z2 for touch detection
        uint8_t high = SPI.transfer(0);
        uint8_t low = SPI.transfer(0);
        digitalWrite(csPin, HIGH);
        
        // Check if touch is detected (pen-down bit in Z measurement)
        return ((high << 8) | low) > 0;
    }
    
    // Read calibrated touch coordinates
    bool getTouchPoint(uint16_t* x, uint16_t* y) {
        if (!isTouched()) {
            touched = false;
            return false;
        }
        
        // Read multiple samples and average
        uint32_t sumX = 0, sumY = 0;
        const int samples = 5;
        
        for (int i = 0; i < samples; i++) {
            sumX += readRawY();  // Note: X and Y are swapped in raw reading
            sumY += readRawX();
            delayMicroseconds(10);
        }
        
        // Calculate averages
        uint16_t rawX = sumY / samples;
        uint16_t rawY = sumX / samples;
        
        // Simple calibration - flip Y axis for TFT coordinate system
        touchX = (uint16_t)map(rawX, 0, 4095, 0, width - 1);
        touchY = (uint16_t)map(rawY, 0, 4095, height - 1, 0);
        
        *x = touchX;
        *y = touchY;
        touched = true;
        return true;
    }
    
    uint16_t getX() const { return touchX; }
    uint16_t getY() const { return touchY; }
    bool wasTouched() const { return touched; }
};

// ============================================================================
// SD Card Driver (SPI mode)
// ============================================================================

class SDCard {
    uint8_t csPin;
public:
    SDCard(uint8_t cs) : csPin(cs) {
        pinMode(csPin, OUTPUT);
        digitalWrite(csPin, HIGH);
    }
    
    void begin() {
        delay(10);
        // In a real implementation, this would initialize the SD card
        // using libraries like SdFat or SD.h
    }
    
    // Check if SD card is present
    bool isPresent() {
        // Simple check - try to send a command
        digitalWrite(csPin, LOW);
        // Send CMD0 (GO_IDLE_STATE)
        SPI.transfer(0x40);
        SPI.transfer(0x00);
        SPI.transfer(0x00);
        SPI.transfer(0x00);
        SPI.transfer(0x00);
        SPI.transfer(0x95);  // CRC
        
        // Wait for response (should be 0x01 for idle state)
        for (int i = 0; i < 10; i++) {
            uint8_t response = SPI.transfer(0xFF);
            digitalWrite(csPin, HIGH);
            if (response == 0x01) {
                return true;
            }
            delay(1);
            digitalWrite(csPin, LOW);
            SPI.transfer(0xFF);
        }
        digitalWrite(csPin, HIGH);
        return false;
    }
    
    // Read a sector (512 bytes)
    bool readSector(uint32_t sector, uint8_t* buffer) {
        if (!buffer) return false;
        
        digitalWrite(csPin, LOW);
        
        // Send CMD17 (READ_SINGLE_BLOCK)
        SPI.transfer(0x51);
        SPI.transfer((sector >> 24) & 0xFF);
        SPI.transfer((sector >> 16) & 0xFF);
        SPI.transfer((sector >> 8) & 0xFF);
        SPI.transfer(sector & 0xFF);
        SPI.transfer(0xFF);  // CRC (ignored)
        
        // Wait for response (0x00 = success)
        for (int i = 0; i < 100; i++) {
            uint8_t response = SPI.transfer(0xFF);
            if (response == 0x00) break;
            if (response != 0xFF) {
                digitalWrite(csPin, HIGH);
                return false;
            }
        }
        
        // Wait for start token (0xFE)
        for (int i = 0; i < 100; i++) {
            uint8_t token = SPI.transfer(0xFF);
            if (token == 0xFE) break;
            if (token != 0xFF) {
                digitalWrite(csPin, HIGH);
                return false;
            }
        }
        
        // Read 512 bytes
        for (int i = 0; i < 512; i++) {
            buffer[i] = SPI.transfer(0xFF);
        }
        
        // Read CRC (ignored)
        SPI.transfer(0xFF);
        SPI.transfer(0xFF);
        
        digitalWrite(csPin, HIGH);
        return true;
    }
    
    // Write a sector (512 bytes)
    bool writeSector(uint32_t sector, const uint8_t* buffer) {
        if (!buffer) return false;
        
        digitalWrite(csPin, LOW);
        
        // Send CMD24 (WRITE_BLOCK)
        SPI.transfer(0x58);
        SPI.transfer((sector >> 24) & 0xFF);
        SPI.transfer((sector >> 16) & 0xFF);
        SPI.transfer((sector >> 8) & 0xFF);
        SPI.transfer(sector & 0xFF);
        SPI.transfer(0xFF);  // CRC (ignored)
        
        // Wait for response
        for (int i = 0; i < 100; i++) {
            uint8_t response = SPI.transfer(0xFF);
            if (response == 0x00) break;
            if (response != 0xFF) {
                digitalWrite(csPin, HIGH);
                return false;
            }
        }
        
        // Send start token
        SPI.transfer(0xFE);
        
        // Write 512 bytes
        for (int i = 0; i < 512; i++) {
            SPI.transfer(buffer[i]);
        }
        
        // Send dummy CRC
        SPI.transfer(0xFF);
        SPI.transfer(0xFF);
        
        // Wait for write complete
        for (int i = 0; i < 100; i++) {
            uint8_t status = SPI.transfer(0xFF);
            if ((status & 0x1F) == 0x05) break;  // Data accepted
            if ((status & 0x1F) != 0x00) {
                digitalWrite(csPin, HIGH);
                return false;
            }
        }
        
        // Wait for write to complete (busy check)
        while (SPI.transfer(0xFF) == 0x00) {
            delay(1);
        }
        
        digitalWrite(csPin, HIGH);
        return true;
    }
    
    uint8_t getCSPin() const { return csPin; }
};

// ============================================================================
// Configuration Definitions
// ============================================================================

// Union-based config definition
const guikit_hw_config_union_t ESP8266_EXPANDER_RAM_TFT_CONFIG = {
    .is_esp8266 = true,
    .is_esp32 = false,
    
    .bank_count = 5,
    .banks = {
        // 1. 23LC1024 SRAM (128KB) on CS=TX (GPIO1)
        {
            .device_type = GUIKIT_DEVICE_RAM_SRAM,
            .enabled = true,
            .config.ram = {
                .type = GUIKIT_RAM_SRAM,
                .size = 131072,  // 128KB
                .cs_pin = SRAM_CS_PIN
            },
            .name = "External SRAM"
        },
        
        // 2. MCP23S17 GPIO Expander on CS=RX (GPIO3)
        {
            .device_type = GUIKIT_DEVICE_SPI_EXPANDER,
            .enabled = true,
            .config.spi_expander = {
                .type = GUIKIT_EXPANDER_MCP23S17,
                .cs_pin = EXPANDER_CS_PIN,
                .irq_pin = EXPANDER_IRQ_PIN,
                .reset_pin = 255  // Not used
            },
            .name = "GPIO Expander"
        },
        
        // 3. TFT Display on CS=D8 (GPIO15)
        {
            .device_type = GUIKIT_DEVICE_TFT,
            .enabled = true,
            .config.spi_device = {
                .type = GUIKIT_DEVICE_TFT,
                .cs_pin = TFT_CS_PIN,
                .irq_pin = 255,  // Not used
                .speed_mhz = SPI_MAX_SPEED_MHZ
            },
            .name = "TFT Display"
        },
        
        // 4. XPT2046 Touch Controller on CS=D2 (GPIO4)
        {
            .device_type = GUIKIT_DEVICE_TOUCH,
            .enabled = true,
            .config.spi_device = {
                .type = GUIKIT_DEVICE_TOUCH,
                .cs_pin = TOUCH_CS_PIN,
                .irq_pin = TOUCH_IRQ_PIN,
                .speed_mhz = SPI_MAX_SPEED_MHZ
            },
            .name = "Touch Panel"
        },
        
        // 5. SD Card on CS=D0 (GPIO16)
        {
            .device_type = GUIKIT_DEVICE_SD_CARD,
            .enabled = true,
            .config.spi_device = {
                .type = GUIKIT_DEVICE_SD_CARD,
                .cs_pin = SD_CS_PIN,
                .irq_pin = 255,  // Not used
                .speed_mhz = SPI_MAX_SPEED_MHZ
            },
            .name = "SD Card"
        }
    },
    
    .sck_pin = SPI_SCK_PIN,
    .mosi_pin = SPI_MOSI_PIN,
    .miso_pin = SPI_MISO_PIN,
    .max_speed_mhz = SPI_MAX_SPEED_MHZ,
    
    .display = {
        .width = 320,
        .height = 240,
        .color_depth = 4,  // 4bpp = 16 colors
        .double_buffer = false
    },
    
    .use_sd_card = true,
    .use_webdav = false,
    .debug_mode = true
};

// Simple config definition
const guikit_hw_config_t ESP8266_EXPANDER_RAM_TFT_CONFIG_SIMPLE = {
    .is_esp8266 = true,
    .is_esp32 = false,
    
    .ram = {
        .internal = true,
        .bank_count = 1,
        .bank = {
            {GUIKIT_RAM_SRAM, 131072, SRAM_CS_PIN, true}
        }
    },
    
    .spi = {
        .expander = true,
        .bank_count = 5,
        .bank = {
            {GUIKIT_SPI_DEVICE, GUIKIT_EXPANDER_NONE, TFT_CS_PIN, 255, true},        // TFT
            {GUIKIT_SPI_DEVICE, GUIKIT_EXPANDER_NONE, TOUCH_CS_PIN, TOUCH_IRQ_PIN, true}, // Touch
            {GUIKIT_SPI_DEVICE, GUIKIT_EXPANDER_NONE, SD_CS_PIN, 255, true},       // SD Card
            {GUIKIT_SPI_EXPANDER, GUIKIT_EXPANDER_MCP23S17, EXPANDER_CS_PIN, EXPANDER_IRQ_PIN, true}, // Expander
            {GUIKIT_SPI_DEVICE, GUIKIT_EXPANDER_NONE, SRAM_CS_PIN, 255, true}    // SRAM as SPI device
        },
        .sck_pin = SPI_SCK_PIN,
        .mosi_pin = SPI_MOSI_PIN,
        .miso_pin = SPI_MISO_PIN,
        .max_speed_mhz = SPI_MAX_SPEED_MHZ,
        .shared_bus = true
    },
    
    .display = {320, 240, 4, false},
    .use_sd_card = true,
    .use_webdav = false,
    .debug_mode = true
};

// Individual configs
const tft_config_t ESP8266_TFT_CONFIG = {
    .cs_pin = TFT_CS_PIN,
    .dc_pin = TFT_DC_PIN,
    .rst_pin = TFT_RST_PIN,
    .width = 320,
    .height = 240,
    .color_depth = 4,
    .double_buffer = false
};

const sram_config_t ESP8266_SRAM_CONFIG = {
    .cs_pin = SRAM_CS_PIN,
    .size_bytes = 131072,  // 128KB
    .spi_bus = 0
};

const expander_config_t ESP8266_EXPANDER_CONFIG = {
    .cs_pin = EXPANDER_CS_PIN,
    .irq_pin = EXPANDER_IRQ_PIN,
    .reset_pin = 255,  // Not used
    .gpio_count = 16    // MCP23S17 has 16 GPIO pins
};

const touch_config_t ESP8266_TOUCH_CONFIG = {
    .cs_pin = TOUCH_CS_PIN,
    .irq_pin = TOUCH_IRQ_PIN,
    .width = 320,
    .height = 240,
    .swap_xy = false,
    .flip_x = false,
    .flip_y = true   // Flip Y to match TFT coordinate system
};

const sdcard_config_t ESP8266_SDCARD_CONFIG = {
    .cs_pin = SD_CS_PIN,
    .cd_pin = 255,  // Not used
    .use_dma = false  // ESP8266 doesn't have DMA for SPI
};

const esp8266_hardware_config_t ESP8266_FULL_CONFIG = {
    .tft = ESP8266_TFT_CONFIG,
    .sram = ESP8266_SRAM_CONFIG,
    .expander = ESP8266_EXPANDER_CONFIG,
    .touch = ESP8266_TOUCH_CONFIG,
    .sdcard = ESP8266_SDCARD_CONFIG,
    
    .sck_pin = SPI_SCK_PIN,
    .mosi_pin = SPI_MOSI_PIN,
    .miso_pin = SPI_MISO_PIN,
    .max_speed_mhz = SPI_MAX_SPEED_MHZ,
    
    .use_sd_card = true,
    .use_webdav = false,
    .debug_mode = true
};

// ============================================================================
// Hardware Initialization
// ============================================================================

// Global device instances
SPISRAM* sram = nullptr;
MCP23S17* expander = nullptr;
TFT_ST7789* tft = nullptr;
XPT2046_Touch* touch = nullptr;
SDCard* sdcard = nullptr;

/**
 * Initialize all hardware devices from the union-based configuration
 */
void initHardwareFromUnionConfig() {
    Serial.println("Initializing hardware from union config...");
    
    // Initialize SPI bus first
    SPI.begin();
    SPI.setFrequency(ESP8266_EXPANDER_RAM_TFT_CONFIG.max_speed_mhz * 1000000);
    SPI.setDataMode(SPI_MODE0);
    Serial.println("SPI bus initialized");
    
    // Initialize each device based on its type
    for (int i = 0; i < ESP8266_EXPANDER_RAM_TFT_CONFIG.bank_count; i++) {
        const guikit_device_bank_t* bank = &ESP8266_EXPANDER_RAM_TFT_CONFIG.banks[i];
        
        if (GUIKIT_BANK_IS_RAM(*bank)) {
            const guikit_ram_config_t* ram = guikit_bank_get_ram(bank);
            sram = new SPISRAM(ram->cs_pin);
            sram->begin();
            Serial.print("  SRAM initialized on CS=");
            Serial.print(ram->cs_pin);
            Serial.print(", Size: ");
            Serial.print(ram->size / 1024);
            Serial.println(" KB");
        }
        else if (GUIKIT_BANK_IS_SPI_EXPANDER(*bank)) {
            const guikit_spi_expander_config_t* exp = guikit_bank_get_spi_expander(bank);
            expander = new MCP23S17(exp->cs_pin, exp->irq_pin);
            expander->begin();
            Serial.print("  MCP23S17 initialized on CS=");
            Serial.println(exp->cs_pin);
        }
        else if (GUIKIT_BANK_IS_SPI_DEVICE(*bank)) {
            const guikit_spi_device_config_t* dev = guikit_bank_get_spi_device(bank);
            if (dev->type == GUIKIT_DEVICE_TFT) {
                tft = new TFT_ST7789(dev->cs_pin, TFT_DC_PIN, TFT_RST_PIN);
                tft->begin();
                Serial.print("  TFT initialized on CS=");
                Serial.println(dev->cs_pin);
            }
            else if (dev->type == GUIKIT_DEVICE_TOUCH) {
                touch = new XPT2046_Touch(dev->cs_pin, dev->irq_pin);
                touch->begin();
                Serial.print("  Touch initialized on CS=");
                Serial.println(dev->cs_pin);
            }
            else if (dev->type == GUIKIT_DEVICE_SD_CARD) {
                sdcard = new SDCard(dev->cs_pin);
                sdcard->begin();
                if (sdcard->isPresent()) {
                    Serial.print("  SD Card initialized on CS=");
                    Serial.println(dev->cs_pin);
                } else {
                    Serial.print("  SD Card NOT found on CS=");
                    Serial.println(dev->cs_pin);
                    delete sdcard;
                    sdcard = nullptr;
                }
            }
        }
    }
    
    Serial.println("All hardware initialized successfully");
}

/**
 * Initialize all hardware devices from the simple configuration
 */
void initHardwareFromSimpleConfig() {
    Serial.println("Initializing hardware from simple config...");
    
    // Initialize SPI bus
    SPI.begin();
    SPI.setFrequency(ESP8266_EXPANDER_RAM_TFT_CONFIG_SIMPLE.spi.max_speed_mhz * 1000000);
    SPI.setDataMode(SPI_MODE0);
    
    // Initialize SRAM from RAM config
    if (ESP8266_EXPANDER_RAM_TFT_CONFIG_SIMPLE.ram.bank_count > 0) {
        sram = new SPISRAM(ESP8266_EXPANDER_RAM_TFT_CONFIG_SIMPLE.ram.bank[0].cs_pin);
        sram->begin();
        Serial.print("  SRAM initialized on CS=");
        Serial.println(ESP8266_EXPANDER_RAM_TFT_CONFIG_SIMPLE.ram.bank[0].cs_pin);
    }
    
    // Initialize TFT, Touch, SD Card and Expander from SPI config
    for (int i = 0; i < ESP8266_EXPANDER_RAM_TFT_CONFIG_SIMPLE.spi.bank_count; i++) {
        const guikit_spi_bank_t* bank = &ESP8266_EXPANDER_RAM_TFT_CONFIG_SIMPLE.spi.bank[i];
        
        if (bank->type == GUIKIT_SPI_DEVICE) {
            if (bank->cs_pin == TFT_CS_PIN) {
                tft = new TFT_ST7789(bank->cs_pin, TFT_DC_PIN, TFT_RST_PIN);
                tft->begin();
                Serial.print("  TFT initialized on CS=");
                Serial.println(bank->cs_pin);
            }
            else if (bank->cs_pin == TOUCH_CS_PIN) {
                touch = new XPT2046_Touch(bank->cs_pin, bank->irq_pin);
                touch->begin();
                Serial.print("  Touch initialized on CS=");
                Serial.println(bank->cs_pin);
            }
            else if (bank->cs_pin == SD_CS_PIN) {
                sdcard = new SDCard(bank->cs_pin);
                sdcard->begin();
                if (sdcard->isPresent()) {
                    Serial.print("  SD Card initialized on CS=");
                    Serial.println(bank->cs_pin);
                } else {
                    Serial.print("  SD Card NOT found on CS=");
                    Serial.println(bank->cs_pin);
                    delete sdcard;
                    sdcard = nullptr;
                }
            }
        }
        else if (bank->type == GUIKIT_SPI_EXPANDER) {
            expander = new MCP23S17(bank->cs_pin, bank->irq_pin);
            expander->begin();
            Serial.print("  MCP23S17 initialized on CS=");
            Serial.println(bank->cs_pin);
        }
    }
    
    Serial.println("All hardware initialized successfully");
}

/**
 * Initialize using individual configurations
 */
void initHardwareFromIndividualConfigs() {
    Serial.println("Initializing hardware from individual configs...");
    
    // Initialize SPI bus
    SPI.begin();
    SPI.setFrequency(ESP8266_FULL_CONFIG.max_speed_mhz * 1000000);
    SPI.setDataMode(SPI_MODE0);
    
    // Initialize SRAM
    sram = new SPISRAM(ESP8266_FULL_CONFIG.sram.cs_pin);
    sram->begin();
    Serial.print("  SRAM initialized on CS=");
    Serial.println(ESP8266_FULL_CONFIG.sram.cs_pin);
    
    // Initialize TFT
    tft = new TFT_ST7789(
        ESP8266_FULL_CONFIG.tft.cs_pin,
        ESP8266_FULL_CONFIG.tft.dc_pin,
        ESP8266_FULL_CONFIG.tft.rst_pin
    );
    tft->begin();
    Serial.print("  TFT initialized on CS=");
    Serial.println(ESP8266_FULL_CONFIG.tft.cs_pin);
    
    // Initialize Expander
    expander = new MCP23S17(
        ESP8266_FULL_CONFIG.expander.cs_pin,
        ESP8266_FULL_CONFIG.expander.irq_pin
    );
    expander->begin();
    Serial.print("  MCP23S17 initialized on CS=");
    Serial.println(ESP8266_FULL_CONFIG.expander.cs_pin);
    
    // Initialize Touch
    touch = new XPT2046_Touch(
        ESP8266_FULL_CONFIG.touch.cs_pin,
        ESP8266_FULL_CONFIG.touch.irq_pin,
        ESP8266_FULL_CONFIG.touch.width,
        ESP8266_FULL_CONFIG.touch.height
    );
    touch->begin();
    Serial.print("  Touch initialized on CS=");
    Serial.println(ESP8266_FULL_CONFIG.touch.cs_pin);
    
    // Initialize SD Card
    sdcard = new SDCard(ESP8266_FULL_CONFIG.sdcard.cs_pin);
    sdcard->begin();
    if (sdcard->isPresent()) {
        Serial.print("  SD Card initialized on CS=");
        Serial.println(ESP8266_FULL_CONFIG.sdcard.cs_pin);
    } else {
        Serial.print("  SD Card NOT found on CS=");
        Serial.println(ESP8266_FULL_CONFIG.sdcard.cs_pin);
        delete sdcard;
        sdcard = nullptr;
    }
    
    Serial.println("All hardware initialized successfully");
}

// ============================================================================
// Hardware Test Functions
// ============================================================================

/**
 * Test all initialized hardware
 */
void testHardware() {
    if (sram) {
        Serial.println("Testing SRAM...");
        // Write test pattern
        sram->write(0, 0xAA);
        sram->write(1, 0x55);
        sram->write(2, 0x0F);
        sram->write(3, 0xF0);
        
        // Read back and verify
        if (sram->read(0) == 0xAA &&
            sram->read(1) == 0x55 &&
            sram->read(2) == 0x0F &&
            sram->read(3) == 0xF0) {
            Serial.println("  SRAM test: PASS");
        } else {
            Serial.println("  SRAM test: FAIL");
        }
    }
    
    if (expander) {
        Serial.println("Testing MCP23S17...");
        // Configure pin 0 as output
        expander->pinMode(0, OUTPUT);
        
        // Test writing HIGH
        expander->digitalWrite(0, HIGH);
        if (expander->digitalRead(0) == HIGH) {
            Serial.println("  Expander pin 0 write HIGH: PASS");
        } else {
            Serial.println("  Expander pin 0 write HIGH: FAIL");
        }
        
        // Test writing LOW
        expander->digitalWrite(0, LOW);
        if (expander->digitalRead(0) == LOW) {
            Serial.println("  Expander pin 0 write LOW: PASS");
        } else {
            Serial.println("  Expander pin 0 write LOW: FAIL");
        }
        
        // Configure pin 1 as input with pull-up
        expander->pinMode(1, INPUT);
        expander->pullUp(1, true);
        delay(1);
        if (expander->digitalRead(1) == HIGH) {
            Serial.println("  Expander pin 1 pull-up: PASS");
        } else {
            Serial.println("  Expander pin 1 pull-up: FAIL");
        }
    }
    
    if (touch) {
        Serial.println("Testing Touch Panel...");
        uint16_t x, y;
        if (touch->getTouchPoint(&x, &y)) {
            Serial.print("  Touch detected at: (");
            Serial.print(x);
            Serial.print(", ");
            Serial.print(y);
            Serial.println(") PASS");
        } else {
            Serial.println("  No touch detected (expected if not touching) - PASS");
        }
    }
    
    if (sdcard) {
        Serial.println("Testing SD Card...");
        uint8_t testBuffer[512] = {0};
        if (sdcard->readSector(0, testBuffer)) {
            Serial.println("  SD Card read sector 0: PASS");
        } else {
            Serial.println("  SD Card read sector 0: FAIL (card may not be formatted)");
        }
    }
    
    if (tft) {
        Serial.println("Testing TFT...");
        
        // Clear screen
        tft->fillScreen(0x0000);
        
        // Draw colored rectangles
        tft->drawRect(0, 0, 40, 40, 0xF800);    // Red
        tft->drawRect(40, 0, 40, 40, 0x07E0);   // Green
        tft->drawRect(80, 0, 40, 40, 0x001F);   // Blue
        
        // Draw a pixel
        tft->drawPixel(120, 20, 0xFFFF);       // White
        
        Serial.println("  TFT test: PASS (visual check required)");
    }
}

// ============================================================================
// Memory Management Example
// ============================================================================

// Framebuffer in external SRAM
#define FRAMEBUFFER_ADDR 0
#define FRAMEBUFFER_SIZE (320 * 240 * 4 / 8)  // 4bpp: 37.5 KB

/**
 * Draw to framebuffer in SRAM, then flush to TFT
 */
void drawFramebufferToTFT() {
    if (!sram || !tft) return;
    
    // For demonstration, just clear the framebuffer in SRAM
    uint8_t clearBuffer[FRAMEBUFFER_SIZE] = {0};
    sram->writeBuffer(FRAMEBUFFER_ADDR, clearBuffer, FRAMEBUFFER_SIZE);
    
    // In a real implementation, you would:
    // 1. Render to framebuffer in SRAM
    // 2. Read from SRAM and write to TFT
    // For now, just clear the TFT directly
    tft->fillScreen(0x0000);
}

/**
 * Store data in external SRAM
 */
void storeInSRAM(uint32_t addr, const uint8_t* data, size_t length) {
    if (sram && addr + length <= sram->getSize()) {
        sram->writeBuffer(addr, data, length);
    }
}

/**
 * Retrieve data from external SRAM
 */
void retrieveFromSRAM(uint32_t addr, uint8_t* buffer, size_t length) {
    if (sram && addr + length <= sram->getSize()) {
        sram->readBuffer(addr, buffer, length);
    }
}

// ============================================================================
// GPIO Expander Usage Example
// ============================================================================

/**
 * Example: Use expander GPIO for buttons
 */
void setupExpanderGPIO() {
    if (!expander) return;
    
    // Configure pins 0-7 as inputs with pull-ups (buttons)
    for (int i = 0; i < 8; i++) {
        expander->pinMode(i, INPUT);
        expander->pullUp(i, true);
    }
    
    // Configure pins 8-15 as outputs (LEDs)
    for (int i = 8; i < 16; i++) {
        expander->pinMode(i, OUTPUT);
        expander->digitalWrite(i, LOW);
    }
}

/**
 * Read button states from expander
 */
uint16_t readExpanderButtons() {
    if (!expander) return 0;
    
    uint16_t buttons = 0;
    for (int i = 0; i < 8; i++) {
        if (expander->digitalRead(i) == LOW) {  // Pressed (pull-up)
            buttons |= (1 << i);
        }
    }
    return buttons;
}

/**
 * Set LED states on expander
 */
void setExpanderLEDs(uint16_t ledStates) {
    if (!expander) return;
    
    for (int i = 8; i < 16; i++) {
        expander->digitalWrite(i, (ledStates >> (i - 8)) & 0x01);
    }
}

// ============================================================================
// Main Setup and Loop
// ============================================================================

void setup() {
    Serial.begin(115200);
    while (!Serial);
    
    Serial.println("ESP8266 + MCP23S17 + 23LC1024 + TFT + Touch + SD Card Example");
    Serial.println("==============================================================");
    
    // Choose one initialization method:
    initHardwareFromUnionConfig();
    // initHardwareFromSimpleConfig();
    // initHardwareFromIndividualConfigs();
    
    // Run hardware tests
    testHardware();
    
    // Setup expander GPIO
    setupExpanderGPIO();
    
    // Clear TFT
    if (tft) {
        tft->fillScreen(0x0000);
    }
    
    Serial.println("\nSetup complete!");
}

void loop() {
    static uint8_t ledState = 0;
    static int x = 0;
    
    // Read buttons
    uint16_t buttons = readExpanderButtons();
    if (buttons != 0) {
        Serial.print("Buttons pressed: 0x");
        Serial.println(buttons, HEX);
        
        // Toggle LEDs based on button press
        ledState ^= 0xFF;
        setExpanderLEDs(ledState);
    }
    
    // Check for touch
    if (touch) {
        uint16_t touchX, touchY;
        if (touch->getTouchPoint(&touchX, &touchY)) {
            Serial.print("Touch at: (");
            Serial.print(touchX);
            Serial.print(", ");
            Serial.print(touchY);
            Serial.println(")");
            
            // Draw a small circle at touch position
            if (tft) {
                for (int r = 0; r < 5; r++) {
                    for (int a = 0; a < 360; a += 15) {
                        float rad = a * PI / 180.0;
                        int px = touchX + (int)(r * cos(rad));
                        int py = touchY + (int)(r * sin(rad));
                        if (px >= 0 && px < tft->getWidth() && py >= 0 && py < tft->getHeight()) {
                            tft->drawPixel(px, py, 0xFFFF);
                        }
                    }
                }
            }
        }
    }
    
    // Simple animation
    if (tft) {
        tft->drawPixel(x, 100, 0xF800);  // Red dot
        x++;
        if (x >= tft->getWidth()) x = 0;
    }
    
    delay(10);
}
