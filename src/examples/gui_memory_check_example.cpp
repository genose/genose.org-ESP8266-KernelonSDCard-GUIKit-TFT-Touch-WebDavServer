/**
 * GUIKit Memory Check Example
 * 
 * Demonstrates how to check if a GUI JSON can fit in memory
 * and display an error on TFT if it cannot
 * 
 * Usage:
 * 1. Call gui_memory_checker_init() in setup()
 * 2. Use gui_memory_calculate_from_json() or gui_memory_calculate_from_file()
 *    to check memory requirements
 * 3. Use gui_loader_load_with_memory_check() to load with automatic checking
 * 4. If memory check fails, an error message is displayed on TFT
 * 
 * Generated by Mistral Vibe
 * Date: 2026-08-15
 */

#include "SPI.h"
#include "gui_memory_checker.h"
#include "gui_loader_memory_safe.h"
#include "widget_pool.h"

// Global TFT instance (from esp8266_expander_ram_tft.cpp)
extern TFT_ST7789* tft;

// ============================================================================
// Example 1: Check a GUI JSON string before loading
// ============================================================================

const char* simple_gui_json = R"({
    "version": "1.0",
    "name": "Simple GUI",
    "size": {"width": 320, "height": 240},
    "background": "#000000",
    "widgets": [
        {
            "id": "title",
            "type": "label",
            "text": "Hello World",
            "x": 10, "y": 10, "width": 300, "height": 30,
            "style": {"fg_color": "#FFFFFF", "font_size": 20, "text_align": "center"}
        },
        {
            "id": "start_btn",
            "type": "button",
            "text": "Start",
            "x": 100, "y": 60, "width": 120, "height": 40,
            "style": {"bg_color": "#008000", "fg_color": "#FFFFFF"},
            "on_click": "handle_start"
        }
    ]
})";

const char* complex_gui_json = R"({
    "version": "1.0",
    "name": "Complex GUI",
    "size": {"width": 320, "height": 240},
    "background": "#000000",
    "widgets": [
        {
            "id": "main_view",
            "type": "view",
            "x": 0, "y": 0, "width": 320, "height": 240,
            "children": [
                {"id": "label1", "type": "label", "text": "Label 1", "x": 10, "y": 10, "width": 100, "height": 20},
                {"id": "label2", "type": "label", "text": "Label 2", "x": 10, "y": 35, "width": 100, "height": 20},
                {"id": "label3", "type": "label", "text": "Label 3", "x": 10, "y": 60, "width": 100, "height": 20},
                {"id": "label4", "type": "label", "text": "Label 4", "x": 10, "y": 85, "width": 100, "height": 20},
                {"id": "label5", "type": "label", "text": "Label 5", "x": 10, "y": 110, "width": 100, "height": 20},
                {"id": "btn1", "type": "button", "text": "Button 1", "x": 120, "y": 10, "width": 80, "height": 25},
                {"id": "btn2", "type": "button", "text": "Button 2", "x": 120, "y": 40, "width": 80, "height": 25},
                {"id": "btn3", "type": "button", "text": "Button 3", "x": 120, "y": 70, "width": 80, "height": 25},
                {"id": "btn4", "type": "button", "text": "Button 4", "x": 120, "y": 100, "width": 80, "height": 25},
                {"id": "slider1", "type": "slider", "x": 10, "y": 140, "width": 200, "height": 20, "min_value": 0, "max_value": 100, "value": 50},
                {"id": "slider2", "type": "slider", "x": 10, "y": 170, "width": 200, "height": 20, "min_value": 0, "max_value": 100, "value": 50},
                {"id": "input1", "type": "text_input", "text": "", "x": 10, "y": 200, "width": 200, "height": 24, "max_length": 50}
            ]
        }
    ]
})";

void example_check_gui_json() {
    Serial.println("=== Example 1: Check GUI JSON Memory ===");
    
    // Check simple GUI
    GuiMemoryStats simple_stats = gui_memory_calculate_from_json(simple_gui_json);
    Serial.print("Simple GUI - Widgets: ");
    Serial.print(simple_stats.widget_count);
    Serial.print(", Memory: ");
    Serial.print(gui_memory_format_size(simple_stats.total_memory_bytes));
    Serial.print(", Fits: ");
    Serial.println(simple_stats.fits_in_memory ? "YES" : "NO");
    
    // Check complex GUI
    GuiMemoryStats complex_stats = gui_memory_calculate_from_json(complex_gui_json);
    Serial.print("Complex GUI - Widgets: ");
    Serial.print(complex_stats.widget_count);
    Serial.print(", Memory: ");
    Serial.print(gui_memory_format_size(complex_stats.total_memory_bytes));
    Serial.print(", Fits: ");
    Serial.println(complex_stats.fits_in_memory ? "YES" : "NO");
}

// ============================================================================
// Example 2: Load GUI with memory checking
// ============================================================================

void example_load_gui_with_check() {
    Serial.println("\n=== Example 2: Load GUI with Memory Check ===");
    
    // Try to load simple GUI
    Serial.println("Loading simple GUI...");
    void* simple_gui = gui_loader_load_with_memory_check(simple_gui_json, tft);
    
    if (simple_gui) {
        Serial.println("Simple GUI loaded successfully!");
        // Use the GUI...
        // When done: free(simple_gui); or use SAFE_RELEASE
    } else {
        Serial.println("Simple GUI failed to load (memory check failed)");
    }
    
    // Try to load complex GUI
    Serial.println("\nLoading complex GUI...");
    void* complex_gui = gui_loader_load_with_memory_check(complex_gui_json, tft);
    
    if (complex_gui) {
        Serial.println("Complex GUI loaded successfully!");
        // Use the GUI...
    } else {
        Serial.println("Complex GUI failed to load (memory check failed)");
    }
}

// ============================================================================
// Example 3: Check current memory usage
// ============================================================================

void example_check_current_memory() {
    Serial.println("\n=== Example 3: Current Memory Usage ===");
    
    GuiMemoryStats current = gui_memory_get_current_usage();
    Serial.print("Currently allocated - Buttons: ");
    Serial.print(current.button_count);
    Serial.print(", Labels: ");
    Serial.print(current.label_count);
    Serial.print(", Sliders: ");
    Serial.print(current.slider_count);
    Serial.print(", Views: ");
    Serial.print(current.view_count);
    Serial.print(", Total Memory: ");
    Serial.println(gui_memory_format_size(current.total_memory_bytes));
}

// ============================================================================
// Example 4: Load from SD card with memory check
// ============================================================================

void example_load_from_sd() {
    Serial.println("\n=== Example 4: Load from SD Card with Memory Check ===");
    
    // Try to load a GUI from SD card
    void* gui = gui_loader_load_sd_with_memory_check("main_gui.json", tft);
    
    if (gui) {
        Serial.println("GUI loaded from SD card successfully!");
        // Use the GUI...
    } else {
        Serial.println("GUI failed to load from SD card (memory check or file not found)");
    }
}

// ============================================================================
// Example 5: Create a GUI that exceeds memory
// ============================================================================

const char* huge_gui_json = R"({
    "version": "1.0",
    "name": "Huge GUI",
    "size": {"width": 320, "height": 240},
    "background": "#000000",
    "widgets": [
)" 
"R"(
        // 100 labels
)" 
"R"(
        {"id": "l0", "type": "label", "text": "Label 0", "x": 0, "y": 0, "width": 50, "height": 20},
        {"id": "l1", "type": "label", "text": "Label 1", "x": 60, "y": 0, "width": 50, "height": 20},
        {"id": "l2", "type": "label", "text": "Label 2", "x": 120, "y": 0, "width": 50, "height": 20},
        {"id": "l3", "type": "label", "text": "Label 3", "x": 180, "y": 0, "width": 50, "height": 20},
        {"id": "l4", "type": "label", "text": "Label 4", "x": 240, "y": 0, "width": 50, "height": 20},
        {"id": "l5", "type": "label", "text": "Label 5", "x": 0, "y": 25, "width": 50, "height": 20},
        {"id": "l6", "type": "label", "text": "Label 6", "x": 60, "y": 25, "width": 50, "height": 20},
        {"id": "l7", "type": "label", "text": "Label 7", "x": 120, "y": 25, "width": 50, "height": 20},
        {"id": "l8", "type": "label", "text": "Label 8", "x": 180, "y": 25, "width": 50, "height": 20},
        {"id": "l9", "type": "label", "text": "Label 9", "x": 240, "y": 25, "width": 50, "height": 20},
        // Add 90 more labels to exceed pool capacity
        {"id": "l10", "type": "label", "text": "L10", "x": 0, "y": 50, "width": 50, "height": 20},
        {"id": "l11", "type": "label", "text": "L11", "x": 60, "y": 50, "width": 50, "height": 20},
        {"id": "l12", "type": "label", "text": "L12", "x": 120, "y": 50, "width": 50, "height": 20},
        {"id": "l13", "type": "label", "text": "L13", "x": 180, "y": 50, "width": 50, "height": 20},
        {"id": "l14", "type": "label", "text": "L14", "x": 240, "y": 50, "width": 50, "height": 20},
        {"id": "l15", "type": "label", "text": "L15", "x": 0, "y": 75, "width": 50, "height": 20},
        {"id": "l16", "type": "label", "text": "L16", "x": 60, "y": 75, "width": 50, "height": 20},
        {"id": "l17", "type": "label", "text": "L17", "x": 120, "y": 75, "width": 50, "height": 20},
        {"id": "l18", "type": "label", "text": "L18", "x": 180, "y": 75, "width": 50, "height": 20},
        {"id": "l19", "type": "label", "text": "L19", "x": 240, "y": 75, "width": 50, "height": 20}
    ]
})";

void example_huge_gui() {
    Serial.println("\n=== Example 5: Huge GUI (Exceeds Memory) ===");
    
    // Check memory requirements
    GuiMemoryStats stats = gui_memory_calculate_from_json(huge_gui_json);
    Serial.print("Huge GUI - Widgets: ");
    Serial.print(stats.widget_count);
    Serial.print(", Memory: ");
    Serial.print(gui_memory_format_size(stats.total_memory_bytes));
    Serial.print(", Fits: ");
    Serial.println(stats.fits_in_memory ? "YES" : "NO");
    
    if (!stats.error_message) {
        Serial.print("Error: ");
        Serial.println(stats.error_message);
    }
    
    // Try to load it (should fail and show error on TFT)
    Serial.println("\nAttempting to load huge GUI...");
    void* huge_gui = gui_loader_load_with_memory_check(huge_gui_json, tft);
    
    if (huge_gui) {
        Serial.println("Huge GUI loaded (unexpected!)");
    } else {
        Serial.println("Huge GUI failed to load as expected (memory check prevented it)");
        Serial.println("Error message should be displayed on TFT");
    }
}

// ============================================================================
// Main Example Setup and Loop
// ============================================================================

void setup_gui_memory_check_example() {
    Serial.begin(115200);
    while (!Serial);
    
    Serial.println("GUIKit Memory Check Example");
    Serial.println("============================");
    
    // Initialize widget pools
    pools_init();
    
    // Initialize memory checker
    gui_memory_checker_init();
    
    // Run examples
    example_check_gui_json();
    example_load_gui_with_check();
    example_check_current_memory();
    
    // For SD card examples, you need to have SD card initialized
    // example_load_from_sd();
    
    example_huge_gui();
    
    Serial.println("\nAll examples completed!");
}

void loop_gui_memory_check_example() {
    // Nothing to do in loop for this example
    delay(1000);
}

// ============================================================================
// Standalone Usage Example
// ============================================================================

/**
 * Example of how to use memory checking in a real application
 */
void application_example() {
    // In your application setup:
    
    // 1. Initialize hardware
    // initHardwareFromUnionConfig();
    
    // 2. Initialize pools
    pools_init();
    
    // 3. Initialize memory checker
    gui_memory_checker_init();
    
    // 4. Load GUI with memory check
    const char* gui_file = "/gui/main_gui.json";
    
    // Option A: Check first, then load
    GuiMemoryStats stats = gui_memory_calculate_from_file(gui_file);
    if (!stats.fits_in_memory) {
        // Display error on TFT
        gui_memory_display_error(tft, &stats);
        // Fallback to a simpler GUI or wait
        return;
    }
    
    // Load the GUI (memory is OK)
    void* gui = gui_loader_load_from_sd(gui_file);
    if (!gui) {
        // Handle other errors (file not found, etc.)
        gui_memory_display_oom_error(tft, "Cannot load GUI file");
        return;
    }
    
    // Option B: Use the memory-safe loader (does both in one call)
    void* gui2 = gui_loader_load_sd_with_memory_check(gui_file, tft);
    if (!gui2) {
        // Memory check failed or file error, error already displayed on TFT
        return;
    }
    
    // Use the GUI...
}
