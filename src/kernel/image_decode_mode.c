/**
 * @file image_decode_mode.c
 * @brief Image decode mode implementation with ESP8266 safety
 *
 * On ESP8266, both INTERNAL_FULL modes alias to DECODE_INTERNAL_TOFILE_NORMAL
 * (streaming with internal RAM buffer to SD Card)
 *
 * Generated by Mistral Vibe
 * Date: 2026-08-16
 */

#include "image_decode_mode.h"
#include <string.h>

// ============================================================================
// MODE STRING REPRESENTATIONS
// ============================================================================

static const char* MODE_NAMES[] = {
    "DECODE_INTERNAL_FULL",
    "DECODE_INTERNAL_TOFILE_FULL",
    "DECODE_EXTERNAL_TOFILE_NORMAL",
    "DECODE_INTERNAL_TOFILE_NORMAL",
    "DECODE_MODE_AUTO"
};

static const char* MODE_DESCRIPTIONS[] = {
    "Full decode in internal RAM (ESP32: keep in RAM, ESP8266: stream to SD)",
    "Full decode in internal RAM, then save to file (ESP32: full buffer, ESP8266: stream to SD)",
    "Streaming decode with external RAM to file",
    "Streaming decode to file using internal RAM only (DEFAULT)",
    "Auto-select based on platform and memory"
};

// ============================================================================
// MODE SELECTION
// ============================================================================

ImageDecodeSpeedMode decode_mode_select(ImageDecodeSpeedMode requested_mode,
                                       uint32_t available_internal_ram,
                                       uint32_t available_external_ram,
                                       uint32_t image_size_bytes) {
    if (requested_mode == DECODE_MODE_AUTO) {
        // Auto-select based on platform
        
        #if defined(ESP8266)
            // ESP8266: Limited to ~80KB internal RAM
            // Only streaming modes are practical
            if (available_external_ram > 0) {
                return DECODE_EXTERNAL_TOFILE_NORMAL;
            }
            return DECODE_INTERNAL_TOFILE_NORMAL;
            
        #elif defined(ESP32)
            // ESP32: Try fastest mode first
            // 1. Full in internal RAM (fastest)
            if (image_size_bytes <= available_internal_ram) {
                return DECODE_INTERNAL_FULL;
            }
            // 2. Stream with external RAM
            if (available_external_ram > 0) {
                return DECODE_EXTERNAL_TOFILE_NORMAL;
            }
            // 3. Full in internal RAM, then save
            if (image_size_bytes <= available_internal_ram) {
                return DECODE_INTERNAL_TOFILE_FULL;
            }
            // 4. Stream with internal RAM (fallback)
            return DECODE_INTERNAL_TOFILE_NORMAL;
            
        #else
            // Unknown platform: use safe default
            if (available_external_ram > 0) {
                return DECODE_EXTERNAL_TOFILE_NORMAL;
            }
            return DECODE_INTERNAL_TOFILE_NORMAL;
        #endif
    }
    
    // Manual mode selection - apply platform aliasing
    return decode_mode_get_actual(requested_mode);
}

// ============================================================================
// SAFETY CHECKS
// ============================================================================

bool decode_mode_is_safe(ImageDecodeSpeedMode mode,
                        uint32_t available_internal_ram,
                        uint32_t available_external_ram,
                        uint32_t image_size_bytes) {
    ImageDecodeSpeedMode actual = decode_mode_get_actual(mode);
    
    switch (actual) {
        case DECODE_INTERNAL_FULL:
            // Requires full image in RAM
            return (image_size_bytes <= available_internal_ram);
            
        case DECODE_INTERNAL_TOFILE_FULL:
            // Requires full image in RAM (temporarily)
            return (image_size_bytes <= available_internal_ram);
            
        case DECODE_EXTERNAL_TOFILE_NORMAL:
            // Requires external RAM for decoder state
            return (available_external_ram > 0);
            
        case DECODE_INTERNAL_TOFILE_NORMAL:
            // Always safe (uses ~7KB streaming buffer)
            return true;
            
        default:
            return false;
    }
}

// ============================================================================
// STRING FUNCTIONS
// ============================================================================

const char* decode_mode_to_string(ImageDecodeSpeedMode mode) {
    // Map aliased modes to their actual mode for display
    ImageDecodeSpeedMode actual = decode_mode_get_actual(mode);
    
    if (actual >= 0 && actual < (sizeof(MODE_NAMES) / sizeof(MODE_NAMES[0]))) {
        return MODE_NAMES[actual];
    }
    return "UNKNOWN_MODE";
}

const char* decode_mode_description(ImageDecodeSpeedMode mode) {
    ImageDecodeSpeedMode actual = decode_mode_get_actual(mode);
    
    if (actual >= 0 && actual < (sizeof(MODE_DESCRIPTIONS) / sizeof(MODE_DESCRIPTIONS[0]))) {
        return MODE_DESCRIPTIONS[actual];
    }
    return "Unknown decode mode";
}

// ============================================================================
// MEMORY REQUIREMENTS
// ============================================================================

// Streaming buffer size (scanline or MCU block)
#define STREAMING_BUFFER_SIZE (1024 * 8)  // 8KB for safety

uint32_t decode_mode_required_ram(ImageDecodeSpeedMode mode, uint32_t image_size_bytes) {
    ImageDecodeSpeedMode actual = decode_mode_get_actual(mode);
    
    switch (actual) {
        case DECODE_INTERNAL_FULL:
            // Full image in RAM
            return image_size_bytes;
            
        case DECODE_INTERNAL_TOFILE_FULL:
            // Full image in RAM (temporarily, then saved)
            return image_size_bytes;
            
        case DECODE_EXTERNAL_TOFILE_NORMAL:
            // Streaming with external RAM: decoder state in internal RAM
            return STREAMING_BUFFER_SIZE;
            
        case DECODE_INTERNAL_TOFILE_NORMAL:
            // Streaming with internal RAM only
            return STREAMING_BUFFER_SIZE;
            
        default:
            return STREAMING_BUFFER_SIZE;
    }
}
