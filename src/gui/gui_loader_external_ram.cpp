/**
 * GUIKit External RAM GUI Loader Implementation
 * 
 * Loads GUI JSON files into external SRAM instead of internal RAM
 * Uses SPI SRAM (23LC1024) for storing GUI definitions and widget data
 * 
 * Generated by Mistral Vibe
 * Date: 2026-08-15
 */

#include "gui_loader_external_ram.h"
#include "gui_loader.h"
#include "SPI.h"
#include <string.h>

// Include the SPISRAM class definition
// We'll use a simplified version here for external RAM access

// Forward declaration of SPISRAM from esp8266_expander_ram_tft.h
class SPISRAM {
    uint8_t csPin;
public:
    SPISRAM(uint8_t cs) : csPin(cs) {}
    void begin();
    uint8_t read(uint32_t addr);
    void write(uint32_t addr, uint8_t data);
    void readBuffer(uint32_t addr, uint8_t* buffer, size_t length);
    void writeBuffer(uint32_t addr, const uint8_t* buffer, size_t length);
    size_t getSize() const;
    uint8_t getCSPin() const { return csPin; }
};

// ============================================================================
// Static Variables
// ============================================================================

// Global SRAM instance (can be set by gui_external_ram_init)
static SPISRAM* global_sram = nullptr;

// ============================================================================
// Helper Functions
// ============================================================================

/**
 * Store a 32-bit value in external RAM
 */
static void store_uint32(SPISRAM* sram, uint32_t addr, uint32_t value) {
    uint8_t bytes[4];
    bytes[0] = (value >> 0) & 0xFF;
    bytes[1] = (value >> 8) & 0xFF;
    bytes[2] = (value >> 16) & 0xFF;
    bytes[3] = (value >> 24) & 0xFF;
    sram->writeBuffer(addr, bytes, 4);
}

/**
 * Load a 32-bit value from external RAM
 */
static uint32_t load_uint32(SPISRAM* sram, uint32_t addr) {
    uint8_t bytes[4];
    sram->readBuffer(addr, bytes, 4);
    return (uint32_t)bytes[0] | ((uint32_t)bytes[1] << 8) | 
           ((uint32_t)bytes[2] << 16) | ((uint32_t)bytes[3] << 24);
}

/**
 * Store a 16-bit value in external RAM
 */
static void store_uint16(SPISRAM* sram, uint32_t addr, uint16_t value) {
    uint8_t bytes[2];
    bytes[0] = (value >> 0) & 0xFF;
    bytes[1] = (value >> 8) & 0xFF;
    sram->writeBuffer(addr, bytes, 2);
}

/**
 * Load a 16-bit value from external RAM
 */
static uint16_t load_uint16(SPISRAM* sram, uint32_t addr) {
    uint8_t bytes[2];
    sram->readBuffer(addr, bytes, 2);
    return (uint16_t)bytes[0] | ((uint16_t)bytes[1] << 8);
}

/**
 * Store a string in external RAM
 */
static bool store_string(SPISRAM* sram, uint32_t addr, const char* str, uint32_t max_len) {
    if (!str) return false;
    
    size_t len = strlen(str);
    if (len >= max_len) len = max_len - 1;
    
    // Store length first (2 bytes)
    store_uint16(sram, addr, (uint16_t)len);
    addr += 2;
    
    // Store string data
    sram->writeBuffer(addr, (const uint8_t*)str, len);
    
    // Null terminate
    sram->write(addr + len, 0);
    
    return true;
}

/**
 * Load a string from external RAM
 */
static bool load_string(SPISRAM* sram, uint32_t addr, char* buffer, int buffer_size) {
    // Load length
    uint16_t len = load_uint16(sram, addr);
    addr += 2;
    
    if (len >= (uint16_t)buffer_size) len = buffer_size - 1;
    
    // Load string data
    sram->readBuffer(addr, (uint8_t*)buffer, len);
    buffer[len] = '\0';
    
    return true;
}

// ============================================================================
// Public Functions
// ============================================================================

bool gui_external_ram_init(SPISRAM* sram) {
    if (!sram) return false;
    
    global_sram = sram;
    return true;
}

bool gui_external_ram_load_from_sd(const char* filepath, SPISRAM* sram) {
    if (!filepath || !sram) return false;
    
    // Load file from SD card
    char buffer[GUI_JSON_MAX_SIZE + 1];
    int bytes_read = gui_loader_load(filepath, buffer, GUI_JSON_MAX_SIZE);
    
    if (bytes_read <= 0) {
        return false;
    }
    
    buffer[bytes_read] = '\0';
    
    // Store in external RAM
    return gui_external_ram_load_from_string(buffer, sram);
}

bool gui_external_ram_load_from_webdav(const char* filename, SPISRAM* sram) {
    if (!filename || !sram) return false;
    
    // Load file from WebDAV
    char buffer[GUI_JSON_MAX_SIZE + 1];
    int bytes_read = gui_loader_load_from_webdav(filename, buffer, GUI_JSON_MAX_SIZE);
    
    if (bytes_read <= 0) {
        return false;
    }
    
    buffer[bytes_read] = '\0';
    
    // Store in external RAM
    return gui_external_ram_load_from_string(buffer, sram);
}

bool gui_external_ram_load_from_string(const char* json, SPISRAM* sram) {
    if (!json || !sram) return false;
    
    size_t json_len = strlen(json);
    
    // Check if JSON fits in allocated space
    if (json_len > GUI_JSON_MAX_SIZE) {
        return false;
    }
    
    // Store JSON in external RAM
    sram->writeBuffer(GUI_JSON_STORAGE_ADDR, (const uint8_t*)json, json_len);
    
    // Store length at the beginning
    store_uint32(sram, GUI_JSON_STORAGE_ADDR - 4, json_len);
    
    return true;
}

void* gui_external_ram_parse(SPISRAM* sram, uint32_t json_addr) {
    if (!sram) {
        if (global_sram) {
            sram = global_sram;
        } else {
            return NULL;
        }
    }
    
    // Load JSON length
    uint32_t json_len = load_uint32(sram, json_addr - 4);
    if (json_len == 0 || json_len > GUI_JSON_MAX_SIZE) {
        return NULL;
    }
    
    // Load JSON from external RAM to a temporary buffer
    // Note: This is a limitation - we need to load to internal RAM first to parse
    // because JSON parsers typically need the entire string in memory
    char* json_buffer = (char*)malloc(json_len + 1);
    if (!json_buffer) {
        return NULL;
    }
    
    sram->readBuffer(json_addr, (uint8_t*)json_buffer, json_len);
    json_buffer[json_len] = '\0';
    
    // Parse JSON (this allocates widgets from pools in internal RAM)
    void* gui = gui_loader_parse_json(json_buffer);
    
    free(json_buffer);
    
    return gui;
}

int gui_external_ram_get_json(SPISRAM* sram, char* buffer, int buffer_size, uint32_t json_addr) {
    if (!sram || !buffer || buffer_size <= 0) return -1;
    
    if (!json_addr) {
        json_addr = GUI_JSON_STORAGE_ADDR;
    }
    
    // Load length
    uint32_t json_len = load_uint32(sram, json_addr - 4);
    if (json_len == 0 || json_len > GUI_JSON_MAX_SIZE) {
        return -1;
    }
    
    if (json_len >= (uint32_t)buffer_size) {
        json_len = buffer_size - 1;
    }
    
    // Load JSON data
    sram->readBuffer(json_addr, (uint8_t*)buffer, json_len);
    buffer[json_len] = '\0';
    
    return json_len;
}

bool gui_external_ram_has_gui(SPISRAM* sram) {
    if (!sram) {
        if (global_sram) {
            sram = global_sram;
        } else {
            return false;
        }
    }
    
    // Check if there's valid data at GUI_JSON_STORAGE_ADDR
    uint32_t json_len = load_uint32(sram, GUI_JSON_STORAGE_ADDR - 4);
    
    // Check if first byte is a valid JSON start
    uint8_t first_byte = sram->read(GUI_JSON_STORAGE_ADDR);
    
    return (json_len > 0 && json_len <= GUI_JSON_MAX_SIZE && 
            (first_byte == '{' || first_byte == '['));
}

uint32_t gui_external_ram_get_gui_size(SPISRAM* sram) {
    if (!sram) {
        if (global_sram) {
            sram = global_sram;
        } else {
            return 0;
        }
    }
    
    return load_uint32(sram, GUI_JSON_STORAGE_ADDR - 4);
}

void gui_external_ram_clear(SPISRAM* sram) {
    if (!sram) {
        if (global_sram) {
            sram = global_sram;
        } else {
            return;
        }
    }
    
    // Clear the entire GUI area
    uint8_t clear_byte = 0;
    for (uint32_t addr = GUI_EXTERNAL_RAM_START_ADDR; 
         addr < GUI_EXTERNAL_RAM_START_ADDR + GUI_EXTERNAL_RAM_MAX_SIZE; 
         addr++) {
        sram->write(addr, clear_byte);
    }
}

// ============================================================================
// External RAM Widget Allocation
// ============================================================================

// External RAM widget pools (stored in external RAM)
// These are pointers to pool structures in external RAM
static uint32_t external_widget_pool_addr = GUI_WIDGET_STORAGE_ADDR;
static uint32_t external_button_pool_addr = 0;
static uint32_t external_label_pool_addr = 0;
static uint32_t external_slider_pool_addr = 0;
static uint32_t external_view_pool_addr = 0;

// Pool sizes (match internal pool sizes)
#define EXTERNAL_MAX_WIDGETS 30
#define EXTERNAL_MAX_BUTTONS 20
#define EXTERNAL_MAX_LABELS 20
#define EXTERNAL_MAX_SLIDERS 10
#define EXTERNAL_MAX_VIEWS 10

/**
 * External RAM widget structure (simplified for external storage)
 */
typedef struct {
    WIDGET_TYPE type;
    uint16_t x, y;
    uint16_t width, height;
    // Text is stored separately in external RAM
    uint32_t text_addr;
    uint16_t text_len;
    // Children pointers would be addresses in external RAM
    uint32_t children_addr;
    uint8_t children_count;
    uint8_t children_capacity;
    uint16_t bg_color;
    uint16_t border_color;
    uint8_t border_width;
    bool dirty;
    bool visible;
} ExternalWidget;

/**
 * External RAM button widget
 */
typedef struct {
    ExternalWidget base;
    bool pressed;
    uint32_t onClick_addr;  // Address of callback in external RAM
} ExternalWidgetButton;

bool gui_external_ram_pools_init(SPISRAM* sram) {
    if (!sram) return false;
    
    // Initialize pool addresses
    external_widget_pool_addr = GUI_WIDGET_STORAGE_ADDR;
    external_button_pool_addr = external_widget_pool_addr + 
                                EXTERNAL_MAX_WIDGETS * sizeof(ExternalWidget);
    external_label_pool_addr = external_button_pool_addr + 
                               EXTERNAL_MAX_BUTTONS * sizeof(ExternalWidgetButton);
    external_slider_pool_addr = external_label_pool_addr + 
                                EXTERNAL_MAX_LABELS * sizeof(ExternalWidget);
    external_view_pool_addr = external_slider_pool_addr + 
                              EXTERNAL_MAX_SLIDERS * sizeof(ExternalWidget);
    
    // Clear all pools
    uint8_t zero = 0;
    for (uint32_t addr = external_widget_pool_addr; 
         addr < external_view_pool_addr + EXTERNAL_MAX_VIEWS * sizeof(ExternalWidget); 
         addr++) {
        sram->write(addr, zero);
    }
    
    return true;
}

Widget* gui_external_ram_widget_alloc(WIDGET_TYPE type, SPISRAM* sram) {
    if (!sram) {
        if (global_sram) {
            sram = global_sram;
        } else {
            return nullptr;
        }
    }
    
    // For now, we'll just allocate from internal pools
    // but mark them as being stored in external RAM
    Widget* widget = widget_alloc(type);
    if (!widget) return nullptr;
    
    // TODO: In a full implementation, we would:
    // 1. Allocate from external RAM pool
    // 2. Store widget data in external RAM
    // 3. Return a proxy pointer that maps to external RAM
    
    // For now, just return the internal widget
    // The actual external RAM storage would require more complex memory management
    return widget;
}

// ============================================================================
// Advanced: Direct JSON Parsing from External RAM
// ============================================================================

/**
 * Parse JSON directly from external RAM without loading to internal RAM
 * This is more memory-efficient but requires a streaming JSON parser
 * 
 * @param sram Pointer to SPISRAM instance
 * @param json_addr Address in SRAM where JSON is stored
 * @return Pointer to parsed GUI structure
 * @note This is a placeholder - would require a streaming JSON parser
 */
void* gui_external_ram_parse_direct(SPISRAM* sram, uint32_t json_addr) {
    // This would require a JSON parser that can read from a stream
    // or read chunks from external RAM on demand
    
    // For now, fall back to the buffer-based approach
    return gui_external_ram_parse(sram, json_addr);
}

// ============================================================================
// Utility Functions
// ============================================================================

/**
 * Calculate total external RAM usage
 * 
 * @param sram Pointer to SPISRAM instance
 * @return Number of bytes used in external RAM for GUI
 */
uint32_t gui_external_ram_get_usage(SPISRAM* sram) {
    if (!sram) {
        if (global_sram) {
            sram = global_sram;
        } else {
            return 0;
        }
    }
    
    uint32_t json_len = gui_external_ram_get_gui_size(sram);
    if (json_len == 0) return 0;
    
    // For now, just return JSON size
    // In a full implementation, this would also track widget data in external RAM
    return json_len + 4;  // +4 for length header
}

/**
 * Get available space in external RAM for GUI
 * 
 * @param sram Pointer to SPISRAM instance
 * @return Number of free bytes
 */
uint32_t gui_external_ram_get_free_space(SPISRAM* sram) {
    if (!sram) {
        if (global_sram) {
            sram = global_sram;
        } else {
            return 0;
        }
    }
    
    return GUI_EXTERNAL_RAM_MAX_SIZE - gui_external_ram_get_usage(sram);
}

/**
 * Check if there's enough space in external RAM for a GUI
 * 
 * @param sram Pointer to SPISRAM instance
 * @param json_size Size of JSON to store
 * @return true if there's enough space
 */
bool gui_external_ram_has_space(SPISRAM* sram, uint32_t json_size) {
    return gui_external_ram_get_free_space(sram) >= json_size + 4;
}
