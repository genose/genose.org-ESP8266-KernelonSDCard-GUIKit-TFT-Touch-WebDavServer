/**
 * GUIKit Memory Checker Implementation
 * 
 * Evaluates memory requirements for GUI JSON files
 * Checks if GUI can fit in available memory before loading
 * Displays error messages on TFT if memory is insufficient
 * 
 * Generated by Mistral Vibe
 * Date: 2026-08-15
 */

#include "gui_memory_checker.h"
#include <string.h>
#include <stdlib.h>
#include "SPI.h"

// ============================================================================
// Static Helper Functions
// ============================================================================

/**
 * Count occurrences of a substring in a string
 */
static int count_substring(const char* str, const char* substr) {
    if (!str || !substr) return 0;
    
    int count = 0;
    const char* tmp = str;
    
    while ((tmp = strstr(tmp, substr)) != NULL) {
        count++;
        tmp += strlen(substr);
    }
    
    return count;
}

/**
 * Simple JSON parser to count widgets
 * This is a lightweight parser that doesn't need a full JSON library
 */
static void count_widgets_in_json(const char* json, 
                                 uint16_t* buttons, uint16_t* labels, 
                                 uint16_t* sliders, uint16_t* views,
                                 uint16_t* text_inputs, uint16_t* text_editors,
                                 uint16_t* total_children) {
    
    if (!json) return;
    
    // Count widget types by looking for "type": "widget_type" patterns
    *buttons = count_substring(json, "\"type\": \"button\"");
    *labels = count_substring(json, "\"type\": \"label\"");
    *sliders = count_substring(json, "\"type\": \"slider\"");
    *views = count_substring(json, "\"type\": \"view\"");
    *text_inputs = count_substring(json, "\"type\": \"text_input\"");
    *text_editors = count_substring(json, "\"type\": \"text_editor\"");
    
    // Count children by looking for "children": [ patterns
    *total_children = count_substring(json, "\"children\": [");
    
    // Also count items in children arrays (approximate)
    // Each "children" array item is a widget
    int open_brackets = 0;
    int in_children = 0;
    int child_count = 0;
    
    for (int i = 0; json[i]; i++) {
        if (strncmp(&json[i], "\"children\": [", 14) == 0) {
            in_children = 1;
            open_brackets = 1;
            i += 13;
            continue;
        }
        
        if (in_children) {
            if (json[i] == '[') open_brackets++;
            if (json[i] == ']') {
                open_brackets--;
                if (open_brackets == 0) {
                    in_children = 0;
                }
            }
            if (json[i] == '{') {
                child_count++;
            }
        }
    }
    
    // Add children to views (each view with children needs extra memory)
    if (child_count > *total_children) {
        *total_children = child_count;
    }
}

/**
 * Calculate memory for children arrays
 */
static uint32_t calculate_children_memory(uint16_t total_children) {
    // Each child pointer is 2 bytes (ESP8266 is 32-bit, pointers are 4 bytes)
    // But we're using uint8_t for children_count, so max 255 children per widget
    // For simplicity, assume each widget with children has 4 children on average
    // and each needs 4 pointers
    
    if (total_children == 0) return 0;
    
    // Approximate: 4 pointers per children array * 4 bytes each
    // This is a rough estimate; actual depends on widget structure
    return total_children * MEMORY_PER_CHILD_POINTER * 4;
}

/**
 * Calculate total memory required for widgets
 */
static uint32_t calculate_widget_memory(uint16_t buttons, uint16_t labels, 
                                       uint16_t sliders, uint16_t views,
                                       uint16_t text_inputs, uint16_t text_editors,
                                       uint16_t total_children) {
    
    uint32_t total = 0;
    
    // Add memory for each widget type
    total += buttons * MEMORY_WIDGET_BUTTON_SIZE;
    total += labels * MEMORY_WIDGET_LABEL_SIZE;
    total += sliders * MEMORY_WIDGET_SLIDER_SIZE;
    total += views * MEMORY_WIDGET_VIEW_SIZE;
    total += text_inputs * MEMORY_WIDGET_TEXT_INPUT_SIZE;
    total += text_editors * MEMORY_WIDGET_TEXT_EDITOR_SIZE;
    
    // Add memory for children pointers
    total += calculate_children_memory(total_children);
    
    // Add overhead for text buffers in labels, buttons, etc.
    // Each label/button with text needs buffer space
    uint16_t text_widgets = labels + buttons + text_inputs + text_editors;
    total += text_widgets * 64;  // Average text buffer size
    
    return total;
}

/**
 * Check if pool has capacity for widgets
 */
static bool check_pool_capacity(uint16_t buttons, uint16_t labels, 
                               uint16_t sliders, uint16_t views,
                               uint16_t text_inputs, uint16_t text_editors) {
    
    // Check each pool
    if (buttons > AVAILABLE_BUTTONS) return false;
    if (labels > AVAILABLE_LABELS) return false;
    if (sliders > AVAILABLE_SLIDERS) return false;
    if (views > AVAILABLE_VIEWS) return false;
    
    // For text inputs and editors, we use generic widget pool
    uint16_t generic_widgets = text_inputs + text_editors;
    if (generic_widgets > AVAILABLE_WIDGETS) return false;
    
    return true;
}

// ============================================================================
// Public Functions
// ============================================================================

void gui_memory_checker_init(void) {
    // Initialize pools if not already initialized
    // (This is called by pools_init() in application startup)
}

GuiMemoryStats gui_memory_get_current_usage(void) {
    GuiMemoryStats stats = {0};
    
    stats.button_count = pool_get_allocated_count(WIDGET_TYPE_BUTTON);
    stats.label_count = pool_get_allocated_count(WIDGET_TYPE_LABEL);
    stats.slider_count = pool_get_allocated_count(WIDGET_TYPE_SLIDER);
    stats.view_count = pool_get_allocated_count(WIDGET_TYPE_VIEW);
    
    // Text inputs and editors use generic widget pool
    // We can't distinguish them from the pool, so we estimate
    stats.widget_count = pool_get_allocated_count(WIDGET_TYPE_VIEW);
    
    // Calculate total memory
    stats.total_memory_bytes = calculate_widget_memory(
        stats.button_count, stats.label_count,
        stats.slider_count, stats.view_count,
        0, 0, 0
    );
    
    stats.fits_in_memory = true;
    stats.error_message = NULL;
    
    return stats;
}

GuiMemoryStats gui_memory_calculate_from_json(const char* json) {
    GuiMemoryStats stats = {0};
    
    if (!json || strlen(json) == 0) {
        stats.fits_in_memory = false;
        stats.error_message = "Invalid JSON";
        return stats;
    }
    
    // Count widgets in JSON
    uint16_t buttons, labels, sliders, views, text_inputs, text_editors, total_children;
    count_widgets_in_json(json, &buttons, &labels, &sliders, &views, &text_inputs, &text_editors, &total_children);
    
    stats.widget_count = buttons + labels + sliders + views + text_inputs + text_editors;
    stats.button_count = buttons;
    stats.label_count = labels;
    stats.slider_count = sliders;
    stats.view_count = views;
    stats.text_input_count = text_inputs;
    stats.text_editor_count = text_editors;
    stats.total_children = total_children;
    stats.estimated_json_size = strlen(json);
    
    // Calculate memory
    stats.total_memory_bytes = calculate_widget_memory(
        buttons, labels, sliders, views, text_inputs, text_editors, total_children
    );
    
    // Add JSON parsing buffer overhead (temporary buffer during parsing)
    stats.total_memory_bytes += stats.estimated_json_size + 256;
    
    // Check if fits in pool capacities
    if (!check_pool_capacity(buttons, labels, sliders, views, text_inputs, text_editors)) {
        stats.fits_in_memory = false;
        stats.error_message = "Widget pool capacity exceeded";
        return stats;
    }
    
    // Check if fits in total memory
    if (stats.total_memory_bytes > TOTAL_AVAILABLE_GUI_MEMORY) {
        stats.fits_in_memory = false;
        stats.error_message = "Insufficient memory";
        return stats;
    }
    
    stats.fits_in_memory = true;
    stats.error_message = NULL;
    
    return stats;
}

GuiMemoryStats gui_memory_calculate_from_file(const char* filepath) {
    GuiMemoryStats stats = {0};
    
    if (!filepath) {
        stats.fits_in_memory = false;
        stats.error_message = "Invalid file path";
        return stats;
    }
    
    // For now, we'll just check the file size and estimate
    // In a real implementation, we would read the file and parse it
    
    // Get file size from SD card
    int file_size = gui_loader_get_size(filepath);
    if (file_size < 0) {
        stats.fits_in_memory = false;
        stats.error_message = "File not found";
        return stats;
    }
    
    stats.estimated_json_size = file_size;
    
    // Load file and calculate
    char* buffer = (char*)malloc(file_size + 1);
    if (!buffer) {
        stats.fits_in_memory = false;
        stats.error_message = "Cannot allocate buffer";
        return stats;
    }
    
    int bytes_read = gui_loader_load(filepath, buffer, file_size);
    if (bytes_read <= 0) {
        free(buffer);
        stats.fits_in_memory = false;
        stats.error_message = "Cannot read file";
        return stats;
    }
    
    buffer[bytes_read] = '\0';
    
    // Calculate from JSON content
    GuiMemoryStats result = gui_memory_calculate_from_json(buffer);
    
    free(buffer);
    return result;
}

bool gui_memory_can_fit(const char* json, uint32_t available_memory) {
    GuiMemoryStats stats = gui_memory_calculate_from_json(json);
    return stats.total_memory_bytes <= available_memory;
}

bool gui_memory_can_fit_file(const char* filepath) {
    GuiMemoryStats stats = gui_memory_calculate_from_file(filepath);
    return stats.fits_in_memory;
}

// ============================================================================
// TFT Error Display Functions
// ============================================================================

// Color definitions for TFT
#define COLOR_BLACK 0x0000
#define COLOR_WHITE 0xFFFF
#define COLOR_RED 0xF800
#define COLOR_YELLOW 0xFFE0

/**
 * Draw a filled rectangle on TFT
 */
static void draw_filled_rect(TFT_ST7789* tft, uint16_t x, uint16_t y, uint16_t w, uint16_t h, uint16_t color) {
    if (tft) {
        tft->setAddrWindow(x, y, x + w - 1, y + h - 1);
        digitalWrite(tft->getCSPin(), LOW);
        digitalWrite(tft->getDCPin(), HIGH);
        for (uint32_t i = 0; i < (uint32_t)w * h; i++) {
            SPI.transfer(color >> 8);
            SPI.transfer(color & 0xFF);
        }
        digitalWrite(tft->getCSPin(), HIGH);
    }
}

/**
 * Draw text on TFT (simplified)
 */
static void draw_text(TFT_ST7789* tft, uint16_t x, uint16_t y, const char* text, uint16_t fg, uint16_t bg) {
    if (!tft || !text) return;
    
    // Simple character rendering (5x7 font)
    const uint8_t* font = NULL; // Would use actual font data in real implementation
    uint16_t char_width = 6;
    uint16_t char_height = 8;
    
    for (int i = 0; text[i]; i++) {
        // Draw character (placeholder - in real implementation would render actual font)
        for (int py = 0; py < char_height; py++) {
            for (int px = 0; px < char_width; px++) {
                // For now, just draw foreground pixels
                if (1) { // In real impl, would check font bitmap
                    tft->drawPixel(x + i * char_width + px, y + py, fg);
                }
            }
        }
    }
}

void gui_memory_display_error(TFT_ST7789* tft, const GuiMemoryStats* stats) {
    if (!tft) return;
    
    // Clear screen with black
    tft->fillScreen(COLOR_BLACK);
    
    // Draw error box
    uint16_t box_x = 20;
    uint16_t box_y = 60;
    uint16_t box_w = tft->getWidth() - 40;
    uint16_t box_h = tft->getHeight() - 120;
    
    // Draw red border
    tft->drawRect(box_x, box_y, box_w, box_h, COLOR_RED);
    
    // Draw yellow background
    draw_filled_rect(tft, box_x + 1, box_y + 1, box_w - 2, box_h - 2, COLOR_YELLOW);
    
    // Draw error title
    const char* title = "MEMORY ERROR";
    uint16_t title_x = box_x + (box_w - strlen(title) * 6) / 2;
    draw_text(tft, title_x, box_y + 10, title, COLOR_BLACK, COLOR_YELLOW);
    
    // Draw error details
    uint16_t line_y = box_y + 30;
    
    if (stats && stats->error_message) {
        draw_text(tft, box_x + 10, line_y, stats->error_message, COLOR_BLACK, COLOR_YELLOW);
        line_y += 15;
    } else {
        draw_text(tft, box_x + 10, line_y, "GUI cannot be loaded", COLOR_BLACK, COLOR_YELLOW);
        line_y += 15;
    }
    
    if (stats) {
        char buffer[64];
        
        // Total widgets
        snprintf(buffer, sizeof(buffer), "Widgets: %u", stats->widget_count);
        draw_text(tft, box_x + 10, line_y, buffer, COLOR_BLACK, COLOR_YELLOW);
        line_y += 15;
        
        // Memory required
        const char* size_str = gui_memory_format_size(stats->total_memory_bytes);
        snprintf(buffer, sizeof(buffer), "Required: %s", size_str);
        draw_text(tft, box_x + 10, line_y, buffer, COLOR_BLACK, COLOR_YELLOW);
        line_y += 15;
        
        // Available memory
        const char* avail_str = gui_memory_format_size(TOTAL_AVAILABLE_GUI_MEMORY);
        snprintf(buffer, sizeof(buffer), "Available: %s", avail_str);
        draw_text(tft, box_x + 10, line_y, buffer, COLOR_BLACK, COLOR_YELLOW);
        line_y += 15;
        
        // Widget breakdown
        if (stats->button_count > 0) {
            snprintf(buffer, sizeof(buffer), "Buttons: %u", stats->button_count);
            draw_text(tft, box_x + 10, line_y, buffer, COLOR_BLACK, COLOR_YELLOW);
            line_y += 15;
        }
        if (stats->label_count > 0) {
            snprintf(buffer, sizeof(buffer), "Labels: %u", stats->label_count);
            draw_text(tft, box_x + 10, line_y, buffer, COLOR_BLACK, COLOR_YELLOW);
            line_y += 15;
        }
        if (stats->slider_count > 0) {
            snprintf(buffer, sizeof(buffer), "Sliders: %u", stats->slider_count);
            draw_text(tft, box_x + 10, line_y, buffer, COLOR_BLACK, COLOR_YELLOW);
            line_y += 15;
        }
        if (stats->view_count > 0) {
            snprintf(buffer, sizeof(buffer), "Views: %u", stats->view_count);
            draw_text(tft, box_x + 10, line_y, buffer, COLOR_BLACK, COLOR_YELLOW);
            line_y += 15;
        }
    }
    
    // Draw OK message at bottom
    const char* ok_msg = "Please reduce GUI complexity";
    draw_text(tft, box_x + (box_w - strlen(ok_msg) * 6) / 2, 
              tft->getHeight() - 20, ok_msg, COLOR_WHITE, COLOR_BLACK);
}

void gui_memory_display_oom_error(TFT_ST7789* tft, const char* message) {
    if (!tft) return;
    
    // Clear screen
    tft->fillScreen(COLOR_BLACK);
    
    // Draw error message
    const char* error = message ? message : "Out of Memory";
    uint16_t text_x = (tft->getWidth() - strlen(error) * 6) / 2;
    uint16_t text_y = tft->getHeight() / 2 - 4;
    
    draw_text(tft, text_x, text_y, error, COLOR_RED, COLOR_BLACK);
    
    // Draw sub-message
    const char* sub_msg = "GUI too complex";
    text_x = (tft->getWidth() - strlen(sub_msg) * 6) / 2;
    draw_text(tft, text_x, text_y + 20, sub_msg, COLOR_WHITE, COLOR_BLACK);
}

const char* gui_memory_format_size(uint32_t bytes) {
    static char buffer[32];
    
    if (bytes < 1024) {
        snprintf(buffer, sizeof(buffer), "%u B", bytes);
    } else if (bytes < 1024 * 1024) {
        float kb = bytes / 1024.0;
        snprintf(buffer, sizeof(buffer), "%.1f KB", kb);
    } else {
        float mb = bytes / (1024.0 * 1024.0);
        snprintf(buffer, sizeof(buffer), "%.1f MB", mb);
    }
    
    return buffer;
}

// ============================================================================
// JSON Parsing Helper (Lightweight)
// ============================================================================

/**
 * Extract a value from JSON (integer)
 */
int gui_memory_json_get_int(const char* json, const char* key, int default_value) {
    char search_key[64];
    snprintf(search_key, sizeof(search_key), "\"%s\": ", key);
    
    const char* pos = strstr(json, search_key);
    if (!pos) return default_value;
    
    pos += strlen(search_key);
    
    // Skip whitespace
    while (*pos == ' ' || *pos == '\t' || *pos == '\n' || *pos == '\r') pos++;
    
    // Parse integer
    return atoi(pos);
}

/**
 * Count widgets recursively in a JSON subtree
 */
static void count_widgets_recursive(const char* json, size_t* pos, 
                                   uint16_t* buttons, uint16_t* labels, 
                                   uint16_t* sliders, uint16_t* views,
                                   uint16_t* text_inputs, uint16_t* text_editors) {
    
    while (json[*pos]) {
        // Skip whitespace
        while (json[*pos] == ' ' || json[*pos] == '\t' || json[*pos] == '\n' || json[*pos] == '\r') {
            (*pos)++;
        }
        
        if (json[*pos] == '}') {
            (*pos)++;
            return;
        }
        
        if (json[*pos] == '"') {
            // Parse key
            (*pos)++;
            const char* key_start = &json[*pos];
            while (json[*pos] && json[*pos] != '"') (*pos)++;
            size_t key_len = &json[*pos] - key_start;
            
            (*pos)++; // Skip closing quote
            
            // Skip to value
            while (json[*pos] == ' ' || json[*pos] == '\t' || json[*pos] == ':') (*pos)++;
            
            // Check for widget type
            if (key_len == 4 && strncmp(key_start, "type", 4) == 0) {
                // Skip to type value
                while (json[*pos] == ' ' || json[*pos] == '\t' || json[*pos] == ':') (*pos)++;
                
                if (json[*pos] == '"') {
                    (*pos)++;
                    const char* type_start = &json[*pos];
                    while (json[*pos] && json[*pos] != '"') (*pos)++;
                    size_t type_len = &json[*pos] - type_start;
                    
                    if (type_len == 6 && strncmp(type_start, "button", 6) == 0) (*buttons)++;
                    else if (type_len == 5 && strncmp(type_start, "label", 5) == 0) (*labels)++;
                    else if (type_len == 6 && strncmp(type_start, "slider", 6) == 0) (*sliders)++;
                    else if (type_len == 4 && strncmp(type_start, "view", 4) == 0) (*views)++;
                    else if (type_len == 10 && strncmp(type_start, "text_input", 10) == 0) (*text_inputs)++;
                    else if (type_len == 11 && strncmp(type_start, "text_editor", 11) == 0) (*text_editors)++;
                    
                    (*pos)++; // Skip closing quote
                }
            }
            
            // Check for children array
            if (key_len == 8 && strncmp(key_start, "children", 8) == 0) {
                // Skip to array
                while (json[*pos] && json[*pos] != '[') (*pos)++;
                if (json[*pos] == '[') {
                    (*pos)++;
                    // Parse array items (widgets)
                    while (json[*pos]) {
                        while (json[*pos] == ' ' || json[*pos] == '\t' || json[*pos] == '\n') (*pos)++;
                        
                        if (json[*pos] == ']') {
                            (*pos)++;
                            break;
                        }
                        
                        if (json[*pos] == '{') {
                            (*pos)++;
                            // Recursively parse child widget
                            count_widgets_recursive(json, pos, buttons, labels, sliders, views, text_inputs, text_editors);
                        } else {
                            (*pos)++;
                        }
                    }
                }
            }
            
            // Skip value
            while (json[*pos] && json[*pos] != ',' && json[*pos] != '}') (*pos)++;
        } else {
            (*pos)++;
        }
    }
}

/**
 * Improved JSON widget counter using recursive parsing
 */
GuiMemoryStats gui_memory_calculate_from_json_v2(const char* json) {
    GuiMemoryStats stats = {0};
    
    if (!json || strlen(json) == 0) {
        stats.fits_in_memory = false;
        stats.error_message = "Invalid JSON";
        return stats;
    }
    
    size_t pos = 0;
    uint16_t buttons = 0, labels = 0, sliders = 0, views = 0, text_inputs = 0, text_editors = 0;
    
    // Skip to widgets array
    const char* widgets_pos = strstr(json, "\"widgets\": [");
    if (widgets_pos) {
        pos = widgets_pos - json + strlen("\"widgets\": [");
        
        // Parse each widget in the array
        while (json[pos]) {
            while (json[pos] == ' ' || json[pos] == '\t' || json[pos] == '\n') pos++;
            
            if (json[pos] == ']') {
                pos++;
                break;
            }
            
            if (json[pos] == '{') {
                pos++;
                count_widgets_recursive(json, &pos, &buttons, &labels, &sliders, &views, &text_inputs, &text_editors);
            } else {
                pos++;
            }
        }
    }
    
    stats.widget_count = buttons + labels + sliders + views + text_inputs + text_editors;
    stats.button_count = buttons;
    stats.label_count = labels;
    stats.slider_count = sliders;
    stats.view_count = views;
    stats.text_input_count = text_inputs;
    stats.text_editor_count = text_editors;
    stats.estimated_json_size = strlen(json);
    
    // Calculate memory
    stats.total_memory_bytes = calculate_widget_memory(
        buttons, labels, sliders, views, text_inputs, text_editors, stats.widget_count
    );
    
    // Add JSON parsing buffer overhead
    stats.total_memory_bytes += stats.estimated_json_size + 256;
    
    // Check if fits
    if (!check_pool_capacity(buttons, labels, sliders, views, text_inputs, text_editors)) {
        stats.fits_in_memory = false;
        stats.error_message = "Widget pool capacity exceeded";
        return stats;
    }
    
    if (stats.total_memory_bytes > TOTAL_AVAILABLE_GUI_MEMORY) {
        stats.fits_in_memory = false;
        stats.error_message = "Insufficient memory";
        return stats;
    }
    
    stats.fits_in_memory = true;
    stats.error_message = NULL;
    
    return stats;
}

// Alias for backward compatibility
GuiMemoryStats gui_memory_calculate_from_json_v1(const char* json) __attribute__((alias("gui_memory_calculate_from_json")));
