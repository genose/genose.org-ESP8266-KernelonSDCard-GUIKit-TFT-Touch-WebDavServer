/**
 * GUIKit Memory Strategy Implementation
 * 
 * Hierarchical memory management for GUI data:
 * 1. External RAM (23LC1024 SRAM) - Primary storage
 * 2. SD Card Swap - Secondary storage (for large GUIs)
 * 3. Internal RAM - Fallback storage
 * 
 * Strategy:
 * - If external RAM is available and GUI fits => use external RAM
 * - Else if SD card is available => use SD card swap (streaming/partial loading)
 * - Else => use internal RAM (with memory limit checking)
 * 
 * Generated by Mistral Vibe
 * Date: 2026-08-15
 */

#include "gui_memory_strategy.h"
#include "gui_loader.h"
#include "gui_loader_external_ram.h"
#include "gui_memory_checker.h"
#include <string.h>
#include <stdlib.h>

// ============================================================================
// Static Variables
// ============================================================================

static SPISRAM* strategy_sram = nullptr;
static SDCard* strategy_sdcard = nullptr;
static TFT_ST7789* strategy_tft = nullptr;
static uint8_t* sd_swap_cache = nullptr;
static MemoryStrategyLevel current_strategy = MEMORY_STRATEGY_INTERNAL_RAM;
static bool gui_loaded = false;
static void (*error_callback)(const char*) = nullptr;

// ============================================================================
// Helper Functions
// ============================================================================

/**
 * Get GUI file size
 */
static int get_gui_size(const char* filepath) {
    if (filepath) {
        return gui_loader_get_size(filepath);
    }
    return -1;
}

/**
 * Load GUI file into buffer
 */
static int load_gui_to_buffer(const char* filepath, char* buffer, int buffer_size) {
    if (filepath && buffer && buffer_size > 0) {
        return gui_loader_load(filepath, buffer, buffer_size);
    }
    return -1;
}

/**
 * Create default result
 */
static MemoryStrategyResult create_result(MemoryStrategyLevel level, bool success, 
                                          uint32_t gui_size, const char* location,
                                          const char* error = nullptr) {
    MemoryStrategyResult result = {0};
    result.level = level;
    result.success = success;
    result.gui_size = gui_size;
    result.storage_location = location;
    result.error_message = error;
    return result;
}

/**
 * Create error result
 */
static MemoryStrategyResult create_error_result(MemoryStrategyLevel level, 
                                                  const char* error, 
                                                  uint32_t gui_size = 0) {
    return create_result(level, false, gui_size, "None", error);
}

// ============================================================================
// Public Functions
// ============================================================================

void gui_memory_strategy_init(SPISRAM* sram, SDCard* sdcard, TFT_ST7789* tft) {
    strategy_sram = sram;
    strategy_sdcard = sdcard;
    strategy_tft = tft;
    
    // Initialize external RAM loader if SRAM is provided
    if (sram) {
        gui_external_ram_init(sram);
    }
    
    // Allocate SD swap cache
    sd_swap_cache = (uint8_t*)malloc(SD_SWAP_CACHE_SIZE);
    if (sd_swap_cache) {
        gui_memory_strategy_sd_swap_init(sd_swap_cache);
    }
    
    current_strategy = MEMORY_STRATEGY_INTERNAL_RAM;
    gui_loaded = false;
}

MemoryStrategyResult gui_memory_strategy_load(const char* filepath) {
    if (!filepath) {
        return create_error_result(MEMORY_STRATEGY_FAILED, "Invalid filepath");
    }
    
    // Get GUI size
    int gui_size = get_gui_size(filepath);
    if (gui_size < 0) {
        return create_error_result(MEMORY_STRATEGY_FAILED, "Cannot determine GUI size");
    }
    
    // Select strategy
    bool sram_avail = (strategy_sram != nullptr);
    bool sdcard_avail = (strategy_sdcard != nullptr && strategy_sdcard->isPresent());
    
    MemoryStrategyLevel level = gui_memory_strategy_select(gui_size, sram_avail, sdcard_avail);
    
    // Try strategies in order
    MemoryStrategyResult result;
    
    switch (level) {
        case MEMORY_STRATEGY_EXTERNAL_RAM:
            result = gui_memory_strategy_external_ram(filepath);
            if (result.success) {
                current_strategy = MEMORY_STRATEGY_EXTERNAL_RAM;
                gui_loaded = true;
                return result;
            }
            // Fall through to next strategy
            
        case MEMORY_STRATEGY_SD_SWAP:
            result = gui_memory_strategy_sd_swap(filepath);
            if (result.success) {
                current_strategy = MEMORY_STRATEGY_SD_SWAP;
                gui_loaded = true;
                return result;
            }
            // Fall through to next strategy
            
        case MEMORY_STRATEGY_INTERNAL_RAM:
            result = gui_memory_strategy_internal_ram(filepath);
            if (result.success) {
                current_strategy = MEMORY_STRATEGY_INTERNAL_RAM;
                gui_loaded = true;
                return result;
            }
            return create_error_result(MEMORY_STRATEGY_FAILED, 
                                        "All memory strategies failed");
            
        default:
            return create_error_result(MEMORY_STRATEGY_FAILED, 
                                        "No valid memory strategy available");
    }
}

MemoryStrategyResult gui_memory_strategy_load_json(const char* json) {
    if (!json) {
        return create_error_result(MEMORY_STRATEGY_FAILED, "Invalid JSON");
    }
    
    uint32_t gui_size = strlen(json);
    bool sram_avail = (strategy_sram != nullptr);
    bool sdcard_avail = (strategy_sdcard != nullptr && strategy_sdcard->isPresent());
    
    MemoryStrategyLevel level = gui_memory_strategy_select(gui_size, sram_avail, sdcard_avail);
    
    MemoryStrategyResult result;
    
    switch (level) {
        case MEMORY_STRATEGY_EXTERNAL_RAM:
            result = gui_memory_strategy_external_ram_json(json);
            if (result.success) {
                current_strategy = MEMORY_STRATEGY_EXTERNAL_RAM;
                gui_loaded = true;
                return result;
            }
            
        case MEMORY_STRATEGY_SD_SWAP:
            result = gui_memory_strategy_sd_swap_json(json);
            if (result.success) {
                current_strategy = MEMORY_STRATEGY_SD_SWAP;
                gui_loaded = true;
                return result;
            }
            
        case MEMORY_STRATEGY_INTERNAL_RAM:
            result = gui_memory_strategy_internal_ram_json(json);
            if (result.success) {
                current_strategy = MEMORY_STRATEGY_INTERNAL_RAM;
                gui_loaded = true;
                return result;
            }
            
        default:
            return create_error_result(MEMORY_STRATEGY_FAILED, 
                                        "All memory strategies failed");
    }
}

MemoryStrategyResult gui_memory_strategy_load_webdav(const char* filename) {
    if (!filename) {
        return create_error_result(MEMORY_STRATEGY_FAILED, "Invalid filename");
    }
    
    // Load from WebDAV to a temporary buffer
    char buffer[GUI_LOADER_MAX_SIZE + 1];
    int bytes_read = gui_loader_load_from_webdav(filename, buffer, GUI_LOADER_MAX_SIZE);
    
    if (bytes_read <= 0) {
        return create_error_result(MEMORY_STRATEGY_FAILED, 
                                    "Cannot load from WebDAV");
    }
    
    buffer[bytes_read] = '\0';
    return gui_memory_strategy_load_json(buffer);
}

// ============================================================================
// Strategy Selection
// ============================================================================

MemoryStrategyLevel gui_memory_strategy_select(uint32_t gui_size, 
                                                bool sram_available, 
                                                bool sdcard_available) {
    // Priority 1: External RAM (if available and GUI is large enough)
    if (sram_available && gui_size >= MEMORY_STRATEGY_EXTERNAL_RAM_MIN_SIZE) {
        if (gui_memory_strategy_can_use_external_ram(gui_size)) {
            return MEMORY_STRATEGY_EXTERNAL_RAM;
        }
    }
    
    // Priority 2: SD Card Swap (if SD card available and GUI is large)
    if (sdcard_available && gui_size >= MEMORY_STRATEGY_SD_SWAP_MIN_SIZE) {
        if (gui_memory_strategy_can_use_sd_swap(gui_size)) {
            return MEMORY_STRATEGY_SD_SWAP;
        }
    }
    
    // Priority 3: Internal RAM (if GUI is small enough)
    if (gui_memory_strategy_can_use_internal_ram(gui_size)) {
        return MEMORY_STRATEGY_INTERNAL_RAM;
    }
    
    // If we get here, all strategies failed
    return MEMORY_STRATEGY_FAILED;
}

bool gui_memory_strategy_can_use_external_ram(uint32_t gui_size) {
    if (!strategy_sram) return false;
    return gui_size <= GUI_EXTERNAL_RAM_MAX_SIZE &&
           gui_external_ram_has_space(strategy_sram, gui_size);
}

bool gui_memory_strategy_can_use_sd_swap(uint32_t gui_size) {
    if (!strategy_sdcard || !strategy_sdcard->isPresent()) return false;
    return gui_size > 0;  // Any size can use SD swap
}

bool gui_memory_strategy_can_use_internal_ram(uint32_t gui_size) {
    return gui_size <= MEMORY_STRATEGY_INTERNAL_RAM_MAX_SIZE &&
           gui_memory_has_enough_memory((const char*)"dummy");  // Quick check
}

// ============================================================================
// Strategy Implementations
// ============================================================================

// --- External RAM Strategy ---

MemoryStrategyResult gui_memory_strategy_external_ram(const char* filepath) {
    if (!strategy_sram) {
        return create_error_result(MEMORY_STRATEGY_EXTERNAL_RAM, 
                                    "External RAM not configured");
    }
    
    if (!filepath) {
        return create_error_result(MEMORY_STRATEGY_EXTERNAL_RAM, 
                                    "Invalid filepath");
    }
    
    int file_size = get_gui_size(filepath);
    if (file_size <= 0) {
        return create_error_result(MEMORY_STRATEGY_EXTERNAL_RAM, 
                                    "Cannot read file");
    }
    
    // Clear external RAM
    gui_external_ram_clear(strategy_sram);
    
    // Load into external RAM
    if (gui_external_ram_load_from_sd(filepath, strategy_sram)) {
        uint32_t gui_size = gui_external_ram_get_gui_size(strategy_sram);
        MemoryStrategyResult result = create_result(
            MEMORY_STRATEGY_EXTERNAL_RAM, true, gui_size, "External RAM"
        );
        result.data.external_ram.sram = strategy_sram;
        result.data.external_ram.sram_addr = GUI_EXTERNAL_RAM_BASE_ADDR;
        result.memory_used = gui_size + 4;  // +4 for length header
        return result;
    }
    
    return create_error_result(MEMORY_STRATEGY_EXTERNAL_RAM, 
                                "Failed to load into external RAM");
}

MemoryStrategyResult gui_memory_strategy_external_ram_json(const char* json) {
    if (!strategy_sram) {
        return create_error_result(MEMORY_STRATEGY_EXTERNAL_RAM, 
                                    "External RAM not configured");
    }
    
    if (!json) {
        return create_error_result(MEMORY_STRATEGY_EXTERNAL_RAM, 
                                    "Invalid JSON");
    }
    
    // Clear external RAM
    gui_external_ram_clear(strategy_sram);
    
    // Load JSON into external RAM
    if (gui_external_ram_load_from_string(json, strategy_sram)) {
        uint32_t gui_size = strlen(json);
        MemoryStrategyResult result = create_result(
            MEMORY_STRATEGY_EXTERNAL_RAM, true, gui_size, "External RAM"
        );
        result.data.external_ram.sram = strategy_sram;
        result.data.external_ram.sram_addr = GUI_EXTERNAL_RAM_BASE_ADDR;
        result.memory_used = gui_size + 4;
        return result;
    }
    
    return create_error_result(MEMORY_STRATEGY_EXTERNAL_RAM, 
                                "Failed to load into external RAM");
}

void* gui_memory_strategy_get_from_external_ram(SPISRAM* sram, uint32_t addr) {
    if (!sram) sram = strategy_sram;
    if (!sram) return nullptr;
    return gui_external_ram_parse(sram, addr);
}

// --- SD Card Swap Strategy ---

// SD swap state
static const char* sd_swap_filepath = nullptr;
static uint32_t sd_swap_file_size = 0;

MemoryStrategyResult gui_memory_strategy_sd_swap(const char* filepath) {
    if (!strategy_sdcard || !strategy_sdcard->isPresent()) {
        return create_error_result(MEMORY_STRATEGY_SD_SWAP, 
                                    "SD card not available");
    }
    
    if (!filepath) {
        return create_error_result(MEMORY_STRATEGY_SD_SWAP, 
                                    "Invalid filepath");
    }
    
    int file_size = get_gui_size(filepath);
    if (file_size <= 0) {
        return create_error_result(MEMORY_STRATEGY_SD_SWAP, 
                                    "Cannot read file");
    }
    
    // Store filepath for later reference
    sd_swap_filepath = filepath;
    sd_swap_file_size = file_size;
    
    // For SD swap, we load the GUI into a cache in internal RAM
    // and parse it from there. The JSON stays on SD card.
    char* json_buffer = (char*)malloc(file_size + 1);
    if (!json_buffer) {
        return create_error_result(MEMORY_STRATEGY_SD_SWAP, 
                                    "Cannot allocate buffer for SD swap");
    }
    
    int bytes_read = load_gui_to_buffer(filepath, json_buffer, file_size);
    if (bytes_read <= 0) {
        free(json_buffer);
        return create_error_result(MEMORY_STRATEGY_SD_SWAP, 
                                    "Cannot load file into cache");
    }
    
    json_buffer[bytes_read] = '\0';
    
    // Parse from cache (which is in internal RAM)
    void* gui = gui_loader_parse_json(json_buffer);
    
    MemoryStrategyResult result;
    if (gui) {
        result = create_result(MEMORY_STRATEGY_SD_SWAP, true, file_size, "SD Card Swap");
        result.data.sd_swap.filepath = filepath;
        result.data.sd_swap.cache_addr = (uint32_t)json_buffer;
        result.data.sd_swap.cache_size = file_size;
        result.memory_used = file_size;  // Cache size
        // Don't free buffer - it's used for the GUI
    } else {
        free(json_buffer);
        result = create_error_result(MEMORY_STRATEGY_SD_SWAP, 
                                      "Failed to parse GUI");
    }
    
    return result;
}

MemoryStrategyResult gui_memory_strategy_sd_swap_json(const char* json) {
    if (!strategy_sdcard || !strategy_sdcard->isPresent()) {
        return create_error_result(MEMORY_STRATEGY_SD_SWAP, 
                                    "SD card not available");
    }
    
    if (!json) {
        return create_error_result(MEMORY_STRATEGY_SD_SWAP, 
                                    "Invalid JSON");
    }
    
    // Store JSON temporarily on SD card for swap
    const char* temp_path = "/tmp/gui_swap.json";
    
    if (!gui_loader_save(temp_path, json, strlen(json))) {
        return create_error_result(MEMORY_STRATEGY_SD_SWAP, 
                                    "Cannot save to SD card for swap");
    }
    
    // Now load from SD card (using the swap mechanism)
    return gui_memory_strategy_sd_swap(temp_path);
}

bool gui_memory_strategy_sd_swap_init(uint8_t* cache_buffer) {
    if (!cache_buffer) return false;
    sd_swap_cache = cache_buffer;
    return true;
}

void gui_memory_strategy_sd_swap_flush() {
    if (sd_swap_cache) {
        memset(sd_swap_cache, 0, SD_SWAP_CACHE_SIZE);
    }
}

// --- Internal RAM Strategy ---

MemoryStrategyResult gui_memory_strategy_internal_ram(const char* filepath) {
    if (!filepath) {
        return create_error_result(MEMORY_STRATEGY_INTERNAL_RAM, 
                                    "Invalid filepath");
    }
    
    int file_size = get_gui_size(filepath);
    if (file_size <= 0) {
        return create_error_result(MEMORY_STRATEGY_INTERNAL_RAM, 
                                    "Cannot read file");
    }
    
    // Check memory before loading
    if (!gui_memory_strategy_can_use_internal_ram(file_size)) {
        return create_error_result(MEMORY_STRATEGY_INTERNAL_RAM, 
                                    "GUI too large for internal RAM");
    }
    
    // Load with memory check
    void* gui = gui_loader_load_with_memory_check(filepath, strategy_tft);
    
    if (gui) {
        MemoryStrategyResult result = create_result(
            MEMORY_STRATEGY_INTERNAL_RAM, true, file_size, "Internal RAM"
        );
        result.data.internal_ram.gui_ptr = gui;
        result.memory_used = file_size + 256;  // JSON + parsing overhead
        return result;
    }
    
    return create_error_result(MEMORY_STRATEGY_INTERNAL_RAM, 
                                "Memory check failed or parsing error");
}

MemoryStrategyResult gui_memory_strategy_internal_ram_json(const char* json) {
    if (!json) {
        return create_error_result(MEMORY_STRATEGY_INTERNAL_RAM, 
                                    "Invalid JSON");
    }
    
    uint32_t json_size = strlen(json);
    
    // Check memory before loading
    if (!gui_memory_strategy_can_use_internal_ram(json_size)) {
        return create_error_result(MEMORY_STRATEGY_INTERNAL_RAM, 
                                    "JSON too large for internal RAM");
    }
    
    // Load with memory check
    void* gui = gui_loader_load_with_memory_check(json, strategy_tft);
    
    if (gui) {
        MemoryStrategyResult result = create_result(
            MEMORY_STRATEGY_INTERNAL_RAM, true, json_size, "Internal RAM"
        );
        result.data.internal_ram.gui_ptr = gui;
        result.memory_used = json_size + 256;
        return result;
    }
    
    return create_error_result(MEMORY_STRATEGY_INTERNAL_RAM, 
                                "Memory check failed or parsing error");
}

// ============================================================================
// Utility Functions
// ============================================================================

const char* gui_memory_strategy_get_config() {
    static char config[128];
    
    const char* sram_status = strategy_sram ? "Available" : "Not available";
    const char* sdcard_status = (strategy_sdcard && strategy_sdcard->isPresent()) ? "Available" : "Not available";
    const char* tft_status = strategy_tft ? "Available" : "Not available";
    
    snprintf(config, sizeof(config), 
             "External RAM: %s, SD Card: %s, TFT: %s",
             sram_status, sdcard_status, tft_status);
    
    return config;
}

const char* gui_memory_strategy_get_location() {
    switch (current_strategy) {
        case MEMORY_STRATEGY_EXTERNAL_RAM:
            return "External RAM";
        case MEMORY_STRATEGY_SD_SWAP:
            return "SD Card Swap";
        case MEMORY_STRATEGY_INTERNAL_RAM:
            return "Internal RAM";
        default:
            return "None";
    }
}

bool gui_memory_strategy_is_gui_loaded() {
    return gui_loaded;
}

void gui_memory_strategy_unload() {
    // Clear external RAM
    if (strategy_sram && gui_external_ram_has_gui(strategy_sram)) {
        gui_external_ram_clear(strategy_sram);
    }
    
    // Clear SD swap cache
    gui_memory_strategy_sd_swap_flush();
    
    // Note: Internal RAM widgets are managed by widget pools
    // and will be automatically released when no longer referenced
    
    gui_loaded = false;
    current_strategy = MEMORY_STRATEGY_INTERNAL_RAM;
}

void gui_memory_strategy_get_stats(uint32_t* total_ram, uint32_t* used_ram, 
                                    uint32_t* free_ram, MemoryStrategyLevel* strategy) {
    if (total_ram) *total_ram = 0;
    if (used_ram) *used_ram = 0;
    if (free_ram) *free_ram = 0;
    if (strategy) *strategy = current_strategy;
    
    switch (current_strategy) {
        case MEMORY_STRATEGY_EXTERNAL_RAM:
            if (strategy_sram) {
                if (total_ram) *total_ram = strategy_sram->getSize();
                if (used_ram) *used_ram = gui_external_ram_get_usage(strategy_sram);
                if (free_ram) *free_ram = gui_external_ram_get_free_space(strategy_sram);
            }
            break;
            
        case MEMORY_STRATEGY_SD_SWAP:
            // SD swap uses cache in internal RAM
            if (total_ram) *total_ram = SD_SWAP_CACHE_SIZE;
            if (used_ram) *used_ram = sd_swap_file_size;
            if (free_ram) *free_ram = SD_SWAP_CACHE_SIZE - sd_swap_file_size;
            break;
            
        case MEMORY_STRATEGY_INTERNAL_RAM:
            // Internal RAM stats
            if (total_ram) *total_ram = MEMORY_STRATEGY_INTERNAL_RAM_MAX_SIZE;
            if (used_ram) *used_ram = 0;  // Would need to track
            if (free_ram) *free_ram = MEMORY_STRATEGY_INTERNAL_RAM_MAX_SIZE;
            break;
            
        default:
            break;
    }
}

// ============================================================================
// Error Handling
// ============================================================================

void gui_memory_strategy_set_error_callback(void (*callback)(const char* message)) {
    error_callback = callback;
}

void gui_memory_strategy_display_error(TFT_ST7789* tft, const MemoryStrategyResult* result) {
    if (!result || !tft) return;
    
    if (result->success) return;  // No error to display
    
    // Use the TFT error display from memory checker
    GuiMemoryStats stats = {0};
    stats.error_message = result->error_message ? result->error_message : "Unknown error";
    gui_memory_display_error(tft, &stats);
    
    // Also call error callback if set
    if (error_callback && result->error_message) {
        error_callback(result->error_message);
    }
}

// ============================================================================
// Strategy Decision Tree (Explicit)
// ============================================================================

/**
 * Explicit strategy: Try external RAM, else SD swap, else internal RAM
 * This is the main decision logic in a clear format
 * 
 * @param filepath Path to GUI file
 * @return MemoryStrategyResult
 */
MemoryStrategyResult gui_memory_strategy_try_all(const char* filepath) {
    // 1. Try external RAM first
    if (strategy_sram) {
        MemoryStrategyResult result = gui_memory_strategy_external_ram(filepath);
        if (result.success) {
            return result;
        }
    }
    
    // 2. Try SD swap
    if (strategy_sdcard && strategy_sdcard->isPresent()) {
        MemoryStrategyResult result = gui_memory_strategy_sd_swap(filepath);
        if (result.success) {
            return result;
        }
    }
    
    // 3. Try internal RAM
    MemoryStrategyResult result = gui_memory_strategy_internal_ram(filepath);
    if (result.success) {
        return result;
    }
    
    // All strategies failed
    return create_error_result(MEMORY_STRATEGY_FAILED, 
                                "All memory strategies failed");
}

/**
 * Force a specific strategy
 * 
 * @param filepath Path to GUI file
 * @param level Specific strategy to use
 * @return MemoryStrategyResult
 */
MemoryStrategyResult gui_memory_strategy_force(const char* filepath, 
                                                MemoryStrategyLevel level) {
    switch (level) {
        case MEMORY_STRATEGY_EXTERNAL_RAM:
            return gui_memory_strategy_external_ram(filepath);
        case MEMORY_STRATEGY_SD_SWAP:
            return gui_memory_strategy_sd_swap(filepath);
        case MEMORY_STRATEGY_INTERNAL_RAM:
            return gui_memory_strategy_internal_ram(filepath);
        default:
            return create_error_result(MEMORY_STRATEGY_FAILED, 
                                        "Invalid strategy level");
    }
}
