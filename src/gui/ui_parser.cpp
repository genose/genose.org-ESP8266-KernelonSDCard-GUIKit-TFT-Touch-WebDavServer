/**
 * UI Parser Implementation - JSON-based GUI Loader
 *
 * Parses GUI JSON files into widget structures using ArduinoJson
 * Implements the design from docs/discussion_analysis/13_UI_PARSER.md
 * 
 * Generated by Mistral Vibe
 * Date: 2026-08-19
 */

#include "ui_parser.h"
#include "widget.h"
#include "widget_pool.h"
#include "widget_macros.h"
#include "widget_scrollable.h"
#include <ArduinoJson.h>
#include <string.h>
#include <stdlib.h>
#include <stdio.h>  // For strtoul

// ============================================================================
// Static Buffer
// ============================================================================

static char ui_buffer[UI_BUFFER_SIZE + 1];

// ============================================================================
// Callback Registry
// ============================================================================

// Simple callback registry (expandable)
#define MAX_CALLBACKS 10
typedef struct {
    const char* name;
    void (*callback)(void);
} CallbackEntry;

static CallbackEntry callback_registry[MAX_CALLBACKS] = {0};
static uint8_t callback_count = 0;

void ui_register_callback(const char* name, void (*callback)(void)) {
    if (callback_count >= MAX_CALLBACKS) return;
    callback_registry[callback_count].name = name;
    callback_registry[callback_count].callback = callback;
    callback_count++;
}

void (*ui_get_callback(const char* name))(void) {
    for (uint8_t i = 0; i < callback_count; i++) {
        if (callback_registry[i].name && strcmp(callback_registry[i].name, name) == 0) {
            return callback_registry[i].callback;
        }
    }
    return NULL;
}

// ============================================================================
// Initialization
// ============================================================================

bool ui_parser_init(void) {
    pools_init();  // Initialize widget pools
    return true;
}

void ui_parser_shutdown(void) {
    // Nothing to do for now
}

// ============================================================================
// JSON Parsing
// ============================================================================

Widget* ui_parse_json(const char* json) {
    if (!json) return NULL;

    DynamicJsonDocument doc(UI_BUFFER_SIZE);
    DeserializationError error = deserializeJson(doc, json);

    if (error) {
        #ifdef GUIKIT_DEBUG
        Serial.print("JSON parsing error: ");
        Serial.println(error.c_str());
        #endif
        return NULL;
    }

    // Parse root widget
    JsonObject root = doc.as<JsonObject>();
    
    // Check if this is the GUIKit format (with widgets array)
    if (root.containsKey("widgets")) {
        // GUIKit format: root has metadata and widgets array
        JsonArray widgets = root["widgets"];
        if (widgets.size() > 0) {
            // First widget in array is the root
            JsonObject root_widget = widgets[0];
            return ui_parse_widget_object(root_widget, NULL);
        }
        return NULL;
    }
    
    // Direct widget format (simpler)
    return ui_parse_widget_object(root, NULL);
}

Widget* ui_parse_widget_object(JsonObject json, Widget* parent) {
    if (!json.containsKey(JSON_KEY_TYPE)) {
        #ifdef GUIKIT_DEBUG
        Serial.println("Error: Missing 'type' in widget");
        #endif
        return NULL;
    }

    const char* type_str = json[JSON_KEY_TYPE];
    WIDGET_TYPE type = ui_string_to_widget_type(type_str);

    Widget* widget = NULL;

    switch (type) {
        case WIDGET_TYPE_VIEW:
            widget = (Widget*)ui_parse_view(json, parent);
            break;
        case WIDGET_TYPE_BUTTON:
            widget = (Widget*)ui_parse_button(json, parent);
            break;
        case WIDGET_TYPE_LABEL:
            widget = (Widget*)ui_parse_label(json, parent);
            break;
        case WIDGET_TYPE_SLIDER:
            widget = (Widget*)ui_parse_slider(json, parent);
            break;
        case WIDGET_TYPE_TEXT_INPUT:
        case WIDGET_TYPE_TEXT_EDITOR:
        case WIDGET_TYPE_MENU:
        default:
            // For unsupported types, create a generic widget
            widget = Widget_new(type);
            break;
    }

    if (!widget) return NULL;

    // Parse common properties
    ui_parse_common_properties(widget, json);

    // Parse children
    if (json.containsKey(JSON_KEY_CHILDREN)) {
        JsonArray children = json[JSON_KEY_CHILDREN];
        for (JsonObject child : children) {
            Widget* child_widget = ui_parse_widget_object(child, widget);
            if (child_widget) {
                Widget_addChild(widget, child_widget);
            }
        }
    }

    return widget;
}

void ui_parse_common_properties(Widget* widget, JsonObject json) {
    if (!widget || !json) return;

    // Position
    if (json.containsKey(JSON_KEY_X)) {
        widget->x = json[JSON_KEY_X];
    }
    if (json.containsKey(JSON_KEY_Y)) {
        widget->y = json[JSON_KEY_Y];
    }

    // Size
    if (json.containsKey(JSON_KEY_WIDTH)) {
        widget->width = json[JSON_KEY_WIDTH];
    }
    if (json.containsKey(JSON_KEY_HEIGHT)) {
        widget->height = json[JSON_KEY_HEIGHT];
    }

    // Text
    if (json.containsKey(JSON_KEY_TEXT)) {
        const char* text = json[JSON_KEY_TEXT];
        Widget_setText(widget, text);
    }

    // Background color (parse hex string like "#1E1E1E")
    if (json.containsKey("background")) {
        const char* bg_str = json["background"];
        if (bg_str && bg_str[0] == '#') {
            // Simple hex to RGB565 conversion (basic implementation)
            uint32_t rgb = strtoul(bg_str + 1, NULL, 16);
            uint16_t r = (rgb >> 16) & 0xFF;
            uint16_t g = (rgb >> 8) & 0xFF;
            uint16_t b = rgb & 0xFF;
            // Convert RGB888 to RGB565
            widget->bg_color = ((r >> 3) << 11) | ((g >> 2) << 5) | (b >> 3);
        }
    }

    // Border color
    if (json.containsKey("border_color")) {
        const char* border_str = json["border_color"];
        if (border_str && border_str[0] == '#') {
            uint32_t rgb = strtoul(border_str + 1, NULL, 16);
            uint16_t r = (rgb >> 16) & 0xFF;
            uint16_t g = (rgb >> 8) & 0xFF;
            uint16_t b = rgb & 0xFF;
            widget->border_color = ((r >> 3) << 11) | ((g >> 2) << 5) | (b >> 3);
        }
    }

    // Border width
    if (json.containsKey("border_width")) {
        widget->border_width = json["border_width"];
    }

    // Note: Additional properties like text_color, text_size, etc. 
    // would be handled by widget-specific parsers or style system
}

// ============================================================================
// Type-specific Parsers
// ============================================================================

Widget* ui_parse_view(JsonObject json, Widget* parent) {
    WidgetView* view = View_new();
    if (!view) return NULL;
    
    // Parse scrollable flag (0-3: none, x, y, both)
    if (json.containsKey("scrollable")) {
        int scrollable = json["scrollable"];
        switch (scrollable) {
            case 1:  // X only
                widget_setScrollable((Widget*)view, SCROLLABLE_X);
                break;
            case 2:  // Y only
                widget_setScrollable((Widget*)view, SCROLLABLE_Y);
                break;
            case 3:  // Both
                widget_setScrollable((Widget*)view, SCROLLABLE_BOTH);
                break;
            default:  // 0 or invalid - not scrollable
                widget_setScrollable((Widget*)view, SCROLLABLE_NONE);
                break;
        }
    }
    
    return (Widget*)view;
}

WidgetButton* ui_parse_button(JsonObject json, Widget* parent) {
    WidgetButton* button = Button_new();
    if (!button) return NULL;

    // Button-specific properties
    if (json.containsKey(JSON_KEY_TEXT)) {
        const char* text = json[JSON_KEY_TEXT];
        Widget_setText((Widget*)button, text);
    }

    // Parse callback (if present) - supports both "callback" and "action"
    if (json.containsKey(JSON_KEY_CALLBACK)) {
        const char* callback_name = json[JSON_KEY_CALLBACK];
        button->onClick = ui_get_callback(callback_name);
    } else if (json.containsKey("action")) {
        const char* action_name = json["action"];
        button->onClick = ui_get_callback(action_name);
    }

    // Disabled state
    if (json.containsKey("disabled")) {
        button->base.visible = !json["disabled"];  // Invert: disabled=true means not visible/interactive
    }

    return button;
}

WidgetLabel* ui_parse_label(JsonObject json, Widget* parent) {
    WidgetLabel* label = Label_new();
    if (!label) return NULL;

    // Label-specific properties
    if (json.containsKey(JSON_KEY_TEXT)) {
        const char* text = json[JSON_KEY_TEXT];
        Widget_setText((Widget*)label, text);
    }

    return label;
}

WidgetSlider* ui_parse_slider(JsonObject json, Widget* parent) {
    uint16_t min_val = 0;
    uint16_t max_val = 100;
    uint16_t value = 50;
    bool vertical = false;

    if (json.containsKey(JSON_KEY_MIN)) min_val = json[JSON_KEY_MIN];
    if (json.containsKey(JSON_KEY_MAX)) max_val = json[JSON_KEY_MAX];
    if (json.containsKey(JSON_KEY_VALUE)) value = json[JSON_KEY_VALUE];
    if (json.containsKey("vertical")) vertical = json["vertical"];

    WidgetSlider* slider = Slider_new();
    if (!slider) return NULL;

    Slider_setRange(slider, min_val, max_val);
    Slider_setValue(slider, value);
    Slider_setVertical(slider, vertical);

    return slider;
}

// ============================================================================
// Type Conversion
// ============================================================================

WIDGET_TYPE ui_string_to_widget_type(const char* str) {
    if (!str) return WIDGET_TYPE_VIEW;

    if (strcmp(str, "view") == 0) return WIDGET_TYPE_VIEW;
    if (strcmp(str, "button") == 0) return WIDGET_TYPE_BUTTON;
    if (strcmp(str, "label") == 0) return WIDGET_TYPE_LABEL;
    if (strcmp(str, "slider") == 0) return WIDGET_TYPE_SLIDER;
    if (strcmp(str, "text_input") == 0) return WIDGET_TYPE_TEXT_INPUT;
    if (strcmp(str, "text_editor") == 0) return WIDGET_TYPE_TEXT_EDITOR;
    if (strcmp(str, "menu") == 0) return WIDGET_TYPE_MENU;

    return WIDGET_TYPE_VIEW;
}

const char* ui_widget_type_to_string(WIDGET_TYPE type) {
    switch (type) {
        case WIDGET_TYPE_VIEW: return "view";
        case WIDGET_TYPE_BUTTON: return "button";
        case WIDGET_TYPE_LABEL: return "label";
        case WIDGET_TYPE_SLIDER: return "slider";
        case WIDGET_TYPE_TEXT_INPUT: return "text_input";
        case WIDGET_TYPE_TEXT_EDITOR: return "text_editor";
        case WIDGET_TYPE_MENU: return "menu";
        default: return "unknown";
    }
}

// ============================================================================
// JSON Generation
// ============================================================================

char* ui_to_json(Widget* root) {
    if (!root) return NULL;

    DynamicJsonDocument doc(UI_BUFFER_SIZE);
    JsonObject json = doc.to<JsonObject>();

    ui_widget_to_json(root, json);

    char* result = (char*)malloc(UI_BUFFER_SIZE + 1);
    if (!result) return NULL;

    serializeJson(doc, result, UI_BUFFER_SIZE);
    return result;
}

void ui_widget_to_json(Widget* widget, JsonObject json) {
    if (!widget || !json) return;

    // Type
    const char* type_str = ui_widget_type_to_string(widget->type);
    json[JSON_KEY_TYPE] = type_str;

    // Position
    json[JSON_KEY_X] = widget->x;
    json[JSON_KEY_Y] = widget->y;

    // Size
    json[JSON_KEY_WIDTH] = widget->width;
    json[JSON_KEY_HEIGHT] = widget->height;

    // Text
    const char* text = Widget_getText(widget);
    if (text && text[0] != '\0') {
        json[JSON_KEY_TEXT] = text;
    }

    // Type-specific properties
    switch (widget->type) {
        case WIDGET_TYPE_BUTTON: {
            WidgetButton* button = (WidgetButton*)widget;
            // Button-specific: callback
            if (button->onClick) {
                // Would need reverse lookup - skip for now
            }
            break;
        }
        case WIDGET_TYPE_SLIDER: {
            WidgetSlider* slider = (WidgetSlider*)widget;
            json[JSON_KEY_MIN] = slider->min_value;
            json[JSON_KEY_MAX] = slider->max_value;
            json[JSON_KEY_VALUE] = slider->value;
            json["vertical"] = slider->vertical;
            break;
        }
    }

    // Children
    if (widget->children_count > 0) {
        JsonArray children = json.createNestedArray(JSON_KEY_CHILDREN);
        for (uint8_t i = 0; i < widget->children_count; i++) {
            JsonObject child_json = children.createNestedObject();
            ui_widget_to_json(widget->children[i], child_json);
        }
    }
}

// ============================================================================
// UI Loading
// ============================================================================

Widget* ui_load_from_sd(const char* filename) {
    if (!filename) return NULL;

    // Try to load from SD card
    // Note: Actual SD card implementation depends on the platform
    // This is a placeholder that should be adapted to the actual SD library

    // For now, we'll assume the file is loaded into ui_buffer
    // In practice, you would use SD.open(), SD.read(), etc.

    // Mock: Return NULL to indicate not implemented
    // Real implementation would read file and call ui_parse_json
    return NULL;
}

Widget* ui_load_from_buffer(const char* json_data) {
    if (!json_data) return NULL;
    return ui_parse_json(json_data);
}

// ============================================================================
// UI Freeing
// ============================================================================

void ui_free(Widget* root) {
    if (!root) return;
    Widget_delete(root);
}

// ============================================================================
// Validation
// ============================================================================

bool ui_validate_json(const char* json) {
    if (!json || strlen(json) == 0) {
        return false;
    }

    // Check for basic required structure
    DynamicJsonDocument doc(UI_BUFFER_SIZE);
    DeserializationError error = deserializeJson(doc, json);

    if (error) {
        return false;
    }

    JsonObject root = doc.as<JsonObject>();

    // Must have type
    if (!root.containsKey(JSON_KEY_TYPE)) {
        return false;
    }

    // Check type is valid
    const char* type_str = root[JSON_KEY_TYPE];
    if (!type_str || ui_string_to_widget_type(type_str) == WIDGET_TYPE_COUNT) {
        return false;
    }

    return true;
}

// ============================================================================
// Integration with gui_loader_parse_json
// ============================================================================

// This function can be used by gui_loader_memory_safe.cpp and others
// It wraps the ArduinoJson parsing with memory-safe checks

extern "C" {

void* gui_loader_parse_json(const char* json) {
    // Ensure pools are initialized
    static bool pools_initialized = false;
    if (!pools_initialized) {
        pools_init();
        pools_initialized = true;
    }

    // Parse using ArduinoJson
    Widget* root = ui_parse_json(json);
    
    // Validate
    if (!root) {
        #ifdef GUIKIT_DEBUG
        Serial.println("Error: Failed to parse JSON");
        #endif
        return NULL;
    }

    return (void*)root;
}

}
