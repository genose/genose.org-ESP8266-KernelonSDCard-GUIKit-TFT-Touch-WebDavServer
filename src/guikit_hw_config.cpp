/**
 * GUIKit Hardware Configuration Implementation
 * 
 * Implementation of configuration functions for GUIKit
 * 
 * Generated by Mistral Vibe
 * Date: 2026-08-15
 */

#include "guikit_hw_config.h"
#include <string.h>
#include <stdio.h>

// ============================================================================
// Default Configurations
// ============================================================================

// Default for both platforms
const guikit_hw_config_t GUIKIT_HW_DEFAULT = {
    .is_esp8266 = GUIKIT_PLATFORM_ESP8266,
    .is_esp32 = GUIKIT_PLATFORM_ESP32,
    .ram = {
        .internal = true,
        .bank_count = 0,
        .bank = {0}
    },
    .spi = {
        .expander = false,
        .bank_count = 0,
        .bank = {0},
        .sck_pin = 14,
        .mosi_pin = 13,
        .miso_pin = 12,
        .max_speed_mhz = 20
    },
    .display = {320, 240, 16, false},
    .memory_strategy = GUIKIT_MEMORY_STRATEGY_DEFAULT,
    .use_sd_card = true,
    .use_webdav = false,
    .debug_mode = false
};

// ESP8266 specific defaults
const guikit_hw_config_t GUIKIT_HW_ESP8266_DEFAULT = {
    .is_esp8266 = true,
    .is_esp32 = false,
    .ram = {
        .internal = true,
        .bank_count = 0,
        .bank = {0}
    },
    .spi = {
        .expander = false,
        .bank_count = 3,
        .bank = {
            {GUIKIT_SPI_DEVICE, GUIKIT_EXPANDER_NONE, 15, 255, true},  // TFT on D8
            {GUIKIT_SPI_DEVICE, GUIKIT_EXPANDER_NONE, 4, 255, true},   // Touch on D2
            {GUIKIT_SPI_DEVICE, GUIKIT_EXPANDER_NONE, 5, 255, true}    // SD on D1
        },
        .sck_pin = 14,   // D5
        .mosi_pin = 13,  // D7
        .miso_pin = 12,  // D6
        .max_speed_mhz = 20
    },
    .display = {320, 240, 16, false},
    .memory_strategy = GUIKIT_MEMORY_STRATEGY_DEFAULT,
    .use_sd_card = true,
    .use_webdav = false,
    .debug_mode = false
};

// ESP32 specific defaults  
const guikit_hw_config_t GUIKIT_HW_ESP32_DEFAULT = {
    .is_esp8266 = false,
    .is_esp32 = true,
    .ram = {
        .internal = true,
        .bank_count = 0,
        .bank = {0}
    },
    .spi = {
        .expander = false,
        .bank_count = 3,
        .bank = {
            {GUIKIT_SPI_DEVICE, GUIKIT_EXPANDER_NONE, 5, 255, true},   // TFT
            {GUIKIT_SPI_DEVICE, GUIKIT_EXPANDER_NONE, 21, 255, true},  // Touch
            {GUIKIT_SPI_DEVICE, GUIKIT_EXPANDER_NONE, 22, 255, true}   // SD
        },
        .sck_pin = 18,
        .mosi_pin = 23,
        .miso_pin = 19,
        .max_speed_mhz = 40
    },
    .display = {320, 240, 16, false},
    .memory_strategy = GUIKIT_MEMORY_STRATEGY_DEFAULT,
    .use_sd_card = true,
    .use_webdav = true,
    .debug_mode = false
};

// ============================================================================
// Helper Functions
// ============================================================================

void guikit_hw_config_init(guikit_hw_config_t* cfg) {
    if (!cfg) return;
    
    // Set platform info
    cfg->is_esp8266 = GUIKIT_PLATFORM_ESP8266;
    cfg->is_esp32 = GUIKIT_PLATFORM_ESP32;
    
    // Initialize RAM config
    cfg->ram.internal = true;
    cfg->ram.bank_count = 0;
    memset(cfg->ram.bank, 0, sizeof(cfg->ram.bank));
    
    // Initialize SPI config
    cfg->spi.expander = false;
    cfg->spi.bank_count = 0;
    memset(cfg->spi.bank, 0, sizeof(cfg->spi.bank));
    
    // SPI bus settings (default for ESP8266)
    cfg->spi.sck_pin = 14;  // D5
    cfg->spi.mosi_pin = 13; // D7
    cfg->spi.miso_pin = 12; // D6
    cfg->spi.max_speed_mhz = 20;
    
    // Display config
    cfg->display.width = 320;
    cfg->display.height = 240;
    cfg->display.color_depth = 16;
    cfg->display.double_buffer = false;
    
    // Memory strategy config
    cfg->memory_strategy = GUIKIT_MEMORY_STRATEGY_DEFAULT;
    
    // System flags
    cfg->use_sd_card = true;
    cfg->use_webdav = false;
    cfg->debug_mode = false;
}

uint32_t guikit_hw_get_external_ram(const guikit_hw_config_t* cfg) {
    if (!cfg) return 0;
    
    uint32_t total = 0;
    for (int i = 0; i < cfg->ram.bank_count; i++) {
        if (cfg->ram.bank[i].enabled && 
            cfg->ram.bank[i].type != GUIKIT_RAM_NONE &&
            cfg->ram.bank[i].type != GUIKIT_RAM_INTERNAL) {
            total += cfg->ram.bank[i].size;
        }
    }
    return total;
}

uint32_t guikit_hw_get_total_ram(const guikit_hw_config_t* cfg) {
    if (!cfg) return 0;
    
    uint32_t total = guikit_hw_get_external_ram(cfg);
    
    // Add internal RAM estimate for ESP8266 (~80KB) and ESP32 (varies)
    if (cfg->ram.internal) {
        if (cfg->is_esp8266) {
            total += 80 * 1024;  // ESP8266 has ~80KB free RAM
        } else if (cfg->is_esp32) {
            total += 320 * 1024; // ESP32 has more internal RAM
        }
    }
    
    return total;
}

uint8_t guikit_hw_count_expanders(const guikit_hw_config_t* cfg) {
    if (!cfg) return 0;
    
    uint8_t count = 0;
    for (int i = 0; i < cfg->spi.bank_count; i++) {
        if (cfg->spi.bank[i].enabled && 
            cfg->spi.bank[i].type == GUIKIT_SPI_EXPANDER) {
            count++;
        }
    }
    return count;
}

uint16_t guikit_hw_get_expander_gpio(const guikit_hw_config_t* cfg) {
    if (!cfg) return 0;
    
    uint16_t total_gpio = 0;
    for (int i = 0; i < cfg->spi.bank_count; i++) {
        if (cfg->spi.bank[i].enabled && 
            cfg->spi.bank[i].type == GUIKIT_SPI_EXPANDER) {
            switch (cfg->spi.bank[i].expander_type) {
                case GUIKIT_EXPANDER_MCP23S17:
                case GUIKIT_EXPANDER_MCP23017:
                    total_gpio += 16;  // 16 GPIO per chip
                    break;
                case GUIKIT_EXPANDER_MCP23S08:
                case GUIKIT_EXPANDER_MCP23008:
                    total_gpio += 8;   // 8 GPIO per chip
                    break;
                default:
                    break;
            }
        }
    }
    return total_gpio;
}

bool guikit_hw_config_validate(const guikit_hw_config_t* cfg) {
    if (!cfg) return false;
    
    // Check platform
    if (cfg->is_esp8266 && cfg->is_esp32) {
        return false;  // Can't be both
    }
    
    // Check SPI bus pins
    if (cfg->spi.sck_pin == cfg->spi.mosi_pin ||
        cfg->spi.sck_pin == cfg->spi.miso_pin ||
        cfg->spi.mosi_pin == cfg->spi.miso_pin) {
        return false;  // SPI pins must be unique
    }
    
    // Check bank counts are within limits
    if (cfg->ram.bank_count > 8 || cfg->spi.bank_count > 8) {
        return false;  // Too many banks
    }
    
    // Validate display
    if (cfg->display.width == 0 || cfg->display.height == 0) {
        return false;
    }
    
    // Validate memory strategy
    if (!guikit_memory_strategy_config_validate(&cfg->memory_strategy)) {
        return false;
    }
    
    return true;
}

void guikit_hw_config_print(const guikit_hw_config_t* cfg) {
    if (!cfg) {
        printf("Configuration: NULL\n");
        return;
    }
    
    printf("GUIKit Hardware Configuration:\n");
    printf("  Platform: %s\n", cfg->is_esp8266 ? "ESP8266" : (cfg->is_esp32 ? "ESP32" : "Unknown"));
    printf("  Internal RAM: %s\n", cfg->ram.internal ? "Yes" : "No");
    printf("  External RAM Banks: %d\n", cfg->ram.bank_count);
    
    for (int i = 0; i < cfg->ram.bank_count; i++) {
        if (cfg->ram.bank[i].enabled) {
            const char* type_name = "";
            switch (cfg->ram.bank[i].type) {
                case GUIKIT_RAM_INTERNAL: type_name = "Internal"; break;
                case GUIKIT_RAM_SRAM: type_name = "SRAM"; break;
                case GUIKIT_RAM_PSRAM: type_name = "PSRAM"; break;
                case GUIKIT_RAM_FRAM: type_name = "FRAM"; break;
                default: type_name = "Unknown"; break;
            }
            printf("    Bank %d: %s, %lu KB, CS=%d\n", 
                   i, type_name, cfg->ram.bank[i].size / 1024, cfg->ram.bank[i].cs_pin);
        }
    }
    
    printf("  SPI Expander: %s\n", cfg->spi.expander ? "Yes" : "No");
    printf("  SPI Banks: %d\n", cfg->spi.bank_count);
    printf("  SPI Pins: SCK=%d, MOSI=%d, MISO=%d, Speed=%d MHz\n",
           cfg->spi.sck_pin, cfg->spi.mosi_pin, cfg->spi.miso_pin, cfg->spi.max_speed_mhz);
    
    printf("  Display: %dx%d, %d bpp, %s buffer\n",
           cfg->display.width, cfg->display.height, cfg->display.color_depth,
           cfg->display.double_buffer ? "Double" : "Single");
    
    printf("  SD Card: %s, WebDAV: %s, Debug: %s\n",
           cfg->use_sd_card ? "Yes" : "No",
           cfg->use_webdav ? "Yes" : "No",
           cfg->debug_mode ? "Yes" : "No");
    
    // Print memory strategy config
    guikit_memory_strategy_config_print(&cfg->memory_strategy);
}

// ============================================================================
// Memory Strategy Configuration Helpers
// ============================================================================

void guikit_memory_strategy_config_init(memory_strategy_config_t* cfg) {
    if (cfg) {
        *cfg = GUIKIT_MEMORY_STRATEGY_DEFAULT;
    }
}

bool guikit_memory_strategy_config_validate(const memory_strategy_config_t* cfg) {
    if (!cfg) return false;
    
    // Check that thresholds make sense
    if (cfg->external_ram_min_size > cfg->external_ram_max_size) {
        return false;
    }
    
    if (cfg->sd_swap_min_size > cfg->external_ram_max_size) {
        return false;  // SD swap should kick in before external RAM max
    }
    
    if (cfg->internal_ram_max_size == 0) {
        return false;  // Must have some internal RAM limit
    }
    
    // Check cache and block sizes are reasonable
    if (cfg->sd_swap_cache_size == 0 || cfg->sd_swap_block_size == 0) {
        return false;
    }
    
    return true;
}

bool guikit_memory_strategy_should_use_external_ram(const memory_strategy_config_t* cfg, uint32_t gui_size) {
    if (!cfg) return false;
    
    return gui_size >= cfg->external_ram_min_size &&
           gui_size <= cfg->external_ram_max_size;
}

bool guikit_memory_strategy_should_use_sd_swap(const memory_strategy_config_t* cfg, uint32_t gui_size) {
    if (!cfg) return false;
    
    return gui_size >= cfg->sd_swap_min_size;
}

bool guikit_memory_strategy_should_use_internal_ram(const memory_strategy_config_t* cfg, uint32_t gui_size) {
    if (!cfg) return false;
    
    return gui_size <= cfg->internal_ram_max_size;
}

MemoryStrategyLevel guikit_memory_strategy_select(const memory_strategy_config_t* cfg,
                                                    uint32_t gui_size, 
                                                    bool sram_available, 
                                                    bool sdcard_available) {
    if (!cfg) return MEMORY_STRATEGY_FAILED;
    
    // Priority 1: External RAM (if available and GUI is large enough)
    if (sram_available && cfg->use_external_ram_by_default &&
        gui_size >= cfg->external_ram_min_size) {
        if (guikit_memory_strategy_should_use_external_ram(cfg, gui_size)) {
            return MEMORY_STRATEGY_EXTERNAL_RAM;
        }
    }
    
    // Priority 2: SD Card Swap (if SD card available and GUI is large)
    if (sdcard_available && cfg->use_sd_swap_by_default &&
        gui_size >= cfg->sd_swap_min_size) {
        if (guikit_memory_strategy_should_use_sd_swap(cfg, gui_size)) {
            return MEMORY_STRATEGY_SD_SWAP;
        }
    }
    
    // Priority 3: Internal RAM (if GUI is small enough)
    if (guikit_memory_strategy_should_use_internal_ram(cfg, gui_size)) {
        return MEMORY_STRATEGY_INTERNAL_RAM;
    }
    
    // If we get here, all strategies failed
    return MEMORY_STRATEGY_FAILED;
}

void guikit_memory_strategy_config_print(const memory_strategy_config_t* cfg) {
    if (!cfg) {
        printf("  Memory Strategy: NULL\n");
        return;
    }
    
    printf("  Memory Strategy:\n");
    printf("    Thresholds: External RAM min=%lu KB, SD swap min=%lu KB, Internal max=%lu KB\n",
           cfg->external_ram_min_size / 1024,
           cfg->sd_swap_min_size / 1024,
           cfg->internal_ram_max_size / 1024);
    printf("    External RAM: base=0x%lX, max=%lu KB\n",
           cfg->external_ram_base_addr,
           cfg->external_ram_max_size / 1024);
    printf("    SD Swap: block=%u B, cache=%u B\n",
           cfg->sd_swap_block_size,
           cfg->sd_swap_cache_size);
    printf("    Flags: external_by_default=%s, sd_swap_by_default=%s, check_memory=%s, display_error=%s\n",
           cfg->use_external_ram_by_default ? "Yes" : "No",
           cfg->use_sd_swap_by_default ? "Yes" : "No",
           cfg->check_memory_before_load ? "Yes" : "No",
           cfg->display_error_on_tft ? "Yes" : "No");
    printf("    Current Strategy: %d (%s)\n",
           cfg->current_strategy,
           cfg->current_strategy == MEMORY_STRATEGY_EXTERNAL_RAM ? "External RAM" :
           cfg->current_strategy == MEMORY_STRATEGY_SD_SWAP ? "SD Swap" :
           cfg->current_strategy == MEMORY_STRATEGY_INTERNAL_RAM ? "Internal RAM" : "Failed");
}
