/**
 * GUIKit Bootloader
 * 
 * Hardware detection and memory strategy initialization at boot
 * Detects: External RAM (SRAM/PSRAM), SPI devices, SD Card, TFT
 * Applies appropriate memory strategy based on available hardware
 * Displays boot information on TFT
 * 
 * Generated by Mistral Vibe
 * Date: 2026-08-15
 */

#include <stdint.h>
#include <stdbool.h>
#include <stdio.h>
#include <string.h>
#include <stdarg.h>
#include "guikit_hw_config.h"
#include "gui_memory_strategy.h"

// Forward declarations for hardware classes
class SPISRAM;
class SDCard;
class TFT_ST7789;

// ============================================================================
// Bootloader Configuration
// ============================================================================

// Bootloader display settings
#define BOOTLOADER_TFT_WIDTH 320
#define BOOTLOADER_TFT_HEIGHT 240
#define BOOTLOADER_TEXT_COLOR 0xFFFF  // White
#define BOOTLOADER_BG_COLOR 0x0000   // Black
#define BOOTLOADER_SUCCESS_COLOR 0x07E0  // Green
#define BOOTLOADER_WARNING_COLOR 0xFFA0  // Orange
#define BOOTLOADER_ERROR_COLOR 0xF800   // Red

// Bootloader timing
#define BOOT_DELAY_MS 100

// ============================================================================
// Hardware Detection Structures
// ============================================================================

// SPI Device Enumeration
typedef enum {
    SPI_DEVICE_NONE = 0,
    SPI_DEVICE_SRAM,
    SPI_DEVICE_PSRAM,
    SPI_DEVICE_SD_CARD,
    SPI_DEVICE_TFT,
    SPI_DEVICE_TOUCH,
    SPI_DEVICE_EXPANDER,
    SPI_DEVICE_FRAM,
    SPI_DEVICE_EEPROM,
    SPI_DEVICE_FLASH,
    SPI_DEVICE_UNKNOWN
} BootSpiDeviceType;

typedef struct {
    BootSpiDeviceType type;
    uint8_t cs_pin;
    uint32_t size;
    const char* type_name;
    uint16_t width;
    uint16_t height;
    guikit_expander_type_t expander_type;
} BootSpiDeviceInfo;

typedef struct {
    bool sram_detected;
    uint32_t sram_size;
    uint8_t sram_cs_pin;
    const char* sram_type;
    
    bool psram_detected;
    uint32_t psram_size;
    
    bool sdcard_detected;
    uint8_t sdcard_cs_pin;
    
    bool tft_detected;
    uint16_t tft_width;
    uint16_t tft_height;
    uint8_t tft_cs_pin;
    
    bool touch_detected;
    uint8_t touch_cs_pin;
    
    uint8_t spi_expander_count;
    uint16_t total_expander_gpio;
    
    bool webdav_available;
    
    // SPI Device Enumeration
    BootSpiDeviceInfo spi_devices[16];
    uint8_t spi_device_count;
    
} BootHardwareInfo;

// ============================================================================
// Bootloader State
// ============================================================================

typedef enum {
    BOOT_STATE_INIT = 0,
    BOOT_STATE_HARDWARE_DETECTION,
    BOOT_STATE_RAM_INITIALIZATION,
    BOOT_STATE_SPI_DETECTION,
    BOOT_STATE_SDCARD_DETECTION,
    BOOT_STATE_TFT_INITIALIZATION,
    BOOT_STATE_MEMORY_STRATEGY_CONFIG,
    BOOT_STATE_MEMORY_STRATEGY_APPLY,
    BOOT_STATE_DISPLAY_RESULTS,
    BOOT_STATE_COMPLETE,
    BOOT_STATE_ERROR
} BootState;

typedef struct {
    BootState current_state;
    BootState last_error_state;
    const char* error_message;
    
    // Hardware detection results
    BootHardwareInfo hardware;
    
    // Memory strategy results
    MemoryStrategyLevel selected_strategy;
    uint32_t available_ram;
    uint32_t available_external_ram;
    uint32_t available_sd_swap;
    
    // Configuration
    guikit_hw_config_t config;
    memory_strategy_config_t memory_config;
    
    // Hardware instances (would be actual objects in real code)
    SPISRAM* sram_instance;
    SDCard* sdcard_instance;
    TFT_ST7789* tft_instance;
    
    // Timing
    uint32_t boot_start_time;
    uint32_t boot_end_time;
    
} BootloaderState;

// ============================================================================
// Kernel Check Functions
// ============================================================================

/**
 * Default kernel paths to check
 */
static const char* KERNEL_PATHS[] = {
    "/kernel.bin",
    "/kernel.gz",
    "/Kernel.bin",
    "/Kernel.gz",
    "/gui/kernel.bin",
    "/gui/kernel.gz",
    NULL
};

/**
 * Minimum kernel size (should be at least a few KB)
 */
#define MIN_KERNEL_SIZE 1024

/**
 * Kernel version string length
 */
#define KERNEL_VERSION_LENGTH 32

/**
 * Check if kernel file exists and is accessible
 */
bool check_kernel_exists(BootloaderState* state, const char* kernel_path) {
    BootHardwareInfo* hw = &state->hardware;
    
    // If no SD card, kernel can't exist on SD card
    if (!hw->sdcard_detected) {
        printf("[KERNEL] No SD Card detected, cannot check for kernel\n");
        return false;
    }
    
    // Mock implementation - in real code, this would check SD card
    // For demo purposes, we'll simulate that kernel.bin exists
    if (strcmp(kernel_path, "/kernel.bin") == 0 || 
        strcmp(kernel_path, "/Kernel.bin") == 0) {
        printf("[KERNEL] Kernel found at: %s\n", kernel_path);
        return true;
    }
    
    printf("[KERNEL] Kernel not found at: %s\n", kernel_path);
    return false;
}

/**
 * Get kernel file size
 */
uint32_t get_kernel_size(BootloaderState* state, const char* kernel_path) {
    BootHardwareInfo* hw = &state->hardware;
    
    if (!hw->sdcard_detected) {
        return 0;
    }
    
    // Mock implementation - return a realistic kernel size
    // In real code, this would read the file size from SD card
    
    // Simulate different kernel sizes based on configuration
    if (hw->sram_detected && hw->sram_size >= 8 * 1024 * 1024) {
        // Large kernel for systems with lots of external RAM
        return 2 * 1024 * 1024;  // 2MB
    } else if (hw->sram_detected) {
        // Medium kernel for systems with external SRAM
        return 256 * 1024;  // 256KB
    } else if (hw->is_esp32) {
        // ESP32 can have larger kernels in internal RAM
        return 512 * 1024;  // 512KB
    } else {
        // ESP8266 with no external RAM - smaller kernel
        return 128 * 1024;  // 128KB
    }
}

/**
 * Check if kernel fits in available RAM
 * 
 * Uses the memory strategy to determine if the kernel can be loaded
 */
bool check_kernel_fits_in_ram(BootloaderState* state, uint32_t kernel_size) {
    BootHardwareInfo* hw = &state->hardware;
    bool sram_avail = hw->sram_detected || hw->psram_detected;
    bool sdcard_avail = hw->sdcard_detected;
    
    printf("[KERNEL] Checking if kernel (%lu KB) fits in RAM...\n", kernel_size / 1024);
    printf("[KERNEL]   Available RAM: %lu KB total\n", state->available_ram / 1024);
    printf("[KERNEL]   External RAM: %s (%lu KB)\n", 
           sram_avail ? "Available" : "Not available", 
           state->available_external_ram / 1024);
    printf("[KERNEL]   SD Card: %s\n", sdcard_avail ? "Available" : "Not available");
    
    // Check strategy 1: External RAM
    if (sram_avail) {
        if (kernel_size <= state->available_external_ram &&
            kernel_size >= state->memory_config.external_ram_min_size) {
            printf("[KERNEL]   Strategy: External RAM can hold kernel\n");
            return true;
        } else {
            printf("[KERNEL]   Strategy: External RAM cannot hold kernel (%lu KB > %lu KB)\n",
                   kernel_size / 1024, state->available_external_ram / 1024);
        }
    } else {
        printf("[KERNEL]   Strategy: External RAM not available\n");
    }
    
    // Check strategy 2: SD Card Swap
    if (sdcard_avail) {
        if (kernel_size >= state->memory_config.sd_swap_min_size) {
            printf("[KERNEL]   Strategy: SD Card Swap can stream kernel\n");
            return true;
        } else {
            printf("[KERNEL]   Strategy: Kernel too small for SD swap (%lu KB < %lu KB)\n",
                   kernel_size / 1024, state->memory_config.sd_swap_min_size / 1024);
        }
    } else {
        printf("[KERNEL]   Strategy: SD Card not available\n");
    }
    
    // Check strategy 3: Internal RAM
    if (kernel_size <= state->memory_config.internal_ram_max_size) {
        printf("[KERNEL]   Strategy: Internal RAM can hold kernel\n");
        return true;
    } else {
        printf("[KERNEL]   Strategy: Internal RAM cannot hold kernel (%lu KB > %lu KB)\n",
               kernel_size / 1024, state->memory_config.internal_ram_max_size / 1024);
    }
    
    printf("[KERNEL]   Result: Kernel does NOT fit in any available RAM\n");
    return false;
}

/**
 * Determine which strategy can load the kernel
 */
MemoryStrategyLevel determine_kernel_strategy(BootloaderState* state, uint32_t kernel_size) {
    BootHardwareInfo* hw = &state->hardware;
    bool sram_avail = hw->sram_detected || hw->psram_detected;
    bool sdcard_avail = hw->sdcard_detected;
    
    // Strategy 1: External RAM
    if (sram_avail && kernel_size <= state->available_external_ram &&
        kernel_size >= state->memory_config.external_ram_min_size) {
        return MEMORY_STRATEGY_EXTERNAL_RAM;
    }
    
    // Strategy 2: SD Card Swap
    if (sdcard_avail && kernel_size >= state->memory_config.sd_swap_min_size) {
        return MEMORY_STRATEGY_SD_SWAP;
    }
    
    // Strategy 3: Internal RAM
    if (kernel_size <= state->memory_config.internal_ram_max_size) {
        return MEMORY_STRATEGY_INTERNAL_RAM;
    }
    
    return MEMORY_STRATEGY_FAILED;
}

/**
 * Check kernel file and update state
 */
bool check_kernel(BootloaderState* state, const char* kernel_path) {
    KernelInfo* kernel = &state->kernel;
    
    // Initialize kernel info
    kernel->found = false;
    kernel->path = kernel_path;
    kernel->size = 0;
    kernel->version = NULL;
    kernel->fits_in_ram = false;
    kernel->required_ram = 0;
    kernel->strategy = MEMORY_STRATEGY_FAILED;
    
    printf("\n");
    printf("[BOOT] Step: Kernel Check\n");
    printf("[KERNEL] Checking for kernel at: %s\n", kernel_path);
    
    // Check if kernel exists
    if (!check_kernel_exists(state, kernel_path)) {
        state->current_state = BOOT_STATE_ERROR;
        state->error_message = "Kernel file not found";
        printf("[KERNEL] ERROR: Kernel not found\n");
        return false;
    }
    
    kernel->found = true;
    
    // Get kernel size
    kernel->size = get_kernel_size(state, kernel_path);
    printf("[KERNEL] Kernel size: %lu KB (%lu bytes)\n", 
           kernel->size / 1024, kernel->size);
    
    if (kernel->size < MIN_KERNEL_SIZE) {
        state->current_state = BOOT_STATE_ERROR;
        state->error_message = "Kernel file too small";
        printf("[KERNEL] ERROR: Kernel file too small (%lu bytes < %d bytes)\n", 
               kernel->size, MIN_KERNEL_SIZE);
        return false;
    }
    
    // Check if kernel fits in RAM
    kernel->fits_in_ram = check_kernel_fits_in_ram(state, kernel->size);
    
    // Determine which strategy can load it
    kernel->strategy = determine_kernel_strategy(state, kernel->size);
    
    // Set required RAM
    kernel->required_ram = kernel->size;
    
    // Set version (mock)
    kernel->version = "1.0.0";
    
    printf("[KERNEL] Kernel check complete\n");
    printf("[KERNEL]   Found: %s\n", kernel->found ? "Yes" : "No");
    printf("[KERNEL]   Size: %lu KB\n", kernel->size / 1024);
    printf("[KERNEL]   Fits in RAM: %s\n", kernel->fits_in_ram ? "Yes" : "No");
    printf("[KERNEL]   Strategy: %s\n",
           kernel->strategy == MEMORY_STRATEGY_EXTERNAL_RAM ? "External RAM" :
           kernel->strategy == MEMORY_STRATEGY_SD_SWAP ? "SD Card Swap" :
           kernel->strategy == MEMORY_STRATEGY_INTERNAL_RAM ? "Internal RAM" : "FAILED");
    
    return kernel->found && kernel->fits_in_ram && 
           kernel->strategy != MEMORY_STRATEGY_FAILED;
}

// ============================================================================
// Hardware Detection Functions (Mock implementations - replace with actual hardware code)
// ============================================================================

/**
 * Detect SPI SRAM (23LC1024) at specified CS pin
 * Returns true if detected, false otherwise
 */
static bool detect_spi_sram(uint8_t cs_pin, uint32_t* size, const char** type) {
    // In a real implementation, this would:
    // 1. Initialize SPI at the specified CS pin
    // 2. Send a read command to the SRAM
    // 3. Check for valid response
    // 4. Read the device ID to determine type and size
    
    // Mock: Simulate detection of 23LC1024 (128KB SRAM)
    if (cs_pin == 16 || cs_pin == 0 || cs_pin == 1 || cs_pin == 2) {
        if (size) *size = 131072;  // 128KB
        if (type) *type = "23LC1024";
        return true;
    }
    
    return false;
}

/**
 * Detect SPI PSRAM at specified CS pin
 * Returns true if detected, false otherwise
 */
static bool detect_spi_psram(uint8_t cs_pin, uint32_t* size) {
    // In a real implementation, this would:
    // 1. Initialize SPI at the specified CS pin
    // 2. Send PSRAM-specific commands
    // 3. Check for valid response
    
    // Mock: Simulate ESP32 PSRAM detection
    if (cs_pin == 255) {  // PSRAM on ESP32 uses internal connection
        if (size) *size = 8 * 1024 * 1024;  // 8MB
        return true;
    }
    
    return false;
}

/**
 * Detect SD Card at specified CS pin
 * Returns true if detected, false otherwise
 */
static bool detect_sd_card(uint8_t cs_pin) {
    // In a real implementation, this would:
    // 1. Initialize SPI at the specified CS pin
    // 2. Send SD card initialization commands
    // 3. Check for valid response
    
    // Mock: SD card is usually at D1 (GPIO 5) on ESP8266
    return (cs_pin == 5);
}

/**
 * Detect TFT display at specified CS pin
 * Returns true if detected, false otherwise
 */
static bool detect_tft(uint8_t cs_pin, uint16_t* width, uint16_t* height) {
    // In a real implementation, this would:
    // 1. Initialize SPI at the specified CS pin
    // 2. Send display-specific commands
    // 3. Read display ID and capabilities
    
    // Mock: TFT is usually at D8 (GPIO 15) on ESP8266
    if (width) *width = BOOTLOADER_TFT_WIDTH;
    if (height) *height = BOOTLOADER_TFT_HEIGHT;
    return (cs_pin == 15);
}

/**
 * Detect Touch controller at specified CS pin
 * Returns true if detected, false otherwise
 */
static bool detect_touch(uint8_t cs_pin) {
    // In a real implementation, this would:
    // 1. Initialize SPI at the specified CS pin
    // 2. Send touch controller commands
    // 3. Check for valid response
    
    // Mock: Touch is usually at D2 (GPIO 4) on ESP8266
    return (cs_pin == 4);
}

/**
 * Detect SPI expander (MCP23S17, etc.) at specified CS pin
 * Returns true if detected, false otherwise
 */
static bool detect_spi_expander(uint8_t cs_pin, guikit_expander_type_t* exp_type) {
    // In a real implementation, this would:
    // 1. Initialize SPI at the specified CS pin
    // 2. Read the device ID
    // 3. Determine expander type
    
    // Mock: Expanders at specific pins
    if (cs_pin == 0 || cs_pin == 1 || cs_pin == 3) {
        if (exp_type) *exp_type = GUIKIT_EXPANDER_MCP23S17;
        return true;
    }
    
    return false;
}

// ============================================================================
// Display Functions (Mock - replace with actual TFT code)
// ============================================================================

/**
 * Initialize TFT display
 */
static bool tft_init(TFT_ST7789** tft, uint8_t cs_pin, uint16_t width, uint16_t height) {
    // In a real implementation, this would initialize the TFT
    // For now, just create a mock instance
    *tft = nullptr;  // Would be new TFT_ST7789(cs_pin, width, height)
    return true;
}

/**
 * Display boot progress message on TFT
 */
static void tft_display_progress(BootloaderState* state, const char* message) {
    if (!state->hardware.tft_detected || !state->tft_instance) {
        return;
    }
    
    static int y_pos = 30;  // Start below the header
    
    // Clear the progress area (simplified - in real code would manage screen properly)
    tft_draw_text(state->tft_instance, 10, y_pos, message, BOOTLOADER_TEXT_COLOR, BOOTLOADER_BG_COLOR);
    y_pos += 15;
    
    // If we reach the bottom, scroll up (simplified)
    if (y_pos > BOOTLOADER_TFT_HEIGHT - 20) {
        y_pos = 30;
        tft_clear(state->tft_instance, BOOTLOADER_BG_COLOR);
        tft_draw_text(state->tft_instance, 10, 10, "GUIKit Bootloader", BOOTLOADER_SUCCESS_COLOR, BOOTLOADER_BG_COLOR);
    }
}

/**
 * Clear TFT screen
 */
static void tft_clear(TFT_ST7789* tft, uint16_t color) {
    // Mock implementation
    (void)tft; (void)color;
}

/**
 * Draw text on TFT
 */
static void tft_draw_text(TFT_ST7789* tft, int x, int y, const char* text, uint16_t color, uint16_t bg_color) {
    // Mock implementation
    (void)tft; (void)x; (void)y; (void)text; (void)color; (void)bg_color;
    printf("[TFT] (%d,%d): %s\n", x, y, text);
}

/**
 * Draw progress bar on TFT
 */
static void tft_draw_progress(TFT_ST7789* tft, int x, int y, int width, int height, int percent, uint16_t color) {
    // Mock implementation
    (void)tft; (void)x; (void)y; (void)width; (void)height; (void)percent; (void)color;
    printf("[TFT] Progress: %d%%\n", percent);
}

// ============================================================================
// Memory Strategy Configuration Based on Detected Hardware
// ============================================================================

/**
 * Configure memory strategy based on detected hardware
 */
static void configure_memory_strategy(BootloaderState* state) {
    BootHardwareInfo* hw = &state->hardware;
    memory_strategy_config_t* cfg = &state->memory_config;
    
    // Initialize with defaults
    *cfg = GUIKIT_MEMORY_STRATEGY_DEFAULT;
    
    // Adjust thresholds based on available hardware
    
    // If we have external RAM (SRAM or PSRAM), use it for larger GUIs
    if (hw->sram_detected || hw->psram_detected) {
        uint32_t total_external = hw->sram_size + hw->psram_size;
        
        // Use external RAM for GUIs larger than 4KB
        cfg->external_ram_min_size = 4096;
        
        // Set max external RAM size based on what's available
        cfg->external_ram_max_size = total_external;
        
        // If we have a lot of external RAM (> 512KB), increase the threshold
        if (total_external > 512 * 1024) {
            cfg->external_ram_min_size = 16384;  // Use external RAM for GUIs > 16KB
        }
        
        // Always try external RAM first
        cfg->use_external_ram_by_default = true;
    } else {
        // No external RAM - disable it
        cfg->use_external_ram_by_default = false;
        cfg->external_ram_min_size = UINT32_MAX;  // Never use
    }
    
    // If we have SD card, enable SD swap
    if (hw->sdcard_detected) {
        cfg->use_sd_swap_by_default = true;
        
        // If we have limited internal RAM (ESP8266), use SD swap for medium-sized GUIs
        // If we have lots of internal RAM (ESP32), only use SD swap for very large GUIs
        #if defined(ESP8266)
            cfg->sd_swap_min_size = 8192;  // Use SD swap for GUIs > 8KB on ESP8266
        #elif defined(ESP32)
            cfg->sd_swap_min_size = 32768;  // Use SD swap for GUIs > 32KB on ESP32
        #else
            cfg->sd_swap_min_size = 16384;  // Default: 16KB
        #endif
    } else {
        // No SD card - disable SD swap
        cfg->use_sd_swap_by_default = false;
        cfg->sd_swap_min_size = UINT32_MAX;  // Never use
    }
    
    // Adjust internal RAM max based on platform
    #if defined(ESP8266)
        // ESP8266 has ~80KB free RAM, reserve some for system
        cfg->internal_ram_max_size = 65536;  // 64KB max for internal RAM
    #elif defined(ESP32)
        // ESP32 has more RAM
        cfg->internal_ram_max_size = 262144;  // 256KB max for internal RAM
    #else
        cfg->internal_ram_max_size = 8192;  // Default: 8KB
    #endif
    
    // Set SD swap cache size based on available internal RAM
    #if defined(ESP8266)
        cfg->sd_swap_cache_size = 2048;  // 2KB cache on ESP8266
    #elif defined(ESP32)
        cfg->sd_swap_cache_size = 8192;  // 8KB cache on ESP32
    #else
        cfg->sd_swap_cache_size = 4096;  // 4KB default
    #endif
    
    // Always check memory before loading
    cfg->check_memory_before_load = true;
    
    // Display errors on TFT if available
    cfg->display_error_on_tft = hw->tft_detected;
}

// ============================================================================
// Hardware Detection and Initialization
// ============================================================================

/**
 * Initialize SPI bus
 */
static bool spi_init(uint8_t sck_pin, uint8_t mosi_pin, uint8_t miso_pin, uint8_t max_speed_mhz) {
    // In a real implementation, this would configure the SPI bus
    printf("[SPI] Initializing: SCK=%d, MOSI=%d, MISO=%d, Speed=%d MHz\n",
           sck_pin, mosi_pin, miso_pin, max_speed_mhz);
    return true;
}

/**
 * Get SPI device type as string
 */
const char* spi_device_type_to_string(BootSpiDeviceType type) {
    switch (type) {
        case SPI_DEVICE_NONE:     return "None";
        case SPI_DEVICE_SRAM:     return "SRAM";
        case SPI_DEVICE_PSRAM:    return "PSRAM";
        case SPI_DEVICE_SD_CARD:  return "SD Card";
        case SPI_DEVICE_TFT:       return "TFT";
        case SPI_DEVICE_TOUCH:    return "Touch";
        case SPI_DEVICE_EXPANDER: return "Expander";
        case SPI_DEVICE_FRAM:     return "FRAM";
        case SPI_DEVICE_EEPROM:   return "EEPROM";
        case SPI_DEVICE_FLASH:    return "Flash";
        case SPI_DEVICE_UNKNOWN:  return "Unknown";
        default:                  return "Unknown";
    }
}

/**
 * Get the number of detected SPI devices
 */
uint8_t get_spi_device_count(BootloaderState* state) {
    return state->hardware.spi_device_count;
}

/**
 * Enumerate all detected SPI devices
 */
const BootSpiDeviceInfo* enumerate_spi_devices(BootloaderState* state) {
    return state->hardware.spi_devices;
}

// ============================================================================
// Hardware Detection and Initialization
// ============================================================================

/**
 * Detect all SPI devices and populate hardware info
 */
static void detect_spi_devices(BootloaderState* state) {
    guikit_spi_config_t* spi_cfg = &state->config.spi;
    BootHardwareInfo* hw = &state->hardware;
    
    // Initialize SPI device enumeration
    hw->spi_device_count = 0;
    
    // Initialize SPI bus
    if (!spi_init(spi_cfg->sck_pin, spi_cfg->mosi_pin, spi_cfg->miso_pin, spi_cfg->max_speed_mhz)) {
        state->current_state = BOOT_STATE_ERROR;
        state->error_message = "Failed to initialize SPI bus";
        return;
    }
    
    printf("[SPI] Enumerating devices on bus: SCK=%d, MOSI=%d, MISO=%d, Speed=%d MHz\n",
           spi_cfg->sck_pin, spi_cfg->mosi_pin, spi_cfg->miso_pin, spi_cfg->max_speed_mhz);
    
    // Detect each SPI device in the configuration
    for (int i = 0; i < spi_cfg->bank_count; i++) {
        guikit_spi_bank_t* bank = &spi_cfg->bank[i];
        
        if (!bank->enabled) continue;
        
        // Try to detect SRAM
        uint32_t sram_size;
        const char* sram_type;
        if (detect_spi_sram(bank->cs_pin, &sram_size, &sram_type)) {
            hw->sram_detected = true;
            hw->sram_size = sram_size;
            hw->sram_cs_pin = bank->cs_pin;
            hw->sram_type = sram_type;
            
            // Add to SPI device enumeration
            BootSpiDeviceInfo* device = &hw->spi_devices[hw->spi_device_count++];
            device->type = SPI_DEVICE_SRAM;
            device->cs_pin = bank->cs_pin;
            device->size = sram_size;
            device->type_name = sram_type;
            
            printf("[SPI] SRAM detected at CS %d: %s, %lu KB\n", bank->cs_pin, sram_type, sram_size / 1024);
            continue;  // This bank is SRAM, skip other checks
        }
        
        // Try to detect PSRAM
        uint32_t psram_size;
        if (detect_spi_psram(bank->cs_pin, &psram_size)) {
            hw->psram_detected = true;
            hw->psram_size = psram_size;
            
            // Add to SPI device enumeration
            BootSpiDeviceInfo* device = &hw->spi_devices[hw->spi_device_count++];
            device->type = SPI_DEVICE_PSRAM;
            device->cs_pin = bank->cs_pin;
            device->size = psram_size;
            device->type_name = "PSRAM";
            
            printf("[SPI] PSRAM detected at CS %d: %lu KB\n", bank->cs_pin, psram_size / 1024);
            continue;  // This bank is PSRAM, skip other checks
        }
        
        // Try to detect SD Card
        if (detect_sd_card(bank->cs_pin)) {
            hw->sdcard_detected = true;
            hw->sdcard_cs_pin = bank->cs_pin;
            
            // Add to SPI device enumeration
            BootSpiDeviceInfo* device = &hw->spi_devices[hw->spi_device_count++];
            device->type = SPI_DEVICE_SD_CARD;
            device->cs_pin = bank->cs_pin;
            device->type_name = "SD Card";
            
            printf("[SPI] SD Card detected at CS %d\n", bank->cs_pin);
            continue;  // This bank is SD Card, skip other checks
        }
        
        // Try to detect TFT
        uint16_t tft_w, tft_h;
        if (detect_tft(bank->cs_pin, &tft_w, &tft_h)) {
            hw->tft_detected = true;
            hw->tft_width = tft_w;
            hw->tft_height = tft_h;
            hw->tft_cs_pin = bank->cs_pin;
            
            // Add to SPI device enumeration
            BootSpiDeviceInfo* device = &hw->spi_devices[hw->spi_device_count++];
            device->type = SPI_DEVICE_TFT;
            device->cs_pin = bank->cs_pin;
            device->width = tft_w;
            device->height = tft_h;
            device->type_name = "TFT";
            
            printf("[SPI] TFT detected at CS %d: %dx%d\n", bank->cs_pin, tft_w, tft_h);
            continue;  // This bank is TFT, skip other checks
        }
        
        // Try to detect Touch
        if (detect_touch(bank->cs_pin)) {
            hw->touch_detected = true;
            hw->touch_cs_pin = bank->cs_pin;
            
            // Add to SPI device enumeration
            BootSpiDeviceInfo* device = &hw->spi_devices[hw->spi_device_count++];
            device->type = SPI_DEVICE_TOUCH;
            device->cs_pin = bank->cs_pin;
            device->type_name = "Touch";
            
            printf("[SPI] Touch detected at CS %d\n", bank->cs_pin);
            continue;  // This bank is Touch, skip other checks
        }
        
        // Try to detect SPI expander
        guikit_expander_type_t exp_type;
        if (detect_spi_expander(bank->cs_pin, &exp_type)) {
            hw->spi_expander_count++;
            switch (exp_type) {
                case GUIKIT_EXPANDER_MCP23S17:
                case GUIKIT_EXPANDER_MCP23017:
                    hw->total_expander_gpio += 16;
                    break;
                case GUIKIT_EXPANDER_MCP23S08:
                case GUIKIT_EXPANDER_MCP23008:
                    hw->total_expander_gpio += 8;
                    break;
                default:
                    break;
            }
            
            // Add to SPI device enumeration
            BootSpiDeviceInfo* device = &hw->spi_devices[hw->spi_device_count++];
            device->type = SPI_DEVICE_EXPANDER;
            device->cs_pin = bank->cs_pin;
            device->expander_type = exp_type;
            device->type_name = "Expander";
            
            printf("[SPI] Expander detected at CS %d: %d\n", bank->cs_pin, exp_type);
        }
    }
    
    // Print SPI device enumeration summary
    printf("[SPI] Device enumeration complete: %d devices found\n", hw->spi_device_count);
    for (int i = 0; i < hw->spi_device_count; i++) {
        BootSpiDeviceInfo* device = &hw->spi_devices[i];
        printf("[SPI]   Device %d: %s at CS %d", i + 1, device->type_name, device->cs_pin);
        if (device->type == SPI_DEVICE_SRAM || device->type == SPI_DEVICE_PSRAM) {
            printf(", %lu KB", device->size / 1024);
        } else if (device->type == SPI_DEVICE_TFT) {
            printf(", %dx%d", device->width, device->height);
        }
        printf("\n");
    }
}

// ============================================================================
// SMP (Symmetric Multi-Processing) Detection
// ============================================================================

/**
 * @brief Get current CPU core ID at runtime
 * 
 * For ESP8266: Always returns 0 (single core)
 * For ESP32: Returns 0 (PRO_CPU) or 1 (APP_CPU)
 * 
 * @return Core ID
 */
uint8_t get_current_cpu_core(void) {
    #if defined(ESP8266) || GUIKIT_PLATFORM_ESP8266
        // ESP8266 is always single-core
        return 0;
    #elif defined(ESP32) || GUIKIT_PLATFORM_ESP32
        // ESP32: detect which core we're running on
        // In ESP32 Arduino, xPortGetCoreID() can be used
        // For mock implementation, we'll simulate based on compile-time
        #ifdef BOOTLOADER_RUNNING_ON_CORE1
            return 1;
        #else
            return 0;  // Default to PRO_CPU (core 0)
        #endif
    #else
        // Unknown platform - assume single core
        return 0;
    #endif
}

/**
 * @brief Get total CPU core count at runtime
 * 
 * @return Core count (1 for ESP8266, 2 for ESP32)
 */
uint8_t get_cpu_core_count(void) {
    #if defined(ESP8266) || GUIKIT_PLATFORM_ESP8266
        return 1;  // ESP8266 is single-core
    #elif defined(ESP32) || GUIKIT_PLATFORM_ESP32
        return 2;  // ESP32 is dual-core
    #else
        return 1;  // Unknown platform - assume single core
    #endif
}

/**
 * @brief Detect SMP (Symmetric Multi-Processing) capability at runtime
 * 
 * This function determines:
 * - Number of available CPU cores
 * - Current core ID
 * - Whether SMP is available (multiple cores)
 * 
 * Detection is done at runtime using platform-specific methods.
 * 
 * @param state Bootloader state to populate with SMP info
 */
void detect_smp_capability(BootloaderState* state) {
    if (!state) return;
    
    // Get core count
    uint8_t core_count = get_cpu_core_count();
    uint8_t current_core = get_current_cpu_core();
    
    // Set SMP info in config
    state->config.cpu_core_count = core_count;
    state->config.current_cpu_core = current_core;
    state->config.smp_available = (core_count > 1);
    
    // Log SMP information
    printf("[SMP] CPU Core Count: %d\n", core_count);
    printf("[SMP] Current Core: %d\n", current_core);
    printf("[SMP] SMP Available: %s\n", state->config.smp_available ? "Yes" : "No");
    
    // ESP32-specific SMP notes
    #if defined(ESP32) || GUIKIT_PLATFORM_ESP32
        if (state->config.smp_available) {
            printf("[SMP] ESP32 Dual-Core Detected\n");
            printf("[SMP]   Core 0 (PRO_CPU): Typically runs bootloader/RTOS tasks\n");
            printf("[SMP]   Core 1 (APP_CPU): Available for application code\n");
            
            // Note: In ESP32, the second core (APP_CPU) is typically started
            // by the first core (PRO_CPU) after boot
            if (current_core == 0) {
                printf("[SMP]   Note: Running on Core 0. Core 1 can be started for parallel processing.\n");
            } else {
                printf("[SMP]   Note: Running on Core 1. This core was likely started by Core 0.\n");
            }
        }
    #endif
    
    // ESP8266-specific note
    #if defined(ESP8266) || GUIKIT_PLATFORM_ESP8266
        printf("[SMP] ESP8266 Single-Core: No SMP capability\n");
    #endif
}

// ============================================================================
// Initialize RAM (internal and external)
// ============================================================================

/**
 * Initialize RAM (internal and external)
 */
static bool init_ram(BootloaderState* state) {
    BootHardwareInfo* hw = &state->hardware;
    guikit_ram_config_t* ram_cfg = &state->config.ram;
    
    // Internal RAM is always available
    ram_cfg->internal = true;
    
    // Initialize external RAM banks
    ram_cfg->bank_count = 0;
    
    // If SRAM was detected, add it to the configuration
    if (hw->sram_detected) {
        guikit_ram_bank_t* bank = &ram_cfg->bank[ram_cfg->bank_count++];
        bank->type = GUIKIT_RAM_SRAM;
        bank->size = hw->sram_size;
        bank->cs_pin = hw->sram_cs_pin;
        bank->enabled = true;
        
        // Create SRAM instance (mock)
        state->sram_instance = nullptr;  // Would be new SPISRAM(hw->sram_cs_pin)
        printf("[RAM] SRAM initialized: %lu KB at CS %d\n", hw->sram_size / 1024, hw->sram_cs_pin);
    }
    
    // If PSRAM was detected, add it to the configuration
    if (hw->psram_detected) {
        guikit_ram_bank_t* bank = &ram_cfg->bank[ram_cfg->bank_count++];
        bank->type = GUIKIT_RAM_PSRAM;
        bank->size = hw->psram_size;
        bank->cs_pin = 255;  // PSRAM uses internal connection on ESP32
        bank->enabled = true;
        
        printf("[RAM] PSRAM initialized: %lu KB\n", hw->psram_size / 1024);
    }
    
    // Calculate available RAM
    state->available_external_ram = guikit_hw_get_external_ram(&state->config);
    
    #if defined(ESP8266)
        state->available_ram = 80 * 1024;  // ~80KB free on ESP8266
    #elif defined(ESP32)
        state->available_ram = 320 * 1024;  // ~320KB free on ESP32
    #else
        state->available_ram = 64 * 1024;  // Default: 64KB
    #endif
    
    state->available_ram += state->available_external_ram;
    
    return true;
}

/**
 * Initialize SD Card
 */
static bool init_sd_card(BootloaderState* state) {
    BootHardwareInfo* hw = &state->hardware;
    
    if (!hw->sdcard_detected) {
        printf("[SD] SD Card not detected, skipping\n");
        return false;
    }
    
    // Initialize SD Card (mock)
    state->sdcard_instance = nullptr;  // Would be new SDCard(hw->sdcard_cs_pin)
    
    // Check if SD Card is accessible
    // In a real implementation, this would try to read the card info
    printf("[SD] SD Card initialized at CS %d\n", hw->sdcard_cs_pin);
    
    return true;
}

/**
 * Initialize TFT display
 */
static bool init_tft(BootloaderState* state) {
    BootHardwareInfo* hw = &state->hardware;
    
    if (!hw->tft_detected) {
        printf("[TFT] TFT not detected, skipping\n");
        return false;
    }
    
    // Initialize TFT
    if (!tft_init(&state->tft_instance, hw->tft_cs_pin, hw->tft_width, hw->tft_height)) {
        state->current_state = BOOT_STATE_ERROR;
        state->error_message = "Failed to initialize TFT";
        return false;
    }
    
    // Clear screen
    tft_clear(state->tft_instance, BOOTLOADER_BG_COLOR);
    
    // Display boot header
    tft_draw_text(state->tft_instance, 10, 10, "GUIKit Bootloader", BOOTLOADER_SUCCESS_COLOR, BOOTLOADER_BG_COLOR);
    tft_draw_text(state->tft_instance, 10, 30, "Initializing...", BOOTLOADER_TEXT_COLOR, BOOTLOADER_BG_COLOR);
    
    // Display progress message
    tft_display_progress(state, "TFT Ready");
    
    printf("[TFT] TFT initialized: %dx%d at CS %d\n", hw->tft_width, hw->tft_height, hw->tft_cs_pin);
    
    return true;
}

// ============================================================================
// Memory Strategy Test
// ============================================================================

/**
 * Test memory strategy with sample GUI sizes
 * 
 * Demonstrates the STOP-at-first-success behavior:
 * 1. Try External RAM -> if success STOP
 * 2. Try SD Card Swap -> if success STOP  
 * 3. Try Internal RAM -> if success STOP
 * 4. Else FAILED
 */
static void test_memory_strategy(BootloaderState* state) {
    BootHardwareInfo* hw = &state->hardware;
    memory_strategy_config_t* cfg = &state->memory_config;
    
    printf("\n[MEMORY STRATEGY] Testing with detected hardware:\n");
    printf("  External RAM: %s (%lu KB)\n", 
           hw->sram_detected ? "Yes" : "No", hw->sram_size / 1024);
    printf("  SD Card: %s\n", hw->sdcard_detected ? "Yes" : "No");
    printf("  Internal RAM: ~%lu KB\n", state->available_ram / 1024);
    printf("\n");
    
    // Test different GUI sizes
    uint32_t test_sizes[] = {
        1024,      // 1KB - Small GUI
        4096,      // 4KB - Boundary for external RAM
        8192,      // 8KB - Boundary for internal RAM
        16384,     // 16KB - Boundary for SD swap
        32768,     // 32KB - Medium GUI
        65536,     // 64KB - Large GUI
        131072,    // 128KB - Very large GUI
        262144     // 256KB - Huge GUI
    };
    
    bool sram_avail = hw->sram_detected || hw->psram_detected;
    bool sdcard_avail = hw->sdcard_detected;
    
    printf("  Strategy Decision Flow (STOP at first success):\n");
    printf("  1. Try External RAM -> if (avail AND fits AND can_use) => SELECT & STOP\n");
    printf("  2. Try SD Card Swap -> if (avail AND fits AND can_use) => SELECT & STOP\n");
    printf("  3. Try Internal RAM -> if (fits AND can_use) => SELECT & STOP\n");
    printf("  4. Else => FAILED\n");
    printf("\n");
    
    for (int i = 0; i < sizeof(test_sizes) / sizeof(test_sizes[0]); i++) {
        uint32_t gui_size = test_sizes[i];
        MemoryStrategyLevel strategy = guikit_memory_strategy_select(
            cfg, gui_size, sram_avail, sdcard_avail
        );
        
        const char* strategy_name = "";
        switch (strategy) {
            case MEMORY_STRATEGY_EXTERNAL_RAM: strategy_name = "External RAM"; break;
            case MEMORY_STRATEGY_SD_SWAP: strategy_name = "SD Card Swap"; break;
            case MEMORY_STRATEGY_INTERNAL_RAM: strategy_name = "Internal RAM"; break;
            case MEMORY_STRATEGY_FAILED: strategy_name = "FAILED"; break;
        }
        
        printf("  GUI Size: %5lu KB -> Strategy: %s [STOP]\n", 
               gui_size / 1024, strategy_name);
        
        // If this is the first test, save it as the selected strategy
        if (i == 0) {
            state->selected_strategy = strategy;
        }
    }
    
    printf("\n");
}

// ============================================================================
// Bootloader Main Functions
// ============================================================================

/**
 * Initialize bootloader state
 */
static void bootloader_init(BootloaderState* state, const guikit_hw_config_t* platform_config) {
    memset(state, 0, sizeof(BootloaderState));
    
    // Set platform configuration
    if (platform_config) {
        state->config = *platform_config;
    } else {
        // Use default for current platform
        #if defined(ESP8266)
            state->config = GUIKIT_HW_ESP8266_DEFAULT;
        #elif defined(ESP32)
            state->config = GUIKIT_HW_ESP32_DEFAULT;
        #else
            state->config = GUIKIT_HW_DEFAULT;
        #endif
    }
    
    state->current_state = BOOT_STATE_INIT;
    state->error_message = NULL;
    state->sram_instance = nullptr;
    state->sdcard_instance = nullptr;
    state->tft_instance = nullptr;
    
    // Initialize SMP info (will be detected later in boot sequence)
    state->config.smp_available = false;
    state->config.cpu_core_count = 1;
    state->config.current_cpu_core = 0;
    
    // Start timing
    state->boot_start_time = 0;  // Would use millis() or similar
}

/**
 * @brief Log boot message to serial and optionally TFT
 * 
 * Before TFT is initialized, logs only to serial
 * After TFT is initialized, logs to both serial and TFT
 * 
 * @param state Bootloader state
 * @param format printf-style format string
 * @param ... Arguments for format string
 */
static void boot_log(BootloaderState* state, const char* format, ...) {
    // Log to serial
    va_list args;
    va_start(args, format);
    vprintf(format, args);
    va_end(args);
    
    // If TFT is initialized, also log to TFT
    if (state->tft_instance != nullptr && state->hardware.tft_detected) {
        char buffer[128];
        va_start(args, format);
        vsnprintf(buffer, sizeof(buffer), format, args);
        va_end(args);
        
        static int tft_y_pos = 30;  // Start below header
        tft_draw_text(state->tft_instance, 10, tft_y_pos, buffer, BOOTLOADER_TEXT_COLOR, BOOTLOADER_BG_COLOR);
        tft_y_pos += 15;
        
        // Scroll if needed
        if (tft_y_pos > BOOTLOADER_TFT_HEIGHT - 20) {
            tft_clear(state->tft_instance, BOOTLOADER_BG_COLOR);
            tft_draw_text(state->tft_instance, 10, 10, "GUIKit Bootloader", BOOTLOADER_SUCCESS_COLOR, BOOTLOADER_BG_COLOR);
            tft_y_pos = 30;
        }
    }
}

/**
 * Run the complete bootloader sequence
 */
bool guikit_bootloader_run(BootloaderState* state) {
    printf("\n");
    printf("========================================\n");
    printf("GUIKit Bootloader Starting\n");
    printf("========================================\n");
    printf("\n");
    
    // Initialize hardware detection info
    memset(&state->hardware, 0, sizeof(BootHardwareInfo));
    
    // Track if TFT is available for logging
    bool tft_ready = false;
    
    // ---------------------------------------------------------------------------
    // Step 0: MCU Platform Detection and Validation
    // ---------------------------------------------------------------------------
    printf("Loading ... [Step 0/8] MCU Platform Detection\n");
    state->current_state = BOOT_STATE_INIT;
    
    // Detect platform at compile time
    #if defined(ESP8266) || GUIKIT_PLATFORM_ESP8266
        state->config.is_esp8266 = true;
        state->config.is_esp32 = false;
        printf("[BOOT] Platform: ESP8266 (compile-time detected)\n");
    #elif defined(ESP32) || GUIKIT_PLATFORM_ESP32
        state->config.is_esp8266 = false;
        state->config.is_esp32 = true;
        printf("[BOOT] Platform: ESP32 (compile-time detected)\n");
    #else
        // Unsupported platform - display error on TFT if available
        state->config.is_esp8266 = false;
        state->config.is_esp32 = false;
        printf("[BOOT] ERROR: Unsupported MCU platform\n");
        
        // Try to display error on TFT if already initialized
        // Note: TFT might not be initialized yet, so we need a low-level method
        state->current_state = BOOT_STATE_ERROR;
        state->error_message = "Unsupported MCU platform";
        
        // If we have TFT CS pin from config, try to initialize TFT for error display
        if (state->config.display.width > 0 && state->config.display.height > 0) {
            TFT_ST7789* tft = nullptr;
            // Try common TFT CS pins
            for (uint8_t cs = 0; cs <= 16; cs++) {
                if (tft_init(&tft, cs, state->config.display.width, state->config.display.height)) {
                    // Clear screen with error color
                    tft_clear(tft, BOOTLOADER_ERROR_COLOR);
                    
                    // Display error message
                    tft_draw_text(tft, 10, 10, "GUIKit Boot Error", BOOTLOADER_BG_COLOR, BOOTLOADER_ERROR_COLOR);
                    tft_draw_text(tft, 10, 30, "Unsupported MCU", BOOTLOADER_BG_COLOR, BOOTLOADER_ERROR_COLOR);
                    tft_draw_text(tft, 10, 50, "Platform: Unknown", BOOTLOADER_BG_COLOR, BOOTLOADER_ERROR_COLOR);
                    
                    // Pause to allow reading
                    // In real code: delay(5000);
                    break;
                }
            }
        }
        
        return false;
    #endif
    
    printf("\n");
    
    // ---------------------------------------------------------------------------
    // Step 1: SMP (Symmetric Multi-Processing) Detection
    // ---------------------------------------------------------------------------
    printf("Loading ... [Step 1/8] SMP Detection\n");
    state->current_state = BOOT_STATE_HARDWARE_DETECTION;
    
    detect_smp_capability(state);
    
    printf("Loading ... [Step 1/8] SMP Detection complete: %d cores, running on core %d\n",
           state->config.cpu_core_count,
           state->config.current_cpu_core);
    printf("  SMP Available: %s\n", state->config.smp_available ? "Yes" : "No");
    printf("\n");
    
    // ---------------------------------------------------------------------------
    // Step 2: Hardware Detection
    // ---------------------------------------------------------------------------
    printf("Loading ... [Step 2/8] Hardware Detection\n");
    state->current_state = BOOT_STATE_HARDWARE_DETECTION;
    
    // Set platform info
    state->config.is_esp8266 = GUIKIT_PLATFORM_ESP8266;
    state->config.is_esp32 = GUIKIT_PLATFORM_ESP32;
    
    // Detect SPI devices
    detect_spi_devices(state);
    
    if (state->current_state == BOOT_STATE_ERROR) {
        printf("ERROR: %s\n", state->error_message);
        return false;
    }
    
    printf("Loading ... [Step 2/8] Hardware detection complete\n");
    printf("  SRAM: %s, PSRAM: %s, SD Card: %s, TFT: %s, Touch: %s\n",
           state->hardware.sram_detected ? "Yes" : "No",
           state->hardware.psram_detected ? "Yes" : "No",
           state->hardware.sdcard_detected ? "Yes" : "No",
           state->hardware.tft_detected ? "Yes" : "No",
           state->hardware.touch_detected ? "Yes" : "No");
    printf("  SPI Expanders: %d, GPIO: %d\n",
           state->hardware.spi_expander_count,
           state->hardware.total_expander_gpio);
    printf("\n");
    
    // ---------------------------------------------------------------------------
    // Step 2: RAM Initialization
    // ---------------------------------------------------------------------------
    printf("Loading ... [Step 3/8] RAM Initialization\n");
    state->current_state = BOOT_STATE_RAM_INITIALIZATION;
    
    if (!init_ram(state)) {
        state->current_state = BOOT_STATE_ERROR;
        state->error_message = "Failed to initialize RAM";
        printf("[BOOT] ERROR: %s\n", state->error_message);
        return false;
    }
    
    printf("Loading ... [Step 3/8] RAM initialization complete\n");
    printf("  Available RAM: %lu KB (Internal: ~%lu KB, External: %lu KB)\n",
           state->available_ram / 1024,
           (state->available_ram - state->available_external_ram) / 1024,
           state->available_external_ram / 1024);
    printf("\n");
    
    // ---------------------------------------------------------------------------
    // Step 3: SD Card Detection
    // ---------------------------------------------------------------------------
    printf("Loading ... [Step 4/8] SD Card Initialization\n");
    state->current_state = BOOT_STATE_SDCARD_DETECTION;
    
    if (state->hardware.sdcard_detected) {
        init_sd_card(state);
    }
    
    printf("Loading ... [Step 4/8] SD Card initialization complete\n");
    printf("  SD Card: %s\n", state->hardware.sdcard_detected ? "Ready" : "Not available");
    printf("\n");
    
    // ---------------------------------------------------------------------------
    // Step 4: TFT Initialization (moved here to show boot messages early)
    // ---------------------------------------------------------------------------
    printf("Loading ... [Step 4/8] TFT Initialization\n");
    state->current_state = BOOT_STATE_TFT_INITIALIZATION;
    
    if (state->hardware.tft_detected) {
        init_tft(state);
        
        // TFT is now ready - log confirmation
        printf("TFT initialized ... logging step on it ...\n");
        
        // Clear TFT and show header
        tft_clear(state->tft_instance, BOOTLOADER_BG_COLOR);
        tft_draw_text(state->tft_instance, 10, 10, "GUIKit Bootloader", BOOTLOADER_SUCCESS_COLOR, BOOTLOADER_BG_COLOR);
    }
    
    printf("Loading ... [Step 4/8] TFT initialization complete\n");
    printf("  TFT: %s\n", state->hardware.tft_detected ? "Ready" : "Not available");
    printf("\n");
    
    // ---------------------------------------------------------------------------
    // Step 5: Kernel Check (if SD Card is available)
    // ---------------------------------------------------------------------------
    if (state->hardware.sdcard_detected) {
        boot_log(state, "Loading ... [Step 5/8] Kernel Check\n");
        state->current_state = BOOT_STATE_KERNEL_CHECK;
        
        // boot_log will automatically display on TFT if initialized
        
        // Try all kernel paths until one is found
        bool kernel_found = false;
        for (int i = 0; KERNEL_PATHS[i] != NULL; i++) {
            if (check_kernel(state, KERNEL_PATHS[i])) {
                kernel_found = true;
                break;
            }
        }
        
        if (!kernel_found) {
            // Try default path
            kernel_found = check_kernel(state, "/kernel.bin");
        }
        
        if (!kernel_found) {
            state->current_state = BOOT_STATE_ERROR;
            state->error_message = "No valid kernel found on SD card";
            boot_log(state, "ERROR: No valid kernel found on SD card\n");
            return false;
        }
        
        boot_log(state, "Loading ... [Step 5/8] Kernel check complete\n");
        boot_log(state, "  Kernel: %lu KB at %s\n", 
               state->kernel.size / 1024, state->kernel.path);
        boot_log(state, "  Fits in RAM: %s\n", state->kernel.fits_in_ram ? "Yes" : "No");
        boot_log(state, "  Load Strategy: %s\n",
               state->kernel.strategy == MEMORY_STRATEGY_EXTERNAL_RAM ? "External RAM" :
               state->kernel.strategy == MEMORY_STRATEGY_SD_SWAP ? "SD Card Swap" :
               state->kernel.strategy == MEMORY_STRATEGY_INTERNAL_RAM ? "Internal RAM" : "FAILED");
        boot_log(state, "\n");
        
        // If kernel doesn't fit in RAM, fail
        if (!state->kernel.fits_in_ram) {
            state->current_state = BOOT_STATE_ERROR;
            state->error_message = "Kernel too large for available RAM";
            boot_log(state, "ERROR: %s\n", state->error_message);
            return false;
        }
        
        // If no valid strategy, fail
        if (state->kernel.strategy == MEMORY_STRATEGY_FAILED) {
            state->current_state = BOOT_STATE_ERROR;
            state->error_message = "No valid memory strategy for kernel";
            boot_log(state, "ERROR: %s\n", state->error_message);
            return false;
        }
    } else {
        // No SD Card - set kernel info accordingly
        state->kernel.found = false;
        state->kernel.size = 0;
        state->kernel.fits_in_ram = false;
        state->kernel.strategy = MEMORY_STRATEGY_FAILED;
        boot_log(state, "No SD Card - skipping kernel check (kernel must be in Flash)\n\n");
    }
    
    // ---------------------------------------------------------------------------
    // Step 6: Memory Strategy Configuration
    // ---------------------------------------------------------------------------
    boot_log(state, "Loading ... [Step 6/8] Memory Strategy Configuration\n");
    state->current_state = BOOT_STATE_MEMORY_STRATEGY_CONFIG;
    
    // Configure memory strategy based on detected hardware
    configure_memory_strategy(state);
    
    // Update the main config with the memory strategy
    state->config.memory_strategy = state->memory_config;
    
    boot_log(state, "Loading ... [Step 6/8] Memory strategy configured\n");
    boot_log(state, "  Strategy thresholds:\n");
    boot_log(state, "    External RAM min: %lu KB\n", state->memory_config.external_ram_min_size / 1024);
    boot_log(state, "    SD Swap min: %lu KB\n", state->memory_config.sd_swap_min_size / 1024);
    boot_log(state, "    Internal RAM max: %lu KB\n", state->memory_config.internal_ram_max_size / 1024);
    boot_log(state, "  Flags:\n");
    boot_log(state, "    Use External RAM: %s\n", state->memory_config.use_external_ram_by_default ? "Yes" : "No");
    boot_log(state, "    Use SD Swap: %s\n", state->memory_config.use_sd_swap_by_default ? "Yes" : "No");
    boot_log(state, "    Check Memory: %s\n", state->memory_config.check_memory_before_load ? "Yes" : "No");
    boot_log(state, "    Display Errors: %s\n", state->memory_config.display_error_on_tft ? "Yes" : "No");
    boot_log(state, "\n");
    
    // ---------------------------------------------------------------------------
    // Step 7: Memory Strategy Test and Apply
    // ---------------------------------------------------------------------------
    boot_log(state, "Loading ... [Step 7/8] Memory Strategy Test and Apply\n");
    state->current_state = BOOT_STATE_MEMORY_STRATEGY_APPLY;
    
    // Test memory strategy with different GUI sizes
    test_memory_strategy(state);
    
    // Initialize memory strategy system
    gui_memory_strategy_init(
        state->sram_instance,
        state->sdcard_instance,
        state->tft_instance,
        &state->memory_config
    );
    
    boot_log(state, "Loading ... [Step 7/8] Memory strategy initialized\n");
    
    // Get current strategy info
    uint32_t total_ram, used_ram, free_ram;
    MemoryStrategyLevel current_strategy;
    gui_memory_strategy_get_stats(&total_ram, &used_ram, &free_ram, &current_strategy);
    
    boot_log(state, "  Current Strategy: %s\n", 
           current_strategy == MEMORY_STRATEGY_EXTERNAL_RAM ? "External RAM" :
           current_strategy == MEMORY_STRATEGY_SD_SWAP ? "SD Swap" :
           current_strategy == MEMORY_STRATEGY_INTERNAL_RAM ? "Internal RAM" : "None");
    boot_log(state, "\n");
    
    // ---------------------------------------------------------------------------
    // Display Results on TFT
    // ---------------------------------------------------------------------------
    if (state->hardware.tft_detected) {
        tft_clear(state->tft_instance, BOOTLOADER_BG_COLOR);
        
        int y = 10;
        tft_draw_text(state->tft_instance, 10, y, "GUIKit Bootloader", BOOTLOADER_SUCCESS_COLOR, BOOTLOADER_BG_COLOR);
        y += 20;
        
        tft_draw_text(state->tft_instance, 10, y, "Hardware Detected:", BOOTLOADER_TEXT_COLOR, BOOTLOADER_BG_COLOR);
        y += 20;
        
        char buffer[64];
        
        snprintf(buffer, sizeof(buffer), "  SMP: %d cores, core %d",
                 state->config.cpu_core_count,
                 state->config.current_cpu_core);
        tft_draw_text(state->tft_instance, 10, y, buffer, BOOTLOADER_TEXT_COLOR, BOOTLOADER_BG_COLOR);
        y += 20;
        
        snprintf(buffer, sizeof(buffer), "  RAM: %lu KB Int, %lu KB Ext",
                 (state->available_ram - state->available_external_ram) / 1024,
                 state->available_external_ram / 1024);
        tft_draw_text(state->tft_instance, 10, y, buffer, BOOTLOADER_TEXT_COLOR, BOOTLOADER_BG_COLOR);
        y += 20;
        
        snprintf(buffer, sizeof(buffer), "  SD Card: %s",
                 state->hardware.sdcard_detected ? "Yes" : "No");
        tft_draw_text(state->tft_instance, 10, y, buffer, BOOTLOADER_TEXT_COLOR, BOOTLOADER_BG_COLOR);
        y += 20;
        
        snprintf(buffer, sizeof(buffer), "  TFT: %dx%d",
                 state->hardware.tft_width, state->hardware.tft_height);
        tft_draw_text(state->tft_instance, 10, y, buffer, BOOTLOADER_TEXT_COLOR, BOOTLOADER_BG_COLOR);
        y += 20;
        
        snprintf(buffer, sizeof(buffer), "  Touch: %s",
                 state->hardware.touch_detected ? "Yes" : "No");
        tft_draw_text(state->tft_instance, 10, y, buffer, BOOTLOADER_TEXT_COLOR, BOOTLOADER_BG_COLOR);
        y += 30;
        
        tft_draw_text(state->tft_instance, 10, y, "Memory Strategy:", BOOTLOADER_TEXT_COLOR, BOOTLOADER_BG_COLOR);
        y += 20;
        
        const char* strategy_names[] = {
            "External RAM", "SD Swap", "Internal RAM", "Failed"
        };
        snprintf(buffer, sizeof(buffer), "  Strategy: %s",
                 strategy_names[state->selected_strategy]);
        tft_draw_text(state->tft_instance, 10, y, buffer, BOOTLOADER_SUCCESS_COLOR, BOOTLOADER_BG_COLOR);
        y += 20;
        
        snprintf(buffer, sizeof(buffer), "  External > %lu KB",
                 state->memory_config.external_ram_min_size / 1024);
        tft_draw_text(state->tft_instance, 10, y, buffer, BOOTLOADER_TEXT_COLOR, BOOTLOADER_BG_COLOR);
        y += 20;
        
        snprintf(buffer, sizeof(buffer), "  SD Swap > %lu KB",
                 state->memory_config.sd_swap_min_size / 1024);
        tft_draw_text(state->tft_instance, 10, y, buffer, BOOTLOADER_TEXT_COLOR, BOOTLOADER_BG_COLOR);
        y += 20;
        
        snprintf(buffer, sizeof(buffer), "  Internal < %lu KB",
                 state->memory_config.internal_ram_max_size / 1024);
        tft_draw_text(state->tft_instance, 10, y, buffer, BOOTLOADER_TEXT_COLOR, BOOTLOADER_BG_COLOR);
        y += 30;
        
        tft_draw_text(state->tft_instance, 10, y, "Boot Complete!", BOOTLOADER_SUCCESS_COLOR, BOOTLOADER_BG_COLOR);
    }
    
    // ---------------------------------------------------------------------------
    // Finalize
    // ---------------------------------------------------------------------------
    state->current_state = BOOT_STATE_COMPLETE;
    state->boot_end_time = 0;  // Would use millis() or similar
    
    boot_log(state, "========================================\n");
    boot_log(state, "GUIKit Bootloader Complete\n");
    boot_log(state, "========================================\n");
    boot_log(state, "\n");
    boot_log(state, "Boot Summary:\n");
    boot_log(state, "  Platform: %s\n", 
           state->config.is_esp8266 ? "ESP8266" : (state->config.is_esp32 ? "ESP32" : "Unknown"));
    boot_log(state, "  SMP: %s (%d cores, running on core %d)\n",
           state->config.smp_available ? "Yes" : "No",
           state->config.cpu_core_count,
           state->config.current_cpu_core);
    boot_log(state, "  RAM: %lu KB total (%lu KB internal, %lu KB external)\n",
           state->available_ram / 1024,
           (state->available_ram - state->available_external_ram) / 1024,
           state->available_external_ram / 1024);
    boot_log(state, "  SD Card: %s\n", state->hardware.sdcard_detected ? "Available" : "Not available");
    boot_log(state, "  TFT: %s (%dx%d)\n", 
           state->hardware.tft_detected ? "Available" : "Not available",
           state->hardware.tft_width, state->hardware.tft_height);
    boot_log(state, "  Touch: %s\n", state->hardware.touch_detected ? "Available" : "Not available");
    boot_log(state, "  SPI Expanders: %d (%d GPIO)\n",
           state->hardware.spi_expander_count, state->hardware.total_expander_gpio);
    
    // Kernel information
    if (state->kernel.found) {
        boot_log(state, "\n");
        boot_log(state, "Kernel:\n");
        boot_log(state, "  Found: Yes\n");
        boot_log(state, "  Path: %s\n", state->kernel.path);
        boot_log(state, "  Size: %lu KB\n", state->kernel.size / 1024);
        boot_log(state, "  Version: %s\n", state->kernel.version ? state->kernel.version : "Unknown");
        boot_log(state, "  Fits in RAM: %s\n", state->kernel.fits_in_ram ? "Yes" : "No");
        boot_log(state, "  Load Strategy: %s\n",
               state->kernel.strategy == MEMORY_STRATEGY_EXTERNAL_RAM ? "External RAM" :
               state->kernel.strategy == MEMORY_STRATEGY_SD_SWAP ? "SD Card Swap" :
               state->kernel.strategy == MEMORY_STRATEGY_INTERNAL_RAM ? "Internal RAM" : "FAILED");
    } else {
        boot_log(state, "\n");
        boot_log(state, "Kernel:\n");
        boot_log(state, "  Found: No (must be in Flash)\n");
    }
    
    boot_log(state, "\n");
    boot_log(state, "Memory Strategy:\n");
    boot_log(state, "  Selected: %s\n",
           state->selected_strategy == MEMORY_STRATEGY_EXTERNAL_RAM ? "External RAM" :
           state->selected_strategy == MEMORY_STRATEGY_SD_SWAP ? "SD Swap" :
           state->selected_strategy == MEMORY_STRATEGY_INTERNAL_RAM ? "Internal RAM" : "Failed");
    boot_log(state, "  Thresholds:\n");
    boot_log(state, "    External RAM: > %lu KB\n", state->memory_config.external_ram_min_size / 1024);
    boot_log(state, "    SD Swap: > %lu KB\n", state->memory_config.sd_swap_min_size / 1024);
    boot_log(state, "    Internal RAM: < %lu KB\n", state->memory_config.internal_ram_max_size / 1024);
    boot_log(state, "\n");
    
    return true;
}

// ============================================================================
// Example Usage
// ============================================================================

/**
 * Example: Full bootloader sequence for ESP8266 with external SRAM
 */
void example_esp8266_with_sram() {
    printf("\n");
    printf("========================================\n");
    printf("Example: ESP8266 with External SRAM\n");
    printf("========================================\n");
    printf("\n");
    
    // Create a custom configuration for ESP8266 with external SRAM
    guikit_hw_config_t platform_config = GUIKIT_HW_ESP8266_DEFAULT;
    
    // Add external SRAM bank
    platform_config.ram.bank_count = 1;
    platform_config.ram.bank[0].type = GUIKIT_RAM_SRAM;
    platform_config.ram.bank[0].size = 131072;  // 128KB
    platform_config.ram.bank[0].cs_pin = 16;    // D0
    platform_config.ram.bank[0].enabled = true;
    
    // Configure SPI for SRAM, TFT, Touch, SD Card
    platform_config.spi.bank_count = 4;
    platform_config.spi.bank[0].type = GUIKIT_SPI_DEVICE;
    platform_config.spi.bank[0].cs_pin = 15;     // TFT on D8
    platform_config.spi.bank[0].enabled = true;
    
    platform_config.spi.bank[1].type = GUIKIT_SPI_DEVICE;
    platform_config.spi.bank[1].cs_pin = 4;      // Touch on D2
    platform_config.spi.bank[1].enabled = true;
    
    platform_config.spi.bank[2].type = GUIKIT_SPI_DEVICE;
    platform_config.spi.bank[2].cs_pin = 5;      // SD on D1
    platform_config.spi.bank[2].enabled = true;
    
    platform_config.spi.bank[3].type = GUIKIT_SPI_DEVICE;
    platform_config.spi.bank[3].cs_pin = 16;     // SRAM on D0
    platform_config.spi.bank[3].enabled = true;
    
    // Run bootloader
    BootloaderState state;
    bootloader_init(&state, &platform_config);
    
    if (guikit_bootloader_run(&state)) {
        printf("Bootloader completed successfully!\n");
    } else {
        printf("Bootloader failed: %s\n", state.error_message);
    }
}

/**
 * Example: Full bootloader sequence for ESP8266 without external RAM
 */
void example_esp8266_no_external_ram() {
    printf("\n");
    printf("========================================\n");
    printf("Example: ESP8266 without External RAM\n");
    printf("========================================\n");
    printf("\n");
    
    // Use default ESP8266 configuration (no external RAM)
    BootloaderState state;
    bootloader_init(&state, &GUIKIT_HW_ESP8266_DEFAULT);
    
    if (guikit_bootloader_run(&state)) {
        printf("Bootloader completed successfully!\n");
    } else {
        printf("Bootloader failed: %s\n", state.error_message);
    }
}

/**
 * Example: Full bootloader sequence for ESP32 with PSRAM
 */
void example_esp32_with_psram() {
    printf("\n");
    printf("========================================\n");
    printf("Example: ESP32 with PSRAM\n");
    printf("========================================\n");
    printf("\n");
    
    // Create a custom configuration for ESP32 with PSRAM
    guikit_hw_config_t platform_config = GUIKIT_HW_ESP32_DEFAULT;
    
    // Add PSRAM bank
    platform_config.ram.bank_count = 1;
    platform_config.ram.bank[0].type = GUIKIT_RAM_PSRAM;
    platform_config.ram.bank[0].size = 8 * 1024 * 1024;  // 8MB
    platform_config.ram.bank[0].cs_pin = 255;  // Internal connection
    platform_config.ram.bank[0].enabled = true;
    
    // Run bootloader
    BootloaderState state;
    bootloader_init(&state, &platform_config);
    
    if (guikit_bootloader_run(&state)) {
        printf("Bootloader completed successfully!\n");
    } else {
        printf("Bootloader failed: %s\n", state.error_message);
    }
}

// ============================================================================
// Main Entry Point (for testing)
// ============================================================================

int main() {
    printf("GUIKit Bootloader Examples\n\n");
    
    // Run all examples
    example_esp8266_with_sram();
    example_esp8266_no_external_ram();
    example_esp32_with_psram();
    
    return 0;
}
