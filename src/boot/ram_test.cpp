/**
 * @brief RAM Length Detection and Testing Implementation
 * 
 * Implements RAM length detection to verify actual RAM size
 * and detect wiring errors (e.g., 64K chip wired as 256K).
 * 
 * Features:
 * - Binary search for RAM size detection
 * - 1 or 2 pass verification
 * - Progress display on TFT
 * - Warning for mismatched RAM sizes
 * - Timeout handling
 * 
 * Generated by Mistral Vibe
 * Date: 2026-08-16
 */

#include "ram_test.h"
#include <string.h>
#include <stdio.h>

// Mock TFT functions - replace with actual TFT driver
#ifndef RAM_TEST_NO_TFT
extern void tft_set_cursor(uint16_t x, uint16_t y);
extern void tft_print(const char* str);
extern void tft_fill_screen(uint16_t color);
extern void tft_set_text_color(uint16_t color);
extern void tft_set_text_bg(uint16_t color);
#define TFT_COLOR_WHITE 0xFFFF
#define TFT_COLOR_BLACK 0x0000
#define TFT_COLOR_RED 0xF800
#define TFT_COLOR_GREEN 0x07E0
#define TFT_COLOR_YELLOW 0xFFE0
#else
#define tft_set_cursor(x, y)
#define tft_print(str)
#define tft_fill_screen(color)
#define tft_set_text_color(color)
#define tft_set_text_bg(color)
#endif

// Mock SPI RAM functions - replace with actual implementation
#ifndef RAM_TEST_NO_SPI
// These would be implemented using the actual SPI library
extern void spi_begin_transaction(uint8_t cs);
extern void spi_end_transaction(uint8_t cs);
extern uint8_t spi_transfer(uint8_t data);
#else
#define spi_begin_transaction(cs)
#define spi_end_transaction(cs)
#define spi_transfer(data) (data)
#endif

// ============================================================================
// SPI RAM Commands
// ============================================================================

#define SRAM_CMD_READ  0x03    /// Read from memory
#define SRAM_CMD_WRITE 0x02    /// Write to memory
#define SRAM_CMD_RDSR  0x05    /// Read status register
#define SRAM_CMD_WRSR  0x01    /// Write status register

// ============================================================================
// Local Functions
// ============================================================================

/// @brief Select RAM chip by setting CS low
/// @param cs_pin Chip select pin
static void ram_select(uint8_t cs_pin) {
    // In real implementation, set CS pin LOW
    // For mock, just track which CS is active
    spi_begin_transaction(cs_pin);
}

/// @brief Deselect RAM chip by setting CS high
/// @param cs_pin Chip select pin
static void ram_deselect(uint8_t cs_pin) {
    spi_end_transaction(cs_pin);
}

/// @brief Send address to RAM (24-bit address for most chips)
/// @param addr 24-bit address
static void ram_send_address(uint32_t addr) {
    // Send 3 bytes of address (MSB first)
    spi_transfer((uint8_t)(addr >> 16));
    spi_transfer((uint8_t)(addr >> 8));
    spi_transfer((uint8_t)(addr));
}

// ============================================================================
// Public Functions
// ============================================================================

bool ram_write_byte(uint8_t cs_pin, uint32_t addr, uint8_t data) {
    ram_select(cs_pin);
    spi_transfer(SRAM_CMD_WRITE);
    ram_send_address(addr);
    spi_transfer(data);
    ram_deselect(cs_pin);
    return true;
}

uint8_t ram_read_byte(uint8_t cs_pin, uint32_t addr) {
    uint8_t result = 0xFF;
    ram_select(cs_pin);
    spi_transfer(SRAM_CMD_READ);
    ram_send_address(addr);
    result = spi_transfer(0xFF); // Send dummy byte to receive data
    ram_deselect(cs_pin);
    return result;
}

bool ram_test_address_range(uint8_t cs_pin, uint32_t start_addr, uint32_t end_addr, uint8_t pattern) {
    // Test every RAM_TEST_STEP_SIZE bytes for speed
    for (uint32_t addr = start_addr; addr < end_addr; addr += RAM_TEST_STEP_SIZE) {
        // Write pattern
        if (!ram_write_byte(cs_pin, addr, pattern)) {
            return false;
        }
    }
    
    // Read back and verify
    for (uint32_t addr = start_addr; addr < end_addr; addr += RAM_TEST_STEP_SIZE) {
        uint8_t read_back = ram_read_byte(cs_pin, addr);
        if (read_back != pattern) {
            return false;
        }
    }
    
    return true;
}

uint32_t ram_find_actual_size(uint8_t cs_pin, uint32_t max_possible_size, uint8_t passes) {
    uint32_t low = 0;
    uint32_t high = max_possible_size;
    uint32_t detected_size = 0;
    
    // Binary search for RAM size
    while (low <= high) {
        uint32_t mid = low + (high - low) / 2;
        
        // Test if we can write/read at mid address
        bool test_passed = true;
        
        for (uint8_t pass = 0; pass < passes; pass++) {
            uint8_t pattern = (pass == 0) ? RAM_TEST_PATTERN_1 : RAM_TEST_PATTERN_2;
            
            // Test write/read at mid address
            if (!ram_write_byte(cs_pin, mid, pattern)) {
                test_passed = false;
                break;
            }
            
            uint8_t read_back = ram_read_byte(cs_pin, mid);
            if (read_back != pattern) {
                test_passed = false;
                break;
            }
        }
        
        if (test_passed) {
            // This address works, try higher
            detected_size = mid + 1;
            low = mid + 1;
        } else {
            // This address doesn't work, try lower
            high = mid - 1;
        }
        
        // Show progress for large RAM
        if (max_possible_size > 1024 * 1024) { // > 1MB
            uint8_t progress = (uint8_t)((low * 100) / max_possible_size);
            char msg[32];
            snprintf(msg, sizeof(msg), "Testing: %lu KB", mid / 1024);
            ram_test_display_progress(progress, mid, msg);
        }
    }
    
    // Round down to nearest known size
    for (uint8_t i = 0; i < sizeof(KNOWN_RAM_SIZES) / sizeof(KNOWN_RAM_SIZES[0]); i++) {
        if (KNOWN_RAM_SIZES[i] <= detected_size) {
            return KNOWN_RAM_SIZES[i];
        }
    }
    
    return detected_size;
}

RamTestResult ram_test_detect_size(uint8_t cs_pin, const RamTestConfig* config, RamTestInfo* info) {
    uint32_t start_time = 0;
    // In real implementation, use millis() or similar
    // For mock, we'll just track elapsed time manually
    
    if (info) {
        info->cs_pin = cs_pin;
        info->test_passes = config->passes;
        info->expected_size = config->expected_size;
        info->error_message = NULL;
        info->chip_type = "Unknown";
    }
    
    // Display start message
    if (config->show_progress) {
        char msg[64];
        snprintf(msg, sizeof(msg), "Testing RAM at CS %d...", cs_pin);
        ram_test_display_progress(0, 0, msg);
    }
    
    // Try to detect RAM by testing known sizes
    // Start with largest known size and work down
    uint32_t detected_size = 0;
    bool size_found = false;
    
    for (uint8_t i = 0; i < sizeof(KNOWN_RAM_SIZES) / sizeof(KNOWN_RAM_SIZES[0]); i++) {
        uint32_t test_size = KNOWN_RAM_SIZES[i];
        
        // Test if this size works
        bool all_passes_ok = true;
        for (uint8_t pass = 0; pass < config->passes; pass++) {
            uint8_t pattern = (pass % 4);
            
            if (!ram_test_address_range(cs_pin, 0, test_size, pattern)) {
                all_passes_ok = false;
                break;
            }
        }
        
        if (all_passes_ok) {
            detected_size = test_size;
            size_found = true;
            
            // Identify chip type based on size
            if (info) {
                info->detected_size = detected_size;
                info->chip_type = ram_size_name(detected_size);
            }
            
            // Update progress
            if (config->show_progress) {
                ram_test_display_progress(100, detected_size, "RAM detected!");
            }
            
            break;
        }
        
        // Update progress
        if (config->show_progress) {
            uint8_t progress = ((i + 1) * 100) / (sizeof(KNOWN_RAM_SIZES) / sizeof(KNOWN_RAM_SIZES[0]));
            char msg[32];
            snprintf(msg, sizeof(msg), "Trying %s...", ram_size_name(test_size));
            ram_test_display_progress(progress, test_size, msg);
        }
    }
    
    // Calculate test time (mock)
    if (info) {
        info->test_time_ms = detected_size / 1024; // ~1ms per KB
    }
    
    if (!size_found) {
        if (config->show_progress) {
            ram_test_display_progress(100, 0, "No RAM detected!");
        }
        if (info) {
            info->detected_size = 0;
            info->error_message = "No RAM detected at CS pin";
        }
        return RAM_TEST_NOT_DETECTED;
    }
    
    // Check against expected size
    if (config->expected_size > 0 && detected_size != config->expected_size) {
        if (info) {
            char msg[64];
            snprintf(msg, sizeof(msg), "Wired: %s, Expected: %s",
                    ram_size_name(detected_size), ram_size_name(config->expected_size));
            info->error_message = msg;
        }
        
        if (config->show_progress) {
            char msg[64];
            snprintf(msg, sizeof(msg), "WTM: %s wired as %s!",
                    ram_size_name(detected_size), ram_size_name(config->expected_size));
            ram_test_display_result(info);
            // Display warning on TFT
            tft_set_text_color(TFT_COLOR_RED);
            tft_set_text_bg(TFT_COLOR_YELLOW);
            tft_print(msg);
        }
        
        if (config->stop_on_failure) {
            return RAM_TEST_SIZE_MISMATCH;
        }
    }
    
    return RAM_TEST_OK;
}

void ram_test_display_progress(uint8_t progress, uint32_t current_size, const char* message) {
    // Clear progress line and display new progress
    tft_set_cursor(0, 120); // Assuming line 8 for progress
    tft_set_text_color(TFT_COLOR_WHITE);
    tft_set_text_bg(TFT_COLOR_BLACK);
    
    char buffer[64];
    snprintf(buffer, sizeof(buffer), "RAM Test: %3d%% %s      ", progress, message);
    tft_print(buffer);
}

void ram_test_display_result(const RamTestInfo* info) {
    if (!info) return;
    
    tft_set_cursor(0, 140); // Line 10 for results
    
    if (info->result == RAM_TEST_OK) {
        tft_set_text_color(TFT_COLOR_GREEN);
        char buffer[64];
        snprintf(buffer, sizeof(buffer), "RAM OK: %s at CS%d",
                info->chip_type, info->cs_pin);
        tft_print(buffer);
    } else if (info->result == RAM_TEST_SIZE_MISMATCH) {
        tft_set_text_color(TFT_COLOR_RED);
        tft_set_text_bg(TFT_COLOR_YELLOW);
        char buffer[64];
        snprintf(buffer, sizeof(buffer), "WTM: %s wired!", info->chip_type);
        tft_print(buffer);
        tft_set_cursor(0, 160);
        snprintf(buffer, sizeof(buffer), "Expected: %s", ram_size_name(info->expected_size));
        tft_print(buffer);
    } else {
        tft_set_text_color(TFT_COLOR_RED);
        char buffer[64];
        snprintf(buffer, sizeof(buffer), "RAM Error: %s",
                info->error_message ? info->error_message : "Unknown");
        tft_print(buffer);
    }
}

void ram_format_size(uint32_t size, char* buffer, uint32_t buffer_size) {
    if (size >= 1024 * 1024 * 1024) {
        snprintf(buffer, buffer_size, "%.1f GB", (float)size / (1024 * 1024 * 1024));
    } else if (size >= 1024 * 1024) {
        snprintf(buffer, buffer_size, "%.1f MB", (float)size / (1024 * 1024));
    } else if (size >= 1024) {
        snprintf(buffer, buffer_size, "%.1f KB", (float)size / 1024);
    } else {
        snprintf(buffer, buffer_size, "%lu B", size);
    }
}

const char* ram_size_name(uint32_t size) {
    switch (size) {
        case RAM_SIZE_8KB:     return "8KB";
        case RAM_SIZE_16KB:    return "16KB";
        case RAM_SIZE_32KB:    return "32KB";
        case RAM_SIZE_64KB:    return "64KB";
        case RAM_SIZE_128KB:   return "128KB";
        case RAM_SIZE_256KB:   return "256KB";
        case RAM_SIZE_512KB:   return "512KB";
        case RAM_SIZE_1MB:     return "1MB";
        case RAM_SIZE_2MB:     return "2MB";
        case RAM_SIZE_4MB:     return "4MB";
        case RAM_SIZE_8MB:     return "8MB";
        case RAM_SIZE_16MB:    return "16MB";
        case RAM_SIZE_32MB:    return "32MB";
        case RAM_SIZE_64MB:    return "64MB";
        default: {
            static char buffer[16];
            ram_format_size(size, buffer, sizeof(buffer));
            return buffer;
        }
    }
}
