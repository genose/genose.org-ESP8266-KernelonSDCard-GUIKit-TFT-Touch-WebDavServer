/**
 * GUIKit Web Editor - GUI Loader with External RAM Support
 * 
 * Load and save GUI JSON files from/to SD card or external RAM
 * By default, GUI JSON is loaded into external SRAM (23LC1024)
 * 
 * Generated by Mistral Vibe
 * Date: 2026-08-15
 */

#include "gui_loader.h"
#include "gui_loader_external_ram.h"
#include <string.h>
#include <stdlib.h>
#include <stddef.h>

// ============================================================================
// Configuration
// (Now using memory_strategy_config_t from guikit_hw_config.h)
// ============================================================================

#include "guikit_hw_config.h"

// For backward compatibility with existing code
#define GUI_LOADER_USE_EXTERNAL_RAM_BY_DEFAULT 1
#define GUI_LOADER_CHECK_MEMORY_BEFORE_LOAD 1

// Get config from memory strategy
static const memory_strategy_config_t* get_memory_config() {
    // This would normally be set during initialization
    // For now, return NULL to use defaults
    return NULL;
}

// ============================================================================
// External RAM Instance
// ============================================================================

// Global SRAM instance (set by gui_loader_set_sram)
static SPISRAM* global_sram_instance = nullptr;

/**
 * Set the external SRAM instance to use for GUI loading
 * 
 * @param sram Pointer to initialized SPISRAM instance
 */
void gui_loader_set_sram(SPISRAM* sram) {
    global_sram_instance = sram;
    
    // Initialize external RAM loader if SRAM is provided
    if (sram) {
        gui_external_ram_init(sram);
    }
}

/**
 * Get the current SRAM instance
 * 
 * @return Pointer to SPISRAM instance, or NULL if not set
 */
SPISRAM* gui_loader_get_sram() {
    return global_sram_instance;
}

// ============================================================================
// Modified GUI Loader Functions
// ============================================================================

bool gui_loader_init(void) {
    // Original SD card initialization
    // On ESP8266, this would be something like:
    // if (!SD.begin(SS, SPI)) return false;
    
    return true;
}

void gui_loader_shutdown(void) {
    // Shutdown SD card
}

int gui_loader_load(const char* path, char* buffer, int buffer_size) {
    if (!path || !buffer || buffer_size <= 0) {
        return -1;
    }
    
    // On ESP8266, this would use SD library:
    // File file = SD.open(path, FILE_READ);
    // if (!file) return -1;
    // int bytes_read = file.readBytes(buffer, buffer_size - 1);
    // file.close();
    // if (bytes_read > 0) buffer[bytes_read] = '\0';
    // return bytes_read;
    
    // For now, return mock data
    return -1;
}

bool gui_loader_save(const char* path, const char* json, int json_len) {
    if (!path || !json || json_len <= 0) {
        return false;
    }
    
    // On ESP8266, this would use SD library:
    // File file = SD.open(path, FILE_WRITE);
    // if (!file) return false;
    // bool success = file.write((const uint8_t*)json, json_len) == json_len;
    // file.close();
    // return success;
    
    return false; // Placeholder
}

bool gui_loader_exists(const char* path) {
    if (!path) {
        return false;
    }
    
    // On ESP8266: return SD.exists(path);
    return false; // Placeholder
}

int gui_loader_get_size(const char* path) {
    if (!path) {
        return -1;
    }
    
    // On ESP8266, this would use SD library:
    // File file = SD.open(path, FILE_READ);
    // if (!file) return -1;
    // int size = file.size();
    // file.close();
    // return size;
    
    return -1; // Placeholder
}

int gui_loader_list_files(const char* path, char** files, int max_files) {
    if (!path || !files || max_files <= 0) {
        return 0;
    }
    
    // On ESP8266, this would list files in the directory
    // For now, return 0 (no files)
    return 0;
}

int gui_loader_load_from_webdav(const char* filename, char* buffer, int buffer_size) {
    // This would make a WebDAV request to load the file
    // For now, use the SD card loader as fallback
    char full_path[256];
    snprintf(full_path, sizeof(full_path), "/gui/%s", filename);
    return gui_loader_load(full_path, buffer, buffer_size);
}

// ============================================================================
// Modified: Load GUI with External RAM Support
// ============================================================================

void* gui_loader_load_from_sd(const char* filename) {
    #if GUI_LOADER_USE_EXTERNAL_RAM_BY_DEFAULT && GUI_LOADER_CHECK_MEMORY_BEFORE_LOAD
    
    // If external RAM is available, try to load there first
    if (global_sram_instance) {
        // Check if file exists and get size
        char full_path[128];
        snprintf(full_path, sizeof(full_path), "/gui/%s", filename);
        
        int file_size = gui_loader_get_size(full_path);
        if (file_size > 0 && file_size <= GUI_JSON_MAX_SIZE) {
            // Check if there's space in external RAM
            if (gui_external_ram_has_space(global_sram_instance, file_size)) {
                // Load directly into external RAM
                if (gui_external_ram_load_from_sd(full_path, global_sram_instance)) {
                    // Parse from external RAM
                    return gui_external_ram_parse(global_sram_instance);
                }
            }
        }
    }
    
    #endif
    
    // Fallback: Load into internal RAM (original behavior)
    char buffer[GUI_LOADER_MAX_SIZE];
    int bytes_read = gui_loader_load(filename, buffer, sizeof(buffer));
    
    if (bytes_read <= 0) {
        return NULL;
    }
    
    return gui_loader_parse_json(buffer);
}

/**
 * Load GUI from SD card into external RAM
 * 
 * @param filename GUI filename
 * @return Pointer to GUI structure, or NULL on error
 * @note GUI data is stored in external RAM, but parsed widgets use internal pools
 */
void* gui_loader_load_from_sd_to_external_ram(const char* filename) {
    if (!global_sram_instance) {
        // No external RAM configured, use internal
        return gui_loader_load_from_sd(filename);
    }
    
    char full_path[128];
    snprintf(full_path, sizeof(full_path), "/gui/%s", filename);
    
    // Load into external RAM
    if (gui_external_ram_load_from_sd(full_path, global_sram_instance)) {
        // Parse from external RAM
        return gui_external_ram_parse(global_sram_instance);
    }
    
    return NULL;
}

/**
 * Load GUI from WebDAV into external RAM
 * 
 * @param filename GUI filename
 * @return Pointer to GUI structure, or NULL on error
 */
void* gui_loader_load_from_webdav_to_external_ram(const char* filename) {
    if (!global_sram_instance) {
        // No external RAM configured, use internal
        char buffer[GUI_LOADER_MAX_SIZE];
        int bytes_read = gui_loader_load_from_webdav(filename, buffer, sizeof(buffer));
        if (bytes_read <= 0) return NULL;
        return gui_loader_parse_json(buffer);
    }
    
    // Load into external RAM
    if (gui_external_ram_load_from_webdav(filename, global_sram_instance)) {
        // Parse from external RAM
        return gui_external_ram_parse(global_sram_instance);
    }
    
    return NULL;
}

void* gui_loader_parse_json(const char* json) {
    // Parse JSON into GUI structure
    // This would use a JSON parser library
    // For now, return NULL as placeholder
    (void)json;
    return NULL;
}

char* gui_loader_to_json(void* gui) {
    // Convert GUI structure to JSON
    // This would use a JSON serializer library
    // For now, return NULL as placeholder
    (void)gui;
    return NULL;
}

bool gui_loader_validate_json(const char* json) {
    // Validate JSON against schema
    // For now, just check if it's non-empty
    if (json == NULL || strlen(json) == 0) {
        return false;
    }
    
    // Check for basic structure
    // This is a very simple check - real implementation would use a JSON schema validator
    return strstr(json, "\"version\"") != NULL &&
           strstr(json, "\"widgets\"") != NULL &&
           strstr(json, "\"size\"") != NULL;
}

// ============================================================================
// Hybrid Loading Functions
// ============================================================================

/**
 * Load GUI with automatic external RAM usage
 * Tries external RAM first, falls back to internal RAM
 * 
 * @param filename GUI filename
 * @param use_external_ram If true, try external RAM first
 * @return Pointer to GUI structure, or NULL on error
 */
void* gui_loader_load_auto(const char* filename, bool use_external_ram) {
    if (use_external_ram && global_sram_instance) {
        // Try external RAM first
        void* gui = gui_loader_load_from_sd_to_external_ram(filename);
        if (gui) {
            return gui;
        }
    }
    
    // Fall back to internal RAM
    return gui_loader_load_from_sd(filename);
}

/**
 * Force reload GUI from SD card
 * If GUI was loaded into external RAM, reload it there
 * Otherwise, reload into internal RAM
 * 
 * @param filename GUI filename
 * @return Pointer to GUI structure, or NULL on error
 */
void* gui_loader_reload(const char* filename) {
    // First, clear any existing GUI in external RAM
    if (global_sram_instance && gui_external_ram_has_gui(global_sram_instance)) {
        gui_external_ram_clear(global_sram_instance);
    }
    
    // Reload
    return gui_loader_load_auto(filename, true);
}

// ============================================================================
// GUI Storage Information
// ============================================================================

/**
 * Check where a GUI is currently stored
 * 
 * @return true if GUI is stored in external RAM, false if in internal RAM
 */
bool gui_loader_is_in_external_ram() {
    if (!global_sram_instance) {
        return false;
    }
    return gui_external_ram_has_gui(global_sram_instance);
}

/**
 * Get GUI storage location as string
 * 
 * @return "External RAM" or "Internal RAM"
 */
const char* gui_loader_get_storage_location() {
    return gui_loader_is_in_external_ram() ? "External RAM" : "Internal RAM";
}

/**
 * Get memory usage information
 * 
 * @param total_ram Output: Total RAM available
 * @param used_ram Output: Used RAM for GUI
 * @param is_external Output: true if using external RAM
 */
void gui_loader_get_memory_info(uint32_t* total_ram, uint32_t* used_ram, bool* is_external) {
    if (total_ram) *total_ram = 0;
    if (used_ram) *used_ram = 0;
    if (is_external) *is_external = false;
    
    if (!global_sram_instance) {
        return;
    }
    
    if (is_external) {
        *is_external = gui_external_ram_has_gui(global_sram_instance);
    }
    
    if (global_sram_instance) {
        if (total_ram) {
            *total_ram = global_sram_instance->getSize();
        }
        if (used_ram) {
            *used_ram = gui_external_ram_get_usage(global_sram_instance);
        }
    }
}
