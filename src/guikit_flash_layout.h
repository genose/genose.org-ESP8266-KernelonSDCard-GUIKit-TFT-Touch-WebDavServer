/**
 * GUIKit Flash Partition Layout
 * 
 * Defines the flash memory layout for both ESP8266 and ESP32
 * Includes a dedicated config partition for storing hardware configuration
 * and runtime-detected settings.
 * 
 * Generated by Mistral Vibe
 * Date: 2026-08-15
 */

#ifndef GUIKIT_FLASH_LAYOUT_H
#define GUIKIT_FLASH_LAYOUT_H

#include <stdint.h>
#include <stdbool.h>
#include "guikit_hw_config.h"

// ============================================================================
// Flash Layout Configuration
// ============================================================================

// Config partition address (same for both ESP8266 and ESP32)
// On ESP8266: This is in the SPIFFS area
// On ESP32: This is a dedicated partition at 0x10000
#define GUIKIT_CONFIG_PARTITION_ADDRESS  0x10000

// Config partition size (4KB)
#define GUIKIT_CONFIG_PARTITION_SIZE     4096

// Magic bytes for config validation
#define GUIKIT_CONFIG_MAGIC              0x4755494B  // "GUIK" in ASCII

// Config version
#define GUIKIT_CONFIG_VERSION            1

// ============================================================================
// ESP8266 Flash Layout
// ============================================================================

#if defined(ESP8266) || GUIKIT_PLATFORM_ESP8266

// ESP8266 Flash Layout (assuming 4MB flash)
// 0x00000-0x01000 : Bootloader (4KB)
// 0x01000-0x10000 : User code (60KB)
// 0x10000-0x11000 : Config partition (4KB) - in SPIFFS area
// 0x11000-...    : SPIFFS (remaining ~3.8MB)

#define GUIKIT_FLASH_TOTAL_SIZE          (4 * 1024 * 1024)  // 4MB
#define GUIKIT_BOOTLOADER_SIZE           (4 * 1024)        // 4KB
#define GUIKIT_USER_CODE_SIZE            (60 * 1024)       // 60KB
#define GUIKIT_SPIFFS_START              0x10000
#define GUIKIT_SPIFFS_SIZE               (GUIKIT_FLASH_TOTAL_SIZE - GUIKIT_SPIFFS_START)

// ESP8266 has ~80KB free RAM
#define GUIKIT_INTERNAL_RAM_SIZE         (80 * 1024)

#endif // ESP8266

// ============================================================================
// ESP32 Flash Layout
// ============================================================================

#if defined(ESP32) || GUIKIT_PLATFORM_ESP32

// ESP32 Flash Layout (assuming 8MB flash with default partition table)
// 0x00000-0x01000 : Bootloader (4KB)
// 0x01000-0x08000 : Partition table + NVS (48KB)
// 0x08000-0x09000 : Phy_init (4KB)
// 0x09000-0x10000 : Reserved (28KB)
// 0x10000-0x11000 : Config partition (4KB)
// 0x11000-0x20000 : Kernel partition (64KB)
// 0x20000-...    : Storage (SPIFFS/FAT, remaining ~7.8MB)

#define GUIKIT_FLASH_TOTAL_SIZE          (8 * 1024 * 1024)  // 8MB
#define GUIKIT_BOOTLOADER_SIZE           (4 * 1024)        // 4KB
#define GUIKIT_PARTITION_TABLE_SIZE      (48 * 1024)       // 48KB
#define GUIKIT_PHY_INIT_SIZE             (4 * 1024)        // 4KB
#define GUIKIT_KERNEL_PARTITION_START    0x11000
#define GUIKIT_KERNEL_PARTITION_SIZE      (64 * 1024)       // 64KB
#define GUIKIT_STORAGE_PARTITION_START    0x20000
#define GUIKIT_STORAGE_PARTITION_SIZE     (GUIKIT_FLASH_TOTAL_SIZE - GUIKIT_STORAGE_PARTITION_START)

// ESP32 has ~320KB free RAM (varies by configuration)
#define GUIKIT_INTERNAL_RAM_SIZE         (320 * 1024)

#endif // ESP32

// ============================================================================
// Config Partition Structure
// ============================================================================

/**
 * Structure stored in the config partition
 * Contains hardware detection results and runtime configuration
 * 
 * Size: 4096 bytes (exactly one partition)
 */
#pragma pack(push, 1)
typedef struct {
    // Header
    uint32_t magic;                  // GUIKIT_CONFIG_MAGIC
    uint16_t version;                // Config version
    uint16_t checksum;                // Simple checksum for validation
    
    // Platform info (runtime detected or compiled)
    uint8_t platform_id;             // 0 = ESP8266, 1 = ESP32, 255 = Unknown
    uint8_t reserved_1[3];
    
    // Hardware detection results (56 bytes)
    bool sram_detected;
    uint32_t sram_size;
    uint8_t sram_cs_pin;
    uint8_t reserved_2[3];
    
    bool psram_detected;
    uint32_t psram_size;
    uint8_t reserved_3[4];
    
    bool sdcard_detected;
    uint8_t sdcard_cs_pin;
    uint8_t reserved_4[3];
    
    bool tft_detected;
    uint16_t tft_width;
    uint16_t tft_height;
    uint8_t tft_cs_pin;
    uint8_t tft_color_depth;
    uint8_t reserved_5[2];
    
    bool touch_detected;
    uint8_t touch_cs_pin;
    uint8_t reserved_6[3];
    
    uint8_t spi_expander_count;
    uint16_t total_expander_gpio;
    uint8_t reserved_7[1];
    
    // Memory strategy configuration (24 bytes)
    MemoryStrategyLevel selected;
    uint32_t external_ram_min_size;
    uint32_t sd_swap_min_size;
    uint32_t internal_ram_max_size;
    bool use_external_ram_by_default;
    bool use_sd_swap_by_default;
    bool check_memory_before_load;
    bool display_error_on_tft;
    uint8_t reserved_8[2];
    
    // Boot configuration (76 bytes)
    uint32_t boot_count;
    uint32_t last_boot_time;
    uint32_t last_error_code;
    char last_error_msg[64];
    
    // User configuration (164 bytes)
    char project_path[128];      // Default project path
    char username[32];          // Default username
    bool auto_load_last_project;
    uint8_t reserved_9[3];
    
    // Padding to fill to 4096 bytes
    // 8 + 56 + 24 + 76 + 164 = 328 bytes used
    // 4096 - 328 = 3768 bytes padding
    uint8_t padding[3768];

} guikit_config_partition_t;
#pragma pack(pop)

// ============================================================================
// Flash Layout Helper Functions
// ============================================================================

/**
 * Calculate checksum for config partition
 */
static inline uint16_t guikit_config_calculate_checksum(const guikit_config_partition_t* config) {
    const uint8_t* data = (const uint8_t*)config;
    uint16_t checksum = 0;
    
    // Skip magic, version, and checksum fields
    for (size_t i = sizeof(uint32_t) + sizeof(uint16_t) + sizeof(uint16_t); 
         i < GUIKIT_CONFIG_PARTITION_SIZE - sizeof(uint16_t); 
         i++) {
        checksum += data[i];
    }
    
    return checksum;
}

/**
 * Validate config partition
 */
static inline bool guikit_config_validate(const guikit_config_partition_t* config) {
    if (!config) return false;
    
    // Check magic
    if (config->magic != GUIKIT_CONFIG_MAGIC) {
        return false;
    }
    
    // Check version
    if (config->version != GUIKIT_CONFIG_VERSION) {
        return false;
    }
    
    // Check checksum
    uint16_t calculated_checksum = guikit_config_calculate_checksum(config);
    if (config->checksum != calculated_checksum) {
        return false;
    }
    
    return true;
}

/**
 * Initialize config partition with defaults
 */
static inline void guikit_config_init(guikit_config_partition_t* config) {
    if (!config) return;
    
    memset(config, 0, sizeof(guikit_config_partition_t));
    
    // Set header
    config->magic = GUIKIT_CONFIG_MAGIC;
    config->version = GUIKIT_CONFIG_VERSION;
    
    // Set platform ID based on compile-time detection
    #if defined(ESP8266) || GUIKIT_PLATFORM_ESP8266
        config->platform_id = 0;  // ESP8266
    #elif defined(ESP32) || GUIKIT_PLATFORM_ESP32
        config->platform_id = 1;  // ESP32
    #else
        config->platform_id = 255; // Unknown
    #endif
    
    // Initialize hardware to not detected
    config->hardware.sram_detected = false;
    config->hardware.psram_detected = false;
    config->hardware.sdcard_detected = false;
    config->hardware.tft_detected = false;
    config->hardware.touch_detected = false;
    config->hardware.spi_expander_count = 0;
    config->hardware.total_expander_gpio = 0;
    
    // Default memory strategy
    config->memory_strategy.selected = MEMORY_STRATEGY_INTERNAL_RAM;
    config->memory_strategy.external_ram_min_size = 4096;
    config->memory_strategy.sd_swap_min_size = 16384;
    config->memory_strategy.internal_ram_max_size = 8192;
    config->memory_strategy.use_external_ram_by_default = true;
    config->memory_strategy.use_sd_swap_by_default = true;
    config->memory_strategy.check_memory_before_load = true;
    config->memory_strategy.display_error_on_tft = true;
    
    // Clear boot info
    config->boot_info.boot_count = 0;
    config->boot_info.last_boot_time = 0;
    config->boot_info.last_error_code = 0;
    memset(config->boot_info.last_error_msg, 0, sizeof(config->boot_info.last_error_msg));
    
    // Clear user config
    memset(config->user_config.project_path, 0, sizeof(config->user_config.project_path));
    memset(config->user_config.username, 0, sizeof(config->user_config.username));
    config->user_config.auto_load_last_project = false;
    
    // Calculate and set checksum
    config->checksum = guikit_config_calculate_checksum(config);
}

/**
 * Update config partition from bootloader state
 */
void guikit_config_update_from_bootloader(guikit_config_partition_t* config, 
                                          const BootloaderState* state);

/**
 * Save config partition to flash
 * 
 * Note: Implementation is platform-specific
 * On ESP8266: Uses SPIFFS
 * On ESP32: Uses dedicated partition
 */
bool guikit_config_save(const guikit_config_partition_t* config);

/**
 * Load config partition from flash
 * 
 * Note: Implementation is platform-specific
 */
bool guikit_config_load(guikit_config_partition_t* config);

/**
 * Get platform name from ID
 */
const char* guikit_platform_id_to_string(uint8_t platform_id);

// ============================================================================
// ESP8266-Specific Flash Access
// ============================================================================

#if defined(ESP8266) || GUIKIT_PLATFORM_ESP8266

#include <FS.h>

/**
 * Save config to SPIFFS on ESP8266
 */
static inline bool guikit_config_save_spiffs(const guikit_config_partition_t* config) {
    if (!SPIFFS.begin()) {
        return false;
    }
    
    File file = SPIFFS.open("/config.bin", "w");
    if (!file) {
        SPIFFS.end();
        return false;
    }
    
    bool success = file.write((const uint8_t*)config, sizeof(guikit_config_partition_t));
    file.close();
    SPIFFS.end();
    
    return success;
}

/**
 * Load config from SPIFFS on ESP8266
 */
static inline bool guikit_config_load_spiffs(guikit_config_partition_t* config) {
    if (!SPIFFS.begin()) {
        return false;
    }
    
    if (!SPIFFS.exists("/config.bin")) {
        SPIFFS.end();
        return false;
    }
    
    File file = SPIFFS.open("/config.bin", "r");
    if (!file) {
        SPIFFS.end();
        return false;
    }
    
    bool success = file.readBytes((char*)config, sizeof(guikit_config_partition_t));
    file.close();
    SPIFFS.end();
    
    return success;
}

#endif // ESP8266

// ============================================================================
// ESP32-Specific Flash Access
// ============================================================================

#if defined(ESP32) || GUIKIT_PLATFORM_ESP32

#include <esp_partition.h>

/**
 * Save config to dedicated partition on ESP32
 */
static inline bool guikit_config_save_partition(const guikit_config_partition_t* config) {
    const esp_partition_t* partition = esp_partition_find_first(
        ESP_PARTITION_TYPE_DATA, ESP_PARTITION_SUBTYPE_ANY, "guikit_config"
    );
    
    if (!partition) {
        // Try to find by address
        partition = esp_partition_get(GUIKIT_CONFIG_PARTITION_ADDRESS);
    }
    
    if (!partition) {
        return false;
    }
    
    return esp_partition_write(partition, 0, (const uint8_t*)config, sizeof(guikit_config_partition_t)) == ESP_OK;
}

/**
 * Load config from dedicated partition on ESP32
 */
static inline bool guikit_config_load_partition(guikit_config_partition_t* config) {
    const esp_partition_t* partition = esp_partition_find_first(
        ESP_PARTITION_TYPE_DATA, ESP_PARTITION_SUBTYPE_ANY, "guikit_config"
    );
    
    if (!partition) {
        // Try to find by address
        partition = esp_partition_get(GUIKIT_CONFIG_PARTITION_ADDRESS);
    }
    
    if (!partition) {
        return false;
    }
    
    return esp_partition_read(partition, 0, (uint8_t*)config, sizeof(guikit_config_partition_t)) == ESP_OK;
}

#endif // ESP32

// ============================================================================
// Platform-Agnostic Save/Load Implementation
// ============================================================================

/**
 * Save config partition to flash (platform-specific)
 */
static inline bool guikit_config_save(const guikit_config_partition_t* config) {
    if (!config) return false;
    
    // Validate before saving
    if (!guikit_config_validate(config)) {
        return false;
    }
    
    #if defined(ESP8266) || GUIKIT_PLATFORM_ESP8266
        return guikit_config_save_spiffs(config);
    #elif defined(ESP32) || GUIKIT_PLATFORM_ESP32
        return guikit_config_save_partition(config);
    #else
        // For other platforms, use a file
        FILE* file = fopen("/tmp/guikit_config.bin", "wb");
        if (!file) return false;
        bool success = fwrite(config, 1, sizeof(guikit_config_partition_t), file) == sizeof(guikit_config_partition_t);
        fclose(file);
        return success;
    #endif
}

/**
 * Load config partition from flash (platform-specific)
 */
static inline bool guikit_config_load(guikit_config_partition_t* config) {
    if (!config) return false;
    
    #if defined(ESP8266) || GUIKIT_PLATFORM_ESP8266
        if (!guikit_config_load_spiffs(config)) {
            return false;
        }
    #elif defined(ESP32) || GUIKIT_PLATFORM_ESP32
        if (!guikit_config_load_partition(config)) {
            return false;
        }
    #else
        FILE* file = fopen("/tmp/guikit_config.bin", "rb");
        if (!file) return false;
        bool success = fread(config, 1, sizeof(guikit_config_partition_t), file) == sizeof(guikit_config_partition_t);
        fclose(file);
        if (!success) return false;
    #endif
    
    // Validate after loading
    return guikit_config_validate(config);
}

/**
 * Get platform name from ID
 */
static inline const char* guikit_platform_id_to_string(uint8_t platform_id) {
    switch (platform_id) {
        case 0:  return "ESP8266";
        case 1:  return "ESP32";
        default: return "Unknown";
    }
}

// ============================================================================
// TFT Error Display for Unsupported MCU
// ============================================================================

/**
 * Display MCU error on TFT
 * 
 * Called when the bootloader detects an unsupported MCU or configuration
 */
void guikit_display_mcu_error(TFT_ST7789* tft, uint8_t platform_id, const char* error_msg);

#endif // GUIKIT_FLASH_LAYOUT_H
